## general/package/rtl8188fu-openipc/Config.in
```kconfig
config BR2_PACKAGE_RTL8188FU_OPENIPC
	bool "rtl8188fu-openipc"
	depends on BR2_LINUX_KERNEL
	help
	  Wireless driver rtl8188fu from Ingenic SDK.

comment "RTL8188FU needs a Linux kernel to be built"
	depends on !BR2_LINUX_KERNEL
```

## package/Config.in
```kconfig
source "$BR2_EXTERNAL_THINGINO_PATH/package/aic8800-openipc/Config.in"
source "$BR2_EXTERNAL_THINGINO_PATH/package/atbm60xx/Config.in"
source "$BR2_EXTERNAL_THINGINO_PATH/package/atbm6441/Config.in"
source "$BR2_EXTERNAL_THINGINO_PATH/package/capjpeg/Config.in"
source "$BR2_EXTERNAL_THINGINO_PATH/package/fdk-aac-openipc/Config.in"
source "$BR2_EXTERNAL_THINGINO_PATH/package/ffmpeg-openipc/Config.in"
source "$BR2_EXTERNAL_THINGINO_PATH/package/go2rtc/Config.in"
source "$BR2_EXTERNAL_THINGINO_PATH/package/ingenic-diag-tools/Config.in"
source "$BR2_EXTERNAL_THINGINO_PATH/package/ingenic-libimp-control/Config.in"
source "$BR2_EXTERNAL_THINGINO_PATH/package/ingenic-opensdk/Config.in"
source "$BR2_EXTERNAL_THINGINO_PATH/package/ingenic-osdrv-t20/Config.in"
source "$BR2_EXTERNAL_THINGINO_PATH/package/ingenic-osdrv-t21/Config.in"
source "$BR2_EXTERNAL_THINGINO_PATH/package/ingenic-osdrv-t23/Config.in"
source "$BR2_EXTERNAL_THINGINO_PATH/package/ingenic-osdrv-t30/Config.in"
source "$BR2_EXTERNAL_THINGINO_PATH/package/ingenic-osdrv-t31/Config.in"
source "$BR2_EXTERNAL_THINGINO_PATH/package/ingenic-osdrv-t40/Config.in"
source "$BR2_EXTERNAL_THINGINO_PATH/package/ingenic-pwm/Config.in"
source "$BR2_EXTERNAL_THINGINO_PATH/package/jsonfilter/Config.in"
source "$BR2_EXTERNAL_THINGINO_PATH/package/libevent-openipc/Config.in"
source "$BR2_EXTERNAL_THINGINO_PATH/package/libogg-openipc/Config.in"
source "$BR2_EXTERNAL_THINGINO_PATH/package/libwebsockets-openipc/Config.in"
source "$BR2_EXTERNAL_THINGINO_PATH/package/linux-firmware-openipc/Config.in"
source "$BR2_EXTERNAL_THINGINO_PATH/package/linux-patcher/Config.in"
source "$BR2_EXTERNAL_THINGINO_PATH/package/logcat/Config.in"
source "$BR2_EXTERNAL_THINGINO_PATH/package/majestic/Config.in"
source "$BR2_EXTERNAL_THINGINO_PATH/package/motors/Config.in"
source "$BR2_EXTERNAL_THINGINO_PATH/package/mt7601u-openipc/Config.in"
source "$BR2_EXTERNAL_THINGINO_PATH/package/onvif-simple-server/Config.in"
source "$BR2_EXTERNAL_THINGINO_PATH/package/quirc-openipc/Config.in"
source "$BR2_EXTERNAL_THINGINO_PATH/package/raptor-ipc/Config.in"
source "$BR2_EXTERNAL_THINGINO_PATH/package/rtl8188eus-openipc/Config.in"
source "$BR2_EXTERNAL_THINGINO_PATH/package/rtl8188fu-openipc/Config.in"
source "$BR2_EXTERNAL_THINGINO_PATH/package/rtl8188fu-openipc/Config.in"
source "$BR2_EXTERNAL_THINGINO_PATH/package/rtl8189es-openipc/Config.in"
source "$BR2_EXTERNAL_THINGINO_PATH/package/rtl8189fs-openipc/Config.in"
source "$BR2_EXTERNAL_THINGINO_PATH/package/rtl8192eu-openipc/Config.in"
source "$BR2_EXTERNAL_THINGINO_PATH/package/rtl8733bu-openipc/Config.in"
source "$BR2_EXTERNAL_THINGINO_PATH/package/rtl8812au-openipc/Config.in"
source "$BR2_EXTERNAL_THINGINO_PATH/package/rtw-hostapd/Config.in"
source "$BR2_EXTERNAL_THINGINO_PATH/package/ssv6x5x-openipc/Config.in"
source "$BR2_EXTERNAL_THINGINO_PATH/package/ssw101b/Config.in"
source "$BR2_EXTERNAL_THINGINO_PATH/package/uacme-openipc/Config.in"
source "$BR2_EXTERNAL_THINGINO_PATH/package/vtund-openipc/Config.in"
source "$BR2_EXTERNAL_THINGINO_PATH/package/webui/Config.in"
source "$BR2_EXTERNAL_THINGINO_PATH/package/yaml-cli/Config.in"
source "$BR2_EXTERNAL_THINGINO_PATH/package/zerotier-one/Config.in"
source "$BR2_EXTERNAL_THINGINO_PATH/package/prudynt_v3/Config.in"
source "$BR2_EXTERNAL_THINGINO_PATH/package/thingino-live555/Config.in"
```

## package/atbm60xx/Config.in
```kconfig
menu "AltoBeam 60xx Wireless Driver" 

config BR2_PACKAGE_ATBM60XX
	bool "atbm60xx"
	depends on BR2_LINUX_KERNEL
	help
	  ALTOBEAM atbm60xx WiFi driver

if BR2_PACKAGE_ATBM60XX

choice
	prompt "Chip model"

config BR2_PACKAGE_ATBM60XX_MODEL_6012B
	bool "ATBM6012B"

config BR2_PACKAGE_ATBM60XX_MODEL_6031
	bool "ATBM6031"

config BR2_PACKAGE_ATBM60XX_MODEL_6032
	bool "ATBM6032"

config BR2_PACKAGE_ATBM60XX_MODEL_6041
	bool "ATBM6041"

endchoice

endif

comment "ATBM60XX needs a Linux kernel to be built"
	depends on !BR2_LINUX_KERNEL

endmenu
```

## package/atbm6441-tools/Config.in
```kconfig
config BR2_PACKAGE_ATBM6441_TOOLS
	bool "ATBM6441 IoT tools"
	depends on BR2_PACKAGE_WIFI_ATBM6441
	help
	  ATBM6441 IoT supplicant and CLI tools.
	  Provides atbm_iot_supplicant_demo (WiFi control daemon)
	  and atbm_iot_cli (command-line WiFi manager).
```

## package/atbm6461-tools/Config.in
```kconfig
config BR2_PACKAGE_ATBM6461_TOOLS
	bool "ATBM6461 MCU tools"
	depends on BR2_PACKAGE_WIFI_ATBM6461
	help
	  Source-built userspace tools for the ATBM6461 WiFi MCU command
	  interface. Provides an mcu_test-compatible command for WiFi setup,
	  battery queries, PIR/RTC settings, and firmware update helpers.
	  This replaces per-camera binary mcu_test overlays.
```

## package/aw87xxx/Config.in
```kconfig
config BR2_PACKAGE_AW87XXX
	bool "aw87xxx"
	depends on BR2_LINUX_KERNEL
	depends on !KERNEL_VERSION_7
	help
	  Awinic AW87xxx "Smart K" audio power amplifier kernel driver
	  (I2C controlled, register/scene profiles). Builds the
	  snd-soc-aw87xxx.ko module, auto-loads it, and installs an
	  example AW87559 ACF firmware to /usr/lib/firmware.

	  Bind via a device-tree node, e.g.:
	      aw87xxx_pa@58 {
	          compatible = "awinic,aw87xxx_pa";
	          reg = <0x58>;
	          reset-gpio = <...>;
	      };
	  Control is via sysfs:
	      /sys/bus/i2c/devices/<bus>-00<addr>/profile

	  The bundled firmware is tuned for the AW87559; boards with a
	  different speaker/chip should ship their own aw87xxx_acf.bin.

	  https://github.com/gtxaspec/aw87xxx

comment "aw87xxx needs a Linux kernel to be built"
	depends on !BR2_LINUX_KERNEL
```

## package/compy/Config.in
```kconfig
config BR2_PACKAGE_COMPY
	bool "compy RTSP library"
	help
	  Lightweight C99 RTSP/RTP library with H.264/H.265 NAL framing,
	  backchannel audio, and digest authentication.

	  https://github.com/gtxaspec/compy
```

## package/esp-microspeech-features/Config.in
```kconfig
config BR2_PACKAGE_ESP_MICROSPEECH_FEATURES
	bool "esp-microspeech-features"
	select BR2_PACKAGE_INGENIC_TFLITE_MICRO
	help
	  ESPMicroSpeechFeatures - TensorFlow Lite Micro spectrogram feature
	  generation library for audio processing.

	  A fork of the TensorFlow Lite Micro's Microfrontend optimized for
	  wake word detection. Generates spectrogram features from raw audio
	  samples suitable for TFLite Micro inference.

	  https://github.com/kahrendt/ESPMicroSpeechFeatures
```

## package/exfat-nofuse/Config.in
```kconfig
config BR2_PACKAGE_EXFAT_NOFUSE
	bool "exfat-nofuse"
	depends on BR2_LINUX_KERNEL
	select BR2_PACKAGE_EXFAT_UTILS
	select BR2_PACKAGE_DOSFSTOOLS
	select BR2_PACKAGE_DOSFSTOOLS_FSCK_FAT
	help
	  Linux non-fuse read/write kernel driver for the exFAT, FAT12, FAT16 and vfat (FAT32) file systems.
	  Originally ported from Android kernel v3.0.

	  https://github.com/dorimanx/exfat-nofuse

comment "exfat-nofuse needs a Linux kernel to be built"
	depends on !BR2_LINUX_KERNEL
```

## package/faac/Config.in
```kconfig
config BR2_PACKAGE_FAAC
	bool "Freeware Advanced Audio Coder"
	help
	  FAAC is an open-source MPEG-2 and MPEG-4 AAC audio format encoder.

	  http://sourceforge.net/projects/faac/

config BR2_PACKAGE_FAAC_INSTALL_BIN
	bool "Install faac CLI"
	default n
	depends on BR2_PACKAGE_FAAC
	help
	  Install the `faac` command-line encoder binary on both the
	  target rootfs and the staging sysroot. Disable this option to
	  keep only the libraries.
```

## package/ffmpeg-openipc/Config.in
```kconfig
config BR2_PACKAGE_FFMPEG_OPENIPC
	bool "FFmpeg (openipc-deprecated)"
	help
	  FFmpeg is a complete, cross-platform solution to record,
	  convert and stream audio and video.
	  http://www.ffmpeg.org
```

## package/gadget-serial/Config.in
```kconfig
config BR2_PACKAGE_GADGET_SERIAL
	bool "gadget-serial"
	select BR2_PACKAGE_THINGINO_KOPT
	select BR2_PACKAGE_THINGINO_KOPT_GADGET_SERIAL
	help
	  Enables a USB gadget serial device to allow termial access
```

## package/go2rtc-mini/Config.in
```kconfig
config BR2_PACKAGE_GO2RTC_MINI
	bool "go2rtc streamer - mini version"
	help
	  Ultimate camera streaming application with limited support for RTSP, for memory constrained devices.
	  Note: Binary will be UPX Compressed, binary size ~3.4mb
	  https://github.com/wltechblog/go2rtc
```

## package/go2rtc/Config.in
```kconfig
config BR2_PACKAGE_GO2RTC
	bool "go2rtc streamer"
	select BR2_PACKAGE_GO
	help
	  Ultimate camera streaming application with support of RTSP, WebRTC, HomeKit, FFmpeg, RTMP, etc.
	  https://github.com/AlexxIT/go2rtc

config BR2_PACKAGE_GO2RTC_UPX
	bool "compress binary with UPX"
	depends on BR2_PACKAGE_GO2RTC
	default y
	help
	  Compress the go2rtc binary with UPX (--best --lzma), reducing size to ~3.4 MB.
```

## package/ingenic-diag-tools/Config.in
```kconfig
config BR2_PACKAGE_INGENIC_DIAG_TOOLS
	bool "Ingenic Diagnostic Tools"
	help
	  Userspace program for manipulating GPIOs
```

## package/ingenic-libimp-control/Config.in
```kconfig
config BR2_PACKAGE_INGENIC_LIBIMP_CONTROL
	bool "IMP Library Control"
	help
	  Library for on the fly adjustments to the IMP Library
```

## package/ingenic-musl/Config.in
```kconfig
config BR2_PACKAGE_INGENIC_MUSL
	bool "ingenic-musl"
	depends on BR2_TOOLCHAIN_USES_MUSL
	help
	  Shared library implementing musl compatability with the Ingenic IMP platform
```

## package/ingenic-osdrv-t20/Config.in
```kconfig
config BR2_PACKAGE_INGENIC_OSDRV_T20
	bool "ingenic-osdrv-t20"
	help
	  Ingenic kernel modules and libs for T20 SoC
```

## package/ingenic-osdrv-t21/Config.in
```kconfig
config BR2_PACKAGE_INGENIC_OSDRV_T21
	bool "ingenic-osdrv-t21"
	help
	  Ingenic kernel modules and libs for T21 SoC
```

## package/ingenic-osdrv-t23/Config.in
```kconfig
config BR2_PACKAGE_INGENIC_OSDRV_T23
	bool "ingenic-osdrv-t23"
	help
	  Ingenic kernel modules and libs for T23 SoC
```

## package/ingenic-osdrv-t30/Config.in
```kconfig
config BR2_PACKAGE_INGENIC_OSDRV_T30
	bool "ingenic-osdrv-t30"
	help
	  Ingenic kernel modules and libs for T30 SoC
```

## package/ingenic-osdrv-t31/Config.in
```kconfig
config BR2_PACKAGE_INGENIC_OSDRV_T31
	bool "ingenic-osdrv-t31"
	help
	  Ingenic kernel modules and libs for T31 SoC
```

## package/ingenic-osdrv-t40/Config.in
```kconfig
config BR2_PACKAGE_INGENIC_OSDRV_T40
	bool "ingenic-osdrv-t40"
	help
	  Ingenic kernel modules and libs for T40 SoC
```
