## package/thingino-webui-mini/Config.in
```kconfig
config BR2_PACKAGE_THINGINO_WEBUI_MINI
	bool "Thingino Firmware Minimal Web User Interface"
	help
	  Minimal Thingino Web UI.
	  https://github.com/themactep/thingino-firmware
```

## package/thingino-wpa_supplicant/Config.in
```kconfig
config BR2_PACKAGE_THINGINO_WPA_SUPPLICANT
	bool "Thingino wpa_supplicant overrides"
	depends on BR2_PACKAGE_WPA_SUPPLICANT
	default y
	help
	  Apply Thingino-specific overrides to wpa_supplicant. This
	  disables unused features (smartcard, PKCS12, IEEE80211R,
	  IEEE80211AC/AX, P2P, TDLS, MATCH_IFACE, debug file) and
	  enables Thingino-specific defaults.

if BR2_PACKAGE_THINGINO_WPA_SUPPLICANT

config BR2_PACKAGE_THINGINO_WPA_SUPPLICANT_ROAMING
	bool "Enable wpa_supplicant roaming (disable driver roaming)"
	select BR2_PACKAGE_WPA_SUPPLICANT_AUTOSCAN
	help
	  Enable wpa_supplicant-based roaming and disable internal
	  driver roaming. This allows wpa_supplicant to manage roaming
	  decisions using bgscan, which is generally more reliable than
	  driver-based roaming. Automatically enables autoscan support.

endif
```

## package/toolchain-openipc/Config.in
```kconfig
config BR2_PACKAGE_TOOLCHAIN_OPENIPC
	bool n
	select BR2_TOOLCHAIN_EXTERNAL
	select BR2_TOOLCHAIN_EXTERNAL_CUSTOM
	select BR2_TOOLCHAIN_EXTERNAL_CXX
	select BR2_TOOLCHAIN_EXTERNAL_DOWNLOAD
	select BR2_TOOLCHAIN_BUILDROOT_LOCALE
	select BR2_TOOLCHAIN_BUILDROOT_USE_SSP
```

## package/usbnet/Config.in
```kconfig
menuconfig BR2_PACKAGE_USBNET
	bool "USB Networking Options"
	help
	  Networking Device Options

config BR2_PACKAGE_USBNET_ASIX
	bool "ASIX AX8817X USB"
	depends on BR2_PACKAGE_USBNET
	help
	  Select this option to enable support for USB network adapters based on
	  the ASIX AX88xxx family of USB 2.0 chipsets. These chipsets are found
	  in many popular USB-to-Ethernet adapters.

config BR2_PACKAGE_USBNET_ASIX_179_178A
	bool "ASIX AX88179_178A USB"
	depends on BR2_PACKAGE_USBNET
	help
	  Select this option to enable support for USB network adapters based on
	  the ASIX AX88179/178A USB 3.0 chipsets. These chipsets are found in
	  USB 3.0 to Gigabit Ethernet adapters.

config BR2_PACKAGE_USBNET_CDC_ETHER
	bool "CDC_ETHER"
	depends on BR2_PACKAGE_USBNET
	help
	  Select this option to enable support for CDC-Ethernet (Communications
	  Device Class), a standard USB protocol for Ethernet networking over USB.
	  This allows communication with devices that implement the CDC-Ethernet
	  protocol, such as USB network adapters and embedded devices. CDC-Ethernet
	  is widely supported across operating systems as a standard way to
	  provide network connectivity over USB.

config BR2_PACKAGE_USBNET_USB_DIRECT_NCM
	bool "USB Direct NCM"
	depends on BR2_PACKAGE_USBNET
	help
	  Select this option to enable support for CDC-NCM (Network Control Model),
	  a USB protocol that provides high-speed Ethernet networking. When enabled,
	  this device acts as a DHCP server and assigns IP addresses to other
	  devices that connect to it over USB. CDC-NCM is commonly used in modern
	  cellular modems and offers better performance than older protocols
	  like RNDIS.

config BR2_PACKAGE_USBNET_USB_DIRECT_NCM_CLIENT
	bool "USB Direct NCM-CLIENT"
	depends on BR2_PACKAGE_USBNET
	help
	  Select this option to enable CDC-NCM (Network Control Model) client mode.
	  When enabled, this device will operate as a client that receives an IP
	  address when connected to a CDC-NCM host device. For example, when
	  connected to a router or gateway operating in CDC-NCM host mode, this
	  device will obtain network connectivity from that host. This is the
	  opposite of CDC-NCM host mode where this device provides addresses to
	  others.

#config BR2_PACKAGE_USBNET_USB_DIRECT_ECM
#	bool "CDC-ECM"
#	depends on BR2_PACKAGE_USBNET
#	help
#	  Enables CDC_ECM

config BR2_PACKAGE_USBNET_CDC_NCM
	bool "CDC-NCM"
	depends on BR2_PACKAGE_USBNET
	help
	  USB CDC Network Control Model (NCM) driver. This enables support
	  for USB Ethernet devices that use the NCM protocol, which offers
	  higher throughput than CDC-ECM by supporting bundling of multiple
	  packets. Common devices include modern USB network adapters and
	  mobile broadband modems that implement the NCM standard.

config BR2_PACKAGE_USBNET_R8152
	bool "Realtek 8152"
	depends on BR2_PACKAGE_USBNET
	help
	  Select this option to enable support for USB network adapters based on
	  the Realtek RTL8152/RTL8153 chipsets.

config BR2_PACKAGE_USBNET_RNDIS
	bool "RNDIS"
	depends on BR2_PACKAGE_USBNET
	help
	  Select this option to enable support for RNDIS (Remote Network
	  Driver Interface Specification) over USB. This allows Ethernet-style
	  networking with USB devices that support the RNDIS protocol, such as
	  smartphones in USB tethering mode or cellular modems that expose an
	  RNDIS interface.

config BR2_PACKAGE_USBNET_WWAN_SERIAL
	bool "WWAN via USB SERIAL"
	depends on BR2_PACKAGE_USBNET
	select BR2_PACKAGE_PPPD
	help
	  Select this option to enable support for Wireless WAN (WWAN) devices
	  that connect via USB serial interfaces, such as LTE/4G modems.
	  This automatically enables the Point-to-Point Protocol daemon (pppd)
	  which is required for establishing cellular data connections with
	  these devices.
```

## package/usrsctp/Config.in
```kconfig
config BR2_PACKAGE_USRSCTP
	bool "usrsctp"
	help
	  Portable SCTP userland stack (dependency of libdatachannel)
```

## package/valisa/Config.in
```kconfig
config BR2_PACKAGE_VALISA
	bool "valisa"
	depends on !BR2_SOC_FAMILY = "a1"
	depends on BR2_PACKAGE_THINGINO_STREAMER_VALISA
	depends on BR2_PACKAGE_THINGINO_JCT
	help
	  Modular open-source camera streamer for Ingenic SoCs.
	  Replaces closed vendored SDK code with an open-stack solution.

	  https://github.com/themactep/valisa

comment "valisa needs thingino-jct"
	depends on !BR2_PACKAGE_THINGINO_JCT
```

## package/webui/Config.in
```kconfig
config BR2_PACKAGE_WEBUI
	bool "Web User Interface"
	select BR2_PACKAGE_HASERL
	select BR2_PACKAGE_ONVIF_SIMPLE_SERVER
	help
	  Web UI working with httpd and haserl.
	  https://github.com/themactep/thingino-firmware
```

## package/wifi-aic8800/Config.in
```kconfig
menu "AIC8800"
config BR2_PACKAGE_WIFI_AIC8800
	bool "AIC8800 wireless support"
	select BR2_LINUX_KERNEL
	help
	  AIC8800 wireless driver

if BR2_PACKAGE_WIFI_AIC8800
	choice
		prompt "Interface type"
		default BR2_PACKAGE_WIFI_AIC8800_USB
		config BR2_PACKAGE_WIFI_AIC8800_USB
			bool "USB"
			select BR2_PACKAGE_THINGINO_KOPT_DWC2
			select BR2_PACKAGE_THINGINO_KOPT_DWC2_WIFI_ONLY
			help
			  Enable USB support for AIC8800 wireless driver
		config BR2_PACKAGE_WIFI_AIC8800_SDIO
			bool "SDIO"
			help
			  Enable SDIO support for AIC8800 wireless driver
		config BR2_PACKAGE_WIFI_AIC8800_PCIE
			bool "PCIE"
			help
			  Enable PCIE support for AIC8800 wireless driver
	endchoice

	if BR2_PACKAGE_WIFI_AIC8800_USB
		choice
			prompt "USB Model"
			default BR2_PACKAGE_WIFI_AIC8800_USB_8800
			config BR2_PACKAGE_WIFI_AIC8800_USB_8800
				bool "AIC8800"
				help
				  Standard AIC8800 model
			config BR2_PACKAGE_WIFI_AIC8800_USB_8800D80
				bool "AIC8800D80"
				help
				  AIC8800D80 model with 80MHz bandwidth
			config BR2_PACKAGE_WIFI_AIC8800_USB_8800D80X2
				bool "AIC8800D80X2"
				help
				  AIC8800D80X2 dual radio model
			config BR2_PACKAGE_WIFI_AIC8800_USB_8800DC
				bool "AIC8800DC"
				help
				  AIC8800DC model with single band 2.4GHz
		endchoice
	endif

	if BR2_PACKAGE_WIFI_AIC8800_SDIO
		choice
			prompt "SDIO Model"
			default BR2_PACKAGE_WIFI_AIC8800_SDIO_8800
			config BR2_PACKAGE_WIFI_AIC8800_SDIO_8800
				bool "AIC8800"
				help
				Standard AIC8800 model
			config BR2_PACKAGE_WIFI_AIC8800_SDIO_8800D80
				bool "AIC8800D80"
				help
				AIC8800D80 model with 80MHz bandwidth
			config BR2_PACKAGE_WIFI_AIC8800_SDIO_8800DC
				bool "AIC8800DC"
				help
				AIC8800DC model with single band 2.4GHz
		endchoice
	endif

	if BR2_PACKAGE_WIFI_AIC8800_PCIE
		choice
			prompt "PCIE Model"
			default BR2_PACKAGE_WIFI_AIC8800_PCIE_8800D80
			config BR2_PACKAGE_WIFI_AIC8800_PCIE_8800D80
				bool "AIC8800D80"
				help
				AIC8800D80 model with 80MHz bandwidth
			config BR2_PACKAGE_WIFI_AIC8800_PCIE_8800D80X2
				bool "AIC8800D80X2"
				help
				AIC8800D80X2 dual radio model
		endchoice
	endif
endif
endmenu
```

## package/wifi-atbm-ble/Config.in
```kconfig
config BR2_PACKAGE_WIFI_ATBM_BLE
	select BR2_LINUX_KERNEL
	bool "AltoBeam ATBM-BLE"
```

## package/wifi-atbm-wifi/Config.in
```kconfig
config BR2_PACKAGE_WIFI_ATBM_WIFI
	select BR2_LINUX_KERNEL
	bool "AltoBeam ATBM-WIFI"
```

## package/wifi-atbm6012b/Config.in
```kconfig
config BR2_PACKAGE_WIFI_ATBM6012B
	select BR2_LINUX_KERNEL
	bool "AltoBeam ATBM6012B"
```

## package/wifi-atbm6012bx/Config.in
```kconfig
config BR2_PACKAGE_WIFI_ATBM6012BX
	select BR2_LINUX_KERNEL
	select BR2_PACKAGE_THINGINO_KOPT_DWC2
	select BR2_PACKAGE_THINGINO_KOPT_DWC2_WIFI_ONLY
	bool "AltoBeam ATBM6012BX"
```

## package/wifi-atbm6031/Config.in
```kconfig
config BR2_PACKAGE_WIFI_ATBM6031
	select BR2_LINUX_KERNEL
	select BR2_PACKAGE_THINGINO_KOPT_MMC
	bool "AltoBeam ATBM6031"
```

## package/wifi-atbm6031x-ble/Config.in
```kconfig
config BR2_PACKAGE_WIFI_ATBM6031X_BLE
    select BR2_LINUX_KERNEL
    select BR2_PACKAGE_WIFI_ATBM_BLE
	bool "AltoBeam ATBM6031X with Bluetooth LE"
	help
	  Enable Bluetooth Low Energy 5.0 support for ATBM6031X combo chip.

	  This adds BLE functionality to the ATBM6031X WiFi driver using
	  BlueZ HCI interface.

	  Hardware support: AltoBeam ATBM6031-X (lite variant)
	  - WiFi: 802.11b/g/n (2.4GHz, HT20/HT40)
	  - Bluetooth: BLE v4.2 / v5.0

	  Cameras known to have ATBM6031X with BLE capability:
	  - Eufy E220 T8410C (T31X + ATBM6031X)
```

## package/wifi-atbm6031x/Config.in
```kconfig
config BR2_PACKAGE_WIFI_ATBM6031X
	select BR2_LINUX_KERNEL
	bool "AltoBeam ATBM6031X"
```

## package/wifi-atbm6032/Config.in
```kconfig
config BR2_PACKAGE_WIFI_ATBM6032
	select BR2_LINUX_KERNEL
        select BR2_PACKAGE_THINGINO_KOPT_DWC2
        select BR2_PACKAGE_THINGINO_KOPT_DWC2_WIFI_ONLY
	bool "AltoBeam ATBM6032"
```

## package/wifi-atbm6032x/Config.in
```kconfig
config BR2_PACKAGE_WIFI_ATBM6032X
	select BR2_LINUX_KERNEL
	bool "AltoBeam ATBM6032X"
```

## package/wifi-atbm6062u/Config.in
```kconfig
config BR2_PACKAGE_WIFI_ATBM6062U
	select BR2_LINUX_KERNEL
	select BR2_PACKAGE_THINGINO_KOPT_DWC2
	select BR2_PACKAGE_THINGINO_KOPT_DWC2_WIFI_ONLY
	bool "AltoBeam ATBM6062U"
```

## package/wifi-atbm6132s/Config.in
```kconfig
config BR2_PACKAGE_WIFI_ATBM6132S
	select BR2_LINUX_KERNEL
	bool "AltoBeam ATBM6132S"
```

## package/wifi-atbm6132u/Config.in
```kconfig
config BR2_PACKAGE_WIFI_ATBM6132U
	select BR2_LINUX_KERNEL
	bool "AltoBeam ATBM6132U"
```

## package/wifi-atbm6162s/Config.in
```kconfig
config BR2_PACKAGE_WIFI_ATBM6162S
	select BR2_LINUX_KERNEL
	bool "AltoBeam ATBM6162S"
```

## package/wifi-atbm6461/Config.in
```kconfig
config BR2_PACKAGE_WIFI_ATBM6461
	bool "AltoBeam ATBM6461 (binary)"
	select BR2_LINUX_KERNEL
	select BR2_PACKAGE_ATBM6461_TOOLS
	select BR2_PACKAGE_THINGINO_KOPT_MMC
	help
	  Binary WiFi+MCU driver for AltoBeam ATBM6461 SDIO.
	  Used by the ZRT/AJCloud T23ZN OS02G10 ATBM6461 camera family,
	  including Wansview A1 and Cinnado B6.

	  Source unavailable; .ko extracted from stock recovery initramfs.
	  Vermagic is patched at build time to match the kernel version.
	  Kernel localversion must be short enough to fit (≤9 chars including
	  the leading dash), e.g. CONFIG_LOCALVERSION="-Archon".

	  Also builds z7682_disable_wdt from recovered source, selects
	  atbm6461-tools for MCU WiFi/battery commands, and ships librtos.so
	  for MCU watchdog communication via /dev/atbm_ioctl.
```

## package/wifi-atk9/Config.in
```kconfig
config BR2_PACKAGE_WIFI_ATK9
	bool "Atheros 9271"
	help
	  Firmware files for the Atheros 9271 module
```

## package/wifi-bcmdhd-ap6181/Config.in
```kconfig
config BR2_PACKAGE_WIFI_BCMDHD_AP6181
	bool "Broadcom 43438 (AP6181)"
	select BR2_LINUX_KERNEL
```
