## package/wifi-rtl8821cs/Config.in
```kconfig
config BR2_PACKAGE_WIFI_RTL8821CS
	bool "Realtek RTL8821CS"
	select BR2_LINUX_KERNEL
	help
	  Realtek's RTL8821CS SDIO driver (v5.15.9.3, as Novatek ships it).
	  https://github.com/gtxaspec/rtl8821cs-wifi
```

## package/wifi-skw6316/Config.in
```kconfig
config BR2_PACKAGE_WIFI_SKW6316
	bool "SeekWave SKW6316"
	select BR2_LINUX_KERNEL
	select BR2_PACKAGE_THINGINO_KOPT_DWC2
	select BR2_PACKAGE_THINGINO_KOPT_DWC2_WIFI_ONLY
	help
	  SeekWave SKW6316 USB WiFi driver (prebuilt).
```

## package/wifi-zt9101/Config.in
```kconfig
config BR2_PACKAGE_WIFI_ZT9101
	bool "ZTop ZT9101"
	select BR2_LINUX_KERNEL
	select BR2_PACKAGE_THINGINO_KOPT_DWC2
	select BR2_PACKAGE_THINGINO_KOPT_DWC2_WIFI_ONLY
	help
	  ZTop ZT9101 USB wireless driver, used by the ZT9101UV20
	  and ZT9101UV30 parts.
```

## package/xr871-bridge/Config.in
```kconfig
config BR2_PACKAGE_XR871_BRIDGE
	bool "XR871 co-processor keep-alive daemon"
	help
	  xr871d speaks the UART control protocol of the XR871 WiFi
	  co-processor used on some Ingenic battery cameras (e.g. ABUS
	  PPIC90520). It sends the heartbeat the XR871 expects, answers
	  its requests and takes the wall clock from it. Without it the
	  XR871 power-cycles the main SoC a few seconds after boot.

	  It is started from rcF (F00xr871d) right after the sysinit mounts.
```
