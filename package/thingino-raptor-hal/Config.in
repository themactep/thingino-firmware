## package/thingino-webui/Config.in
```kconfig
config BR2_PACKAGE_THINGINO_WEBUI
	bool "Thingino Firmware Web User Interface"
	depends on BR2_PACKAGE_THINGINO_WEBSERVER
	help
	  Thingino Web UI (HTML, JS, CSS, Auburn shell CGI).
	  Requires a web server to be selected.
	  https://github.com/themactep/thingino-firmware

config BR2_PACKAGE_THINGINO_WEBUI_PARANOID
	bool "Paranoid mode — bundle assets locally, no CDN"
	depends on BR2_PACKAGE_THINGINO_WEBUI
	help
	  Bundle Bootstrap, icons, and font assets on the camera.
	  All HTML pages reference local vendor files instead of CDNs.
	  Useful when the camera is isolated from the internet.
	  Adds ~248 KB to the firmware image.
```

## package/timps/Config.in
```kconfig
config BR2_PACKAGE_TIMPS
	bool "timps"
	depends on !BR2_SOC_FAMILY = "a1"
	depends on BR2_PACKAGE_THINGINO_STREAMER_TIMPS
	select BR2_PACKAGE_INGENIC_LIB
	select BR2_PACKAGE_INGENIC_LIB_LIBIMP
	select BR2_PACKAGE_THINGINO_FONTS
	select BR2_PACKAGE_THINGINO_LOGO
	select BR2_PACKAGE_THINGINO_SEND2
	select BR2_PACKAGE_INGENIC_MUSL if BR2_TOOLCHAIN_USES_MUSL
	select BR2_PACKAGE_INGENIC_UCLIBC if BR2_TOOLCHAIN_USES_UCLIBC
	help
	  Tiny IMP Streamer — a minimal, dependency-light RTSP / fragmented-MP4 /
	  MJPEG streamer for Ingenic SoC IP cameras.

	  Built straight on the vendor libimp — no live555, libconfig,
	  libwebsockets or libschrift. A lightweight alternative to prudynt-t
	  and raptor for the Thingino ecosystem.

	  https://github.com/Lu-Fi/timps

if BR2_PACKAGE_TIMPS

config BR2_PACKAGE_TIMPS_FAAC
	bool "AAC audio support (libfaac)"
	default y
	select BR2_PACKAGE_FAAC
	help
	  Enable software AAC audio encoding via libfaac. This enables
	  browser-compatible audio in the fMP4 preview and RTSP streams.
	  Without this, only G.711 audio is available.

config BR2_PACKAGE_TIMPS_CONTROL
	bool "Live control endpoint (/control)"
	default y
	help
	  Enable the live JSON control API at /control. Provides runtime
	  configuration, status, and camera control without restarting.
	  Disable to save ~15KB of binary size and reduce attack surface.

config BR2_PACKAGE_TIMPS_DAYNIGHT
	bool "Automatic day/night detection"
	default y
	help
	  Enable the native automatic day/night detection thread. Monitors
	  sensor brightness and switches ISP day/night mode and IR-cut
	  filter automatically. Disable if using an external photosensing
	  solution.

config BR2_PACKAGE_TIMPS_TLS
	bool "TLS support (HTTPS + RTSPS via mbedTLS)"
	default y
	select BR2_PACKAGE_MBEDTLS
	help
	  Enable mbedTLS for HTTPS (HTTP preview port) and RTSPS (RTSP
	  over TLS on port 322). Requires TLS certificates at
	  /etc/ssl/certs/httpd.crt and /etc/ssl/private/httpd.key.

config BR2_PACKAGE_TIMPS_SRT
	bool "SRT output (libsrt)"
	select BR2_PACKAGE_LIBSRT
	help
	  Enable MPEG-TS over SRT output in listener mode. The camera
	  acts as an SRT listener, serving live video+audio.
	  Playback: ffplay srt://<ip>:9000

config BR2_PACKAGE_TIMPS_ROTATE
	bool "Image rotation (90/180/270)"
	default n
	help
	  Enable per-stream image rotation. 180 is available on all SoCs
	  (realised as a global ISP Hflip+Vflip); hardware 90/270 rotation
	  is available on T40/T41 (I2D) and T31 (FrameSource rotate).
	  Rotation is restart-required. Disabled by default: when off, no
	  rotation code is compiled in (byte-identical build).

config BR2_PACKAGE_TIMPS_SW_ROTATE
	bool "Software 90/270 on SoCs without hardware rotate (T23)"
	depends on BR2_PACKAGE_TIMPS_ROTATE
	default n
	help
	  Enable software 90/270 rotation on SoCs that lack a hardware
	  rotate path (T23). The frame is transposed in software per frame
	  and fed to the unbound YuvEncode API. CPU-heavy on the single-core
	  T23, H264 only, software OSD only (no hardware OSD/privacy on the
	  rotated stream), and enlarges the binary. Leave off unless needed.

config BR2_PACKAGE_TIMPS_BACKCHANNEL
	bool "ONVIF audio backchannel (client -> speaker)"
	default n
	help
	  Enable the ONVIF audio backchannel: an RTSP client can send audio
	  to the camera to play through its speaker (talk-back). timps decodes
	  the incoming RTP to PCM and drives the speaker (IMP_AO) NATIVELY -
	  it owns the audio-output device directly, no external /bin/iac
	  (ingenic-audiodaemon) helper is needed anymore. G.711 (PCMU/PCMA)
	  decode is pure C, no extra library. Restart-required. Disabled by
	  default; when off, no backchannel code is compiled in.

config BR2_PACKAGE_TIMPS_BC_AAC
	bool "AAC backchannel decode (libhelix-aac)"
	depends on BR2_PACKAGE_TIMPS_BACKCHANNEL
	default n
	select BR2_PACKAGE_LIBHELIX_AAC
	help
	  Also accept AAC (mpeg4-generic) on the backchannel, decoded via
	  libhelix-aac (the same decoder prudynt uses). Better audio quality
	  than G.711 but higher latency and an extra dependency. Leave off
	  for a G.711-only, dependency-light backchannel.

config BR2_PACKAGE_TIMPS_PLAY
	bool "System-sound play queue (/usr/sbin/play)"
	default n
	help
	  Install /usr/sbin/play and have timps serve a play FIFO at
	  /run/timps/audio_out. This lets other parts of thingino play system
	  sounds through the camera speaker (native IMP_AO): the WiFi
	  captive-portal prompts, the post-upgrade chime, and the Home
	  Assistant ESPHome media_player/TTS integration all shell out to
	  `play`. Decodes WAV and raw PCM16 out of the box. Restart-required.
	  Disabled by default; when off, no play-queue code is compiled in and
	  those integrations are silent no-ops on a timps image.

config BR2_PACKAGE_TIMPS_PLAY_OPUS
	bool "Opus playback in the play queue (opusfile)"
	depends on BR2_PACKAGE_TIMPS_PLAY
	default n
	select BR2_PACKAGE_OPUSFILE
	help
	  Also decode Ogg-Opus files in the play queue, via opusfile (pulls in
	  libopus + libogg). thingino's shipped system sounds
	  (/usr/share/sounds/*.opus, the thingino-sounds package) are Ogg-Opus,
	  so enable this if you want those to play. Leave off for a
	  WAV/PCM-only, dependency-light play queue.

choice
	prompt "Audio backchannel preset"
	default BR2_PACKAGE_TIMPS_AUDIO_PRESET_MANUAL
	help
	  Backchannel + play queue + the matching thingino-sounds format are
	  five separate knobs (BACKCHANNEL/BC_AAC/PLAY/PLAY_OPUS here, plus
	  thingino-sounds' own format choice) that need to agree with each
	  other and with how much flash headroom the board actually has -
	  easy to get wrong one knob at a time. These two presets bundle the
	  combinations that are known to work; pick Manual to keep setting
	  the individual options above yourself.

config BR2_PACKAGE_TIMPS_AUDIO_PRESET_MANUAL
	bool "Manual (use the individual options above)"

config BR2_PACKAGE_TIMPS_AUDIO_PRESET_FULL
	bool "Full (backchannel + AAC + Opus play queue)"
	select BR2_PACKAGE_TIMPS_BACKCHANNEL
	select BR2_PACKAGE_TIMPS_BC_AAC
	select BR2_PACKAGE_TIMPS_PLAY
	select BR2_PACKAGE_TIMPS_PLAY_OPUS
	select BR2_PACKAGE_THINGINO_SOUNDS
	select BR2_PACKAGE_THINGINO_SOUNDS_FORMAT_OPUS
	help
	  Two-way audio with AAC backchannel quality, plus a system-sound
	  play queue that plays the stock Opus sound files. ~395KB of
	  codec/library footprint (opusfile+opus+libogg+libhelix-aac) -
	  needs a board with flash headroom. Confirmed fitting on T31-family
	  boards; too big for a ~5MB T20 rootfs partition this session.

config BR2_PACKAGE_TIMPS_AUDIO_PRESET_MINIMAL
	bool "Minimal (backchannel + G.711 play queue, no extra codecs)"
	select BR2_PACKAGE_TIMPS_BACKCHANNEL
	select BR2_PACKAGE_TIMPS_PLAY
	select BR2_PACKAGE_THINGINO_SOUNDS
	# The sound-file format is a Kconfig `choice`, which cannot be forced with
	# `select`; thingino-sounds instead defaults to G.711 whenever TIMPS_PLAY is
	# on without TIMPS_PLAY_OPUS (exactly this preset), so no select is needed.
	help
	  Two-way audio (G.711 only, no AAC) plus a system-sound play queue
	  using the G.711 mu-law sound files - zero extra codec libraries,
	  since timps' G.711 decoder is always built in. The
	  smallest-footprint way to get backchannel + play working on a
	  flash-constrained board; confirmed on a T20 board with a ~5MB
	  rootfs partition this session.

endchoice

endif # BR2_PACKAGE_TIMPS
```

## package/wifi-atbm6062s/Config.in
```kconfig
config BR2_PACKAGE_WIFI_ATBM6062S
	depends on !KERNEL_VERSION_7
	select BR2_LINUX_KERNEL
	select BR2_PACKAGE_THINGINO_KOPT_MMC
	bool "AltoBeam ATBM6062S"
```

## package/wifi-atbm6132cu/Config.in
```kconfig
config BR2_PACKAGE_WIFI_ATBM6132CU
	select BR2_LINUX_KERNEL
	select BR2_PACKAGE_THINGINO_KOPT_DWC2
	select BR2_PACKAGE_THINGINO_KOPT_DWC2_WIFI_ONLY
	bool "AltoBeam ATBM6132CU"

config BR2_PACKAGE_WIFI_ATBM6132CU_6162
	depends on BR2_PACKAGE_WIFI_ATBM6132CU
	bool "ATBM6132CU with USB DID 0x6162 (BT-comb firmware)"
	help
	  The ATBM6132CU ships under two USB DIDs. Parts reporting 0x6162
	  need the BT-comb firmware and the wifi_bt_comb=1 module parameter,
	  or transmit stalls a minute or two after association.
```

## package/wifi-atbm6441/Config.in
```kconfig
config BR2_PACKAGE_WIFI_ATBM6441
	bool "AltoBeam ATBM6441"
	select BR2_LINUX_KERNEL
	select BR2_PACKAGE_ATBM6441_TOOLS
	select BR2_PACKAGE_THINGINO_MMC
	help
	  AltoBeam ATBM6441 SDIO WiFi driver.

	  The thingino-mmc init script loads the module, and the IoT tools
	  drive the MCU WiFi stack, so both are selected here. The board
	  must still select the MMC kernel support separately; this package
	  does not select BR2_PACKAGE_THINGINO_KOPT_MMC.
```

## package/wifi-bcm43438/Config.in
```kconfig
config BR2_PACKAGE_WIFI_BCM43438
	bool "Broadcom 43438 (AP6212a)"
	select BR2_LINUX_KERNEL
	select BR2_PACKAGE_THINGINO_KOPT_MMC
```

## package/wifi-bcmdhd-ap6214a/Config.in
```kconfig
config BR2_PACKAGE_WIFI_BCMDHD_AP6214A
	bool "Broadcom 43438 (AP6214a)"
	select BR2_LINUX_KERNEL
	select BR2_PACKAGE_THINGINO_KOPT_MMC
	depends on KERNEL_VERSION_4 && BR2_SOC_FAMILY = "c100"
```

## package/wifi-hwsim/Config.in
```kconfig
config BR2_PACKAGE_WIFI_HWSIM
	select BR2_LINUX_KERNEL
	bool "mac80211_hwsim (QEMU virtual WiFi)"
	help
	  Virtual WiFi radio for testing in QEMU. Creates wlan0/wlan1
	  interfaces backed by mac80211_hwsim so the full WiFi
	  provisioning stack (wpa_supplicant, hostapd, thingino WiFi
	  setup) can be tested without hardware.
```

## package/wifi-rt5370/Config.in
```kconfig
config BR2_PACKAGE_WIFI_RT5370
	bool "Ralink RT5370"
	select BR2_LINUX_KERNEL
	select BR2_PACKAGE_THINGINO_KOPT_DWC2
	select BR2_PACKAGE_LINUX_FIRMWARE
	select BR2_PACKAGE_LINUX_FIRMWARE_RALINK_RT2XX
	help
	  Wireless driver RT5370 (rt2800usb).
```

## package/wifi-ssv6158/Config.in
```kconfig
config BR2_PACKAGE_WIFI_SSV6158
	bool "SSV6158"
	select BR2_LINUX_KERNEL
	select BR2_PACKAGE_THINGINO_KOPT_MMC
	help
		Enable support for SSV6158 SDIO based WiFi chips.
```

## package/wifi-swt6621s/Config.in
```kconfig
config BR2_PACKAGE_WIFI_SWT6621S
	bool "Seekwave SWT6621S (SV6621S/SV6160LITE) USB"
	select BR2_LINUX_KERNEL
	select BR2_PACKAGE_THINGINO_KOPT_DWC2
	select BR2_PACKAGE_THINGINO_KOPT_DWC2_WIFI_ONLY
	help
	  Seekwave SWT6621S Wi-Fi over USB (enumerates as SV6160LITE,
	  USB ID 3607:6621). Builds the vendor BSP (skw_usb_lite) and
	  cfg80211 core (swt6621s_wifi) as a single external-module
	  build; the BSP module must be probed first - it registers the
	  wifi platform device and requests the core via request_module.
```

## package/wyze-accessory/Config.in
```kconfig
config BR2_PACKAGE_WYZE_ACCESSORY
	bool "Wyze Accessories"
	help
	  Kernel modules, programs, and scripts for controlling Wyze accessories, such as the Spotlight or Wyze Car.

config BR2_PACKAGE_WYZE_ACCESSORY_FLOODLIGHT
	bool "Wyze Floodlight"
	depends on BR2_PACKAGE_WYZE_ACCESSORY
	help
	  Kernel modules and scripts for controlling the Wyze Floodlight accessory

config BR2_PACKAGE_WYZE_ACCESSORY_SPOTLIGHT
	bool "Wyze Spotlight"
	depends on BR2_PACKAGE_WYZE_ACCESSORY
	help
	  Kernel modules and scripts for controlling the Wyze Spotlight accessory

config BR2_PACKAGE_WYZE_ACCESSORY_LAMP_SOCKET
	bool "Wyze Lamp Socket"
	depends on BR2_PACKAGE_WYZE_ACCESSORY
	help
	  Kernel modules, lamp_socket_ctl and a web UI page for switching the
	  Wyze Lamp Socket (v1) that powers a Wyze Cam v3 over its USB cable.
	  Adds a Lamp button to the control bar and, with thingino-ha, a
	  Home Assistant switch. Off until enabled under Settings > Lamp Socket.

config BR2_PACKAGE_WYZE_ACCESSORY_CAR
	bool "Wyze Car"
	depends on BR2_PACKAGE_WYZE_ACCESSORY
	help
	  Kernel modules and scripts for controlling the Wyze Car accessory

config BR2_PACKAGE_WYZE_ACCESSORY_DOORBELL_CTRL
	bool "Wyze Doorbell Chime"
	depends on BR2_PACKAGE_WYZE_ACCESSORY
	help
	  Userspace program for pairing and controlling the wireless chime on the Wyze Doorbell V1.
	  Supports multiple chimes stored in /etc/thingino.json with day/night-aware
	  event routing via doorbell_event.
```
