## package/thingino-secureboop/Config.in
```kconfig
config BR2_PACKAGE_THINGINO_SECUREBOOP
	bool "SPL patching for eFuse-locked SoCs (secureboop)"
	help
	  Patch the locally-built U-Boot SPL at build time so it boots
	  on SoCs with eFuse-locked secure boot.

	  T23/T32/T40/T41/A1: init-table write into the SPL header.
	  T31: signature collision on the partial RSA check.

	  Init-table SoCs need no extra configuration.  T31 requires the
	  vendor RSA modulus (see sub-options).

if BR2_PACKAGE_THINGINO_SECUREBOOP

config BR2_PACKAGE_THINGINO_SECUREBOOP_T31_MODULUS
	string "T31 RSA modulus (512 hex chars)"
	depends on BR2_SOC_FAMILY = "t31"
	help
	  The 256-byte RSA-2048 public modulus from the vendor-signed
	  SPL, as 512 hex characters.  This is the public key, not a
	  secret.  Extract once from a stock flash dump:

	    ingenic_t31_spl_patcher.py extract <stock.bin>

config BR2_PACKAGE_THINGINO_SECUREBOOP_T31_EXPONENT
	int "T31 RSA exponent"
	depends on BR2_SOC_FAMILY = "t31"
	default 65537
	help
	  RSA public exponent.  Almost always 65537 (0x10001).

endif
```

## package/thingino-send2/Config.in
```kconfig
config BR2_PACKAGE_THINGINO_SEND2
	bool "thingino-send2"
	select BR2_PACKAGE_THINGINO_JCT
	help
	  Shared send-to-* notification toolkit (email, FTP, Telegram, MQTT,
	  ntfy, Pushover, webhook, storage, Google Photos, Gotify).

	  Provides /usr/sbin/send2* plus /etc/send2.json and shared helpers.
	  Default send2common is prudynt capture; raptor and timps install
	  their own send2common at image finalize so each camera has one
	  capture path only (no runtime streamer branching).
```

## package/thingino-sensor-info/Config.in
```kconfig
config BR2_PACKAGE_THINGINO_SENSOR_INFO
	bool "thingino-sensor-info"
	help
	  Userspace Ingenic image sensor detector. Probes the sensor
	  I2C bus against a database of known sensors, driving MCLK
	  and reset/pwdn GPIOs itself. Replaces the sinfo kernel
	  module and the per-kernel .ko download flow.

	  https://github.com/thingino/sensor-info
```

## package/thingino-snmpd/Config.in
```kconfig
config BR2_PACKAGE_THINGINO_SNMPD
	bool "thingino-snmpd"
	depends on BR2_PACKAGE_THINGINO_JCT
	select BR2_PACKAGE_MINI_SNMPD
	help
	  mini-snmpd, a minimal SNMP daemon for embedded systems, wired
	  into thingino. Lets an NMS (LibreNMS, Zabbix, Observium, Cacti,
	  check_mk, ...) poll the camera for uptime, CPU load, memory,
	  disk usage, network interface counters and hwmon temperature
	  sensors.

	  The daemon itself is built by Buildroot's mini-snmpd package;
	  this option adds the Thingino integration layer (init script,
	  shipped defaults and WebUI plugin) on top of it.

	  Read-only SNMP v1/v2c, optional SNMPv2c traps. No SNMPv3.

	  Configuration lives in the "snmpd" section of
	  /etc/thingino.json; a WebUI page is installed when
	  thingino-webui is enabled. The service ships disabled.

	  https://github.com/troglobit/mini-snmpd
```

## package/thingino-soc-vpu/Config.in
```kconfig
config BR2_PACKAGE_THINGINO_SOC_VPU
	bool "thingino-soc-vpu"
	default y if BR2_PACKAGE_THINGINO_ISP_OPEN && BR2_THINGINO_DEV_CAMERA && BR2_SOC_FAMILY = "t20" && KERNEL_VERSION_7
	depends on BR2_SOC_FAMILY = "t20"
	depends on KERNEL_VERSION_7
	depends on BR2_PACKAGE_THINGINO_ISP_OPEN
	depends on BR2_THINGINO_DEV_CAMERA
	help
	  Vendor T20 soc_vpu (Helix) H.264/JPEG encoder driver.

	  The modern kernels do not build the vendor SDK and the mainline
	  tree has no soc_vpu driver, so nothing provides /dev/soc_vpu.  The
	  vendored libimp's IMP_Encoder opens that node; without it the
	  streamer faults after the ISP is up.

	  This builds the T20 soc_vpu/jz_nvpu stack as a module and installs
	  /etc/modules.d/10-soc-vpu.  Only meaningful for the open T20 7.x
	  stack.
```

## package/thingino-sounds/Config.in
```kconfig
config BR2_PACKAGE_THINGINO_SOUNDS
	bool "thingino-sounds"
	help
	  Base sound files for thingino devices

if BR2_PACKAGE_THINGINO_SOUNDS

config BR2_PACKAGE_THINGINO_SOUNDS_STARTUP
	bool "Startup sound"
	default y
	help
	  Install the Thingino startup sound file.
	  This sound is played when the device boots up.

config BR2_PACKAGE_THINGINO_SOUNDS_CHIMES
	bool "Chime sounds"
	default y
	help
	  Install the Thingino chime sound files.

choice
	prompt "Sound file format"
	default BR2_PACKAGE_THINGINO_SOUNDS_FORMAT_OPUS
	help
	  Opus is smaller on-disk and higher quality, but needs timps'
	  TIMPS_PLAY_OPUS (opusfile+opus+libogg, ~200KB flash) to decode.
	  G.711 needs no extra library (timps' G.711 decoder is always
	  built in) at the cost of somewhat larger sound files - the
	  better choice on boards too flash-constrained for TIMPS_PLAY_OPUS.

config BR2_PACKAGE_THINGINO_SOUNDS_FORMAT_OPUS
	bool "Opus"

config BR2_PACKAGE_THINGINO_SOUNDS_FORMAT_G711
	bool "G.711 mu-law (WAV)"

endchoice

endif
```

## package/thingino-ssl/Config.in
```kconfig
config BR2_PACKAGE_THINGINO_SSL
	bool

choice
	prompt "SSL/TLS Library"
	default BR2_PACKAGE_THINGINO_SSL_MBEDTLS
	help
	  Select the SSL/TLS library for thingino.
	  Only one SSL/TLS library should be selected.

config BR2_PACKAGE_THINGINO_SSL_MBEDTLS
	bool "mbedTLS"
	select BR2_PACKAGE_THINGINO_MBEDTLS
	select BR2_PACKAGE_MBEDTLS_CERTGEN
	select BR2_PACKAGE_THINGINO_SSL
	help
	  Use mbedTLS for SSL/TLS support.
	  Lightweight, designed for embedded systems with HTTP/2 support.

	  https://tls.mbed.org/

config BR2_PACKAGE_THINGINO_SSL_WOLFSSL
	bool "wolfSSL"
	depends on BR2_TOOLCHAIN_HAS_THREADS
	select BR2_PACKAGE_THINGINO_WOLFSSL
	select BR2_PACKAGE_THINGINO_WOLFSSL_CERTGEN
	select BR2_PACKAGE_THINGINO_SSL
	help
	  Use wolfSSL for SSL/TLS support.
	  Fast, portable SSL/TLS library targeted at IoT and embedded systems.

	  https://www.wolfssl.com/

config BR2_PACKAGE_THINGINO_SSL_OPENSSL
	bool "OpenSSL"
	select BR2_PACKAGE_OPENSSL
	select BR2_PACKAGE_LIBOPENSSL
	select BR2_PACKAGE_LIBOPENSSL_BIN
	# Essential for HTTPS, RTSPS, RTMP, WPA2, etc. (not all are needed)
	select BR2_PACKAGE_LIBOPENSSL_ENABLE_CHACHA          # Modern cipher for TLS 1.3
	select BR2_PACKAGE_LIBOPENSSL_ENABLE_RC4             # RTMP + WPA2-TKIP
	select BR2_PACKAGE_LIBOPENSSL_ENABLE_MD4             # WPA2 support
	select BR2_PACKAGE_LIBOPENSSL_ENABLE_DES             # WPA2 support
	select BR2_PACKAGE_LIBOPENSSL_ENABLE_PSK             # WPA2-PSK
	select BR2_PACKAGE_LIBOPENSSL_ENABLE_IDEA            # May be needed
	select BR2_PACKAGE_LIBOPENSSL_ENABLE_SEED            # May be needed
	select BR2_PACKAGE_LIBOPENSSL_ENABLE_BLAKE2          # Modern hash
	select BR2_PACKAGE_LIBOPENSSL_ENABLE_SSL             # Essential for HTTPS
	select BR2_PACKAGE_LIBOPENSSL_ENABLE_ECX             # Modern elliptic curves
	select BR2_PACKAGE_LIBOPENSSL_ENABLE_ARGON2          # Modern password hashing
	select BR2_PACKAGE_THINGINO_SSL
	help
	  Use OpenSSL for SSL/TLS support.
	  Full-featured, widely compatible SSL/TLS library.

	  Obsolete and insecure algorithms (MD2, RC2, CAST, Blowfish,
	  SSLv3, weak SSL, etc.) are disabled by default; see the
	  thingino libopenssl override (package/thingino-libopenssl/).

	  https://www.openssl.org/

endchoice

comment "wolfSSL needs a toolchain w/ threads"
	depends on !BR2_TOOLCHAIN_HAS_THREADS

# SSL library package definitions (selectable only via the choice above)
if BR2_PACKAGE_THINGINO_SSL
source "$BR2_EXTERNAL_THINGINO_PATH/package/thingino-mbedtls/Config.in"
source "$BR2_EXTERNAL_THINGINO_PATH/package/thingino-wolfssl/Config.in"
endif
```

## package/thingino-system/Config.in
```kconfig
config BR2_PACKAGE_THINGINO_SYSTEM
	bool "thingino-system"
	help
	  Various utilities related to thingino system operations

config BR2_PACKAGE_THINGINO_SYSTEM_INGENIC
	default y
	bool "Ingenic platform utilities"
	depends on BR2_PACKAGE_THINGINO_SYSTEM && BR2_SOC_VENDOR_INGENIC
	help
	  soc, sensor, usb-role and S03mac, from files/ingenic/.

	  All four are tied to the silicon: soc and usb-role read Ingenic
	  registers through devmem, S03mac reads the serial-number registers
	  to derive a MAC, and sensor reads the /proc/jz tree the Ingenic
	  kernel modules create. On other silicon they report nothing useful,
	  and usb-role, which writes, would be actively wrong.

	  Another vendor supplies its own block rather than teaching these
	  to branch.

config BR2_PACKAGE_THINGINO_SYSTEM_USB_ROLE
	default y
	depends on BR2_PACKAGE_THINGINO_SYSTEM && BR2_PACKAGE_THINGINO_KOPT_DWC2_OTG
	bool "usb-role switcher"
	help
	  Enables on the fly USB role switching when using the ingenic DWC2 USB controller.

config BR2_PACKAGE_THINGINO_SYSTEM_ENTROPY_GENERATOR
	default y
	bool "entropy generator"
	depends on BR2_PACKAGE_THINGINO_SYSTEM && SOC_FAMILY = "t40"
	help
	  Enables the entropy service for the T40 SoC.

config BR2_PACKAGE_THINGINO_SYSTEM_AUTOMOUNT
	bool "block device automount"
	depends on BR2_PACKAGE_THINGINO_SYSTEM
	default y if BR2_THINGINO_SDCARD
	help
	  Install the mdev handler and boot-time scan that mount partitions below
	  /mnt. SD-card boards select this by default; SATA and USB-storage
	  appliances can enable it without pulling in the MMC kernel stack.

config BR2_PACKAGE_THINGINO_SYSTEM_SWAP
	bool "swap"
	depends on BR2_PACKAGE_THINGINO_SYSTEM
	help
	  Enables swap support.

config BR2_PACKAGE_THINGINO_SYSTEM_SENSOR_UTILS
	default y
	bool "sensor utilities"
	depends on BR2_PACKAGE_THINGINO_SYSTEM && BR2_THINGINO_DEV_CAMERA
	select BR2_PACKAGE_THINGINO_SENSOR_INFO if BR2_SOC_VENDOR_INGENIC
	help
	  Enables sensor utilities: /usr/sbin/sensor, which every vendor
	  supplies.

	  On Ingenic it also pulls in the sensor-info package, whose sinfo
	  probes the sensor I2C bus. That detector is Ingenic-only, so it
	  is not selected for other vendors, which supply their own
	  detection.
```

## package/thingino-uboot/Config.in
```kconfig
menu "Thingino U-Boot integration"

choice
	prompt "U-Boot version"
	default BR2_THINGINO_UBOOT_VERSION_2026_07
	help
	  Select the U-Boot version to build.

config BR2_THINGINO_UBOOT_VERSION_2026_07
	bool "2026.07 (buildroot)"

config BR2_THINGINO_UBOOT_VERSION_2013_07
	bool "2013.07 (ingenic)"

config BR2_THINGINO_UBOOT_VERSION_CUSTOM_FORK
	bool "gtxaspec/u-boot-ingenic (custom fork)"
endchoice

comment "Configure the base U-Boot package under Bootloaders"

config BR2_PACKAGE_THINGINO_UBOOT_SD_ENABLE
	bool

config BR2_PACKAGE_THINGINO_UBOOT_ETH_ENABLE
	bool

config BR2_PACKAGE_THINGINO_UBOOT_NETCONSOLE
	bool "Enable NetConsole (U-Boot console over UDP)"
	depends on BR2_PACKAGE_THINGINO_UBOOT_ETH_ENABLE || BR2_PACKAGE_THINGINO_KOPT_DWC2_OTG
	depends on !BR2_THINGINO_UBOOT_VERSION_2013_07
	help
	  Build the bootloader with NetConsole and redirect the console to
	  it (stdout/stderr/stdin = serial,nc) so U-Boot can be driven over
	  UDP on a camera whose serial port is not exposed. Also raises
	  bootdelay to 5s so the autoboot window can be interrupted over the
	  network.

	  Needs a wired network: U-Boot has no Wi-Fi driver. That is either
	  the on-chip MAC, or -- on a board with no wired Ethernet but a USB
	  OTG data port -- a USB-Ethernet dongle, for which the injected
	  preboot runs `usb start` before redirecting the console. The ASIX
	  host drivers are already in the isvp defconfigs, so nothing extra
	  is compiled.

	  The 2013.07 tree configures NetConsole through a patch instead and
	  is handled on the ciao branch, hence the version dependency here.

	  SECURITY: with ncip unset the board accepts console input from any
	  host on the L2 segment, so anyone on the subnet can interrupt boot
	  and reach an unauthenticated U-Boot prompt during the boot window.
	  Enable only on trusted networks, or pin a single client with
	  `fw_setenv ncip <host>`. Off by default; opt in per camera.

config BR2_PACKAGE_THINGINO_UBOOT_ENABLE_BAR
	bool "Enable SPI Flash BAR"
	help
	  Define this option to use the Bank addr/Extended addr
	  support on SPI NOR flash chips which have sizes > 16Mbytes.

config BR2_PACKAGE_THINGINO_UBOOT_PHY_RESET_AFTER_CONFIG
	bool "Reset PHY after being Configured"

config BR2_PACKAGE_THINGINO_UBOOT_GPIO_PHY_RESET
	int "GPIO to toggle for PHY Reset"
	default -1
	depends on BR2_PACKAGE_THINGINO_UBOOT_PHY_RESET_AFTER_CONFIG

config BR2_PACKAGE_THINGINO_UBOOT_GPIO_PHY_RESET_ENLEVEL
	int "0 for active low reset signal or 1 for active high"
	default 0
	depends on BR2_PACKAGE_THINGINO_UBOOT_PHY_RESET_AFTER_CONFIG

config BR2_PACKAGE_THINGINO_UBOOT_EXTERNAL_ENV_ENABLE
	bool "Enable ENV config from Buildroot"
	help
	  Enable this option to have Buildroot inject environment variables
	  into U-Boot based on the Buildroot configuration files for the
	  selected device. This allows device-specific boot parameters to
	  be managed through the Buildroot configuration system rather
	  than hardcoded in U-Boot.

menu "Boot Configuration"

config BR2_PACKAGE_THINGINO_UBOOT_ROOT
	string "Root device"
	help
	  Define the root device to be used during boot.

config BR2_PACKAGE_THINGINO_UBOOT_ROOTFSTYPE
	string "Root filesystem type"
	help
	  Specify the filesystem type for the root partition (e.g., ext4, squashfs).

config BR2_PACKAGE_THINGINO_UBOOT_INIT
	string "Init program"
	help
	  Define the init program to be executed (e.g., /sbin/init).

menu "Flash Controller Prefix"

choice
	prompt "Select Flash Controller Prefix"
	default BR2_PACKAGE_THINGINO_UBOOT_FLASH_CONTROLLER_JZ_SFC

config BR2_PACKAGE_THINGINO_UBOOT_FLASH_CONTROLLER_JZ_SFC
	bool "jz_sfc"

config BR2_PACKAGE_THINGINO_UBOOT_FLASH_CONTROLLER_SFC_NAND
	bool "sfc_nand"

config BR2_PACKAGE_THINGINO_UBOOT_FLASH_CONTROLLER_SFC0_NOR
	bool "sfc0_nor"

config BR2_PACKAGE_THINGINO_UBOOT_FLASH_CONTROLLER_SFC1_NOR
	bool "sfc1_nor"

config BR2_PACKAGE_THINGINO_UBOOT_FLASH_CONTROLLER_SFC0_NAND
	bool "sfc0_nand"

config BR2_PACKAGE_THINGINO_UBOOT_FLASH_CONTROLLER_SFC1_NAND
	bool "sfc1_nand"

config BR2_PACKAGE_THINGINO_UBOOT_FLASH_CONTROLLER_CUSTOM
	bool "Custom"
endchoice

config BR2_PACKAGE_THINGINO_UBOOT_FLASH_CONTROLLER_CUSTOM_STRING
	string "Custom Flash Controller Prefix"
	depends on BR2_PACKAGE_THINGINO_UBOOT_FLASH_CONTROLLER_CUSTOM
	help
	  Enter a custom string for the flash controller prefix.

endmenu


config BR2_PACKAGE_THINGINO_UBOOT_MTDPARTS
	string "MTD partition layout"
	help
	  Define the partition layout for MTD devices.

config BR2_PACKAGE_THINGINO_UBOOT_BOOTARGS
	string "Boot arguments"
	help
	  Define additional kernel command-line arguments.

config BR2_PACKAGE_THINGINO_UBOOT_BOOTCMD
	string "Boot command"
	help
	  Define the default boot command executed by U-Boot.

endmenu

endmenu
```

## package/thingino-userkeys/Config.in
```kconfig
config BR2_PACKAGE_THINGINO_USERKEYS
	bool "thingino-userkeys"
	depends on BR2_mips_xburst2
	depends on BR2_PACKAGE_THINGINO_KOPT_KEYS
	default y
	help
	  Out-of-tree gpio-userkeys.ko for XBurst2 (kernel 4.4): registers a
	  gpio-keys device from /etc/modules.d/gpio-userkeys (reset button
	  etc., generated from thingino.json gpio.button_reset), so
	  thingino-button gets an /dev/input/event* like on 3.10.
```

## package/thingino-vdb2-chime/Config.in
```kconfig
config BR2_PACKAGE_THINGINO_VDB2_CHIME
	bool "thingino-vdb2-chime"
	select BR2_PACKAGE_THINGINO_JCT
	help
	  Safe mechanical-chime controller for the Wyze Video Doorbell v2.

	  Reproduces the three-stage GPIO sequence used by the stock iCamera
	  application and checks its energy-ready input before energizing it.

	  This package is board-specific. Do not enable it for another camera
	  without first verifying its schematic or stock GPIO behavior.
```
