## package/thingino-dusk2dawn/Config.in
```kconfig
config BR2_PACKAGE_THINGINO_DUSK2DAWN
	bool "thingino-dusk2dawn"
	help
	  Installs userspace scripts and configuration files to control dusk2dawn
```

## package/thingino-esphome/Config.in
```kconfig
config BR2_PACKAGE_THINGINO_ESPHOME
	bool "thingino-esphome"
	depends on BR2_USE_MMU # meson
	depends on BR2_TOOLCHAIN_HAS_THREADS # dbus
	select BR2_THINGINO_LIBBLE if BR2_PACKAGE_THINGINO_BLUETOOTH
	help
	  ESPHome Linux service for Thingino cameras.

	  A lightweight TCP service implementing the ESPHome Native API,
	  allowing Thingino cameras to function as ESPHome devices
	  discoverable by Home Assistant.

	  Features:
	  - MediaPlayer plugin for audio playback via Home Assistant
	  - Bluetooth Proxy for BLE device scanning (optional, requires BR2_PACKAGE_THINGINO_BLUETOOTH)
	  - Auto-discovery via mDNS (_esphomelib._tcp)
	  - Plugin architecture for extensibility
	  - Native integration with Home Assistant

	  Optional features (enable via fragments):
	  - Bluetooth Proxy: Include BR2_PACKAGE_THINGINO_BLUETOOTH=y in camera defconfig
	    Requires BLE-capable hardware (ATBM6031x, SSV6158, etc.)

	  Recommended:
	  - mDNS service (mdnsd or avahi-daemon) for auto-discovery
	  - ingenic-audiodaemon for MediaPlayer functionality

	  https://github.com/yinzara/esphome-linux

if BR2_PACKAGE_THINGINO_ESPHOME

config BR2_PACKAGE_THINGINO_ESPHOME_WAKE_WORD
	bool "Wake word detection support"
	select BR2_PACKAGE_INGENIC_TFLITE_MICRO
	select BR2_PACKAGE_ESP_MICROSPEECH_FEATURES
	help
	  Enable on-device wake word detection using TensorFlow Lite Micro.

	  This allows the camera to listen for wake words (like "Thingino!")
	  and trigger voice assistant interactions with Home Assistant.

	  Requires:
	  - ingenic-tflite-micro (auto-selected)
	  - esp-microspeech-features (auto-selected)
	  - ingenic-audiodaemon for microphone input

endif

comment "thingino-esphome needs a toolchain w/ threads"
	depends on BR2_USE_MMU
	depends on !BR2_TOOLCHAIN_HAS_THREADS
```

## package/thingino-ethernet/Config.in
```kconfig
config BR2_PACKAGE_THINGINO_ETHERNET
	bool "thingino-ethernet"
	select BR2_PACKAGE_THINGINO_KOPT
	select BR2_PACKAGE_THINGINO_KOPT_JZ_MAC
#	select BR2_PACKAGE_THINGINO_KOPT_JZ_MAC_INTERNAL_PHY
#	select BR2_PACKAGE_THINGINO_KOPT_JZ_MAC_V12
#	select BR2_PACKAGE_THINGINO_KOPT_JZ_MAC_V13
	help
	  Enables support of Ethernet networking.
```

## package/thingino-ffmpeg/Config.in
```kconfig
menuconfig BR2_PACKAGE_THINGINO_FFMPEG
	bool "Thingino FFmpeg"
	help
	  Feature-reduced FFmpeg binary specifically configured
	  to perform recording on thingino devices.
	  FFmpeg is a complete, cross-platform solution to record,
	  convert and stream audio and video.
	  http://www.ffmpeg.org

if BR2_PACKAGE_THINGINO_FFMPEG

choice
	prompt "FFmpeg Configuration"
	default BR2_PACKAGE_THINGINO_FFMPEG_IPC
	help
	  Select the FFmpeg configuration variant.

config BR2_PACKAGE_THINGINO_FFMPEG_IPC
	bool "IPC (IP Camera)"
	help
	  Minimal configuration for IP camera use cases:
	  - RTSP streaming to MP4 recording
	  - H.264 video copy (no re-encoding)
	  - OPUS to AAC audio conversion
	  - Optimized for size and performance

config BR2_PACKAGE_THINGINO_FFMPEG_NVR
	bool "NVR (Network Video Recorder)"
	help
	  Extended configuration for NVR use cases:
	  - Multiple codec support (H.264, H.265, AAC, OPUS)
	  - Multiple container formats
	  - More protocols and features
	  - Larger binary but more functionality

config BR2_PACKAGE_THINGINO_FFMPEG_DEV
	bool "DEV (Development/Maximum Features)"
	help
	  Development configuration with maximum features enabled:
	  - All available codecs, formats, and protocols
	  - All filters and processing capabilities
	  - Hardware acceleration support where available
	  - Debugging and development tools
	  - Largest binary but maximum functionality
	  - Intended for development and testing purposes

endchoice

endif
```

## package/thingino-floodlightd/Config.in
```kconfig
config BR2_PACKAGE_THINGINO_FLOODLIGHTD
	bool "thingino-floodlightd"
	help
	  Userspace daemon for the Wyze Floodlight v2 (T41) CH554 MCU.

	  The floodlight white LEDs, the 3-zone PIR motion array and the
	  siren are managed by an external CH554 MCU on /dev/ttyS2.
	  floodlightd speaks the stock serial protocol: it reports PIR
	  motion (per zone) to a hook script and drives the floodlight
	  brightness in response to motion.

	  Requires UART2 (ttyS2) enabled in the device tree.

	  See docs/wyze-floodlightv2-mcu-protocol.md for the protocol.
```

## package/thingino-fonts/Config.in
```kconfig
config BR2_PACKAGE_THINGINO_FONTS
	bool "Thingino OSD fonts"
	help
	  OSD fonts for thingino
```

## package/thingino-freetype/Config.in
```kconfig
config BR2_PACKAGE_THINGINO_FREETYPE
	bool "freetype"
	select BR2_PACKAGE_FREETYPE
	help
	  a free, high-quality and portable font engine.

	  https://www.freetype.org/
```

## package/thingino-go/Config.in
```kconfig
config BR2_PACKAGE_THINGINO_GO
	bool "Go toolchain (shadow package)"
	default y if BR2_PACKAGE_GO2RTC
	select BR2_PACKAGE_HOST_GO
	help
	  Shadow package that forces Buildroot's host-go toolchain to be
	  rebuilt with the upstream 1.25.3 release, using a fresh stage4
	  bootstrap compiler so Go >= 1.24 based applications build
	  reliably.
```

## package/thingino-gpio/Config.in
```kconfig
config BR2_PACKAGE_THINGINO_GPIO
	bool "thingino-gpio"
	help
	  Installs userspace scripts and configuration files to control GPIOs
```

## package/thingino-httpd-ssl/Config.in
```kconfig
config BR2_PACKAGE_THINGINO_HTTPD_SSL
	bool "thingino-httpd-ssl"
	depends on BR2_PACKAGE_BUSYBOX
	depends on BR2_USE_MMU
	depends on BR2_PACKAGE_MBEDTLS || BR2_PACKAGE_THINGINO_MBEDTLS
	select BR2_PACKAGE_MBEDTLS_CERTGEN
	help
	  HTTPS wrapper for BusyBox httpd using mbedTLS.

	  This package provides a lightweight SSL/TLS wrapper that allows
	  BusyBox httpd to serve HTTPS traffic. It listens on port 443 and
	  forwards decrypted traffic to httpd running on localhost.

	  Features:
	  - Small footprint using mbedTLS
	  - Automatic certificate generation using mbedtls-certgen
	  - Compatible with BusyBox httpd
	  - Minimal configuration required

comment "thingino-httpd-ssl needs BusyBox with httpd enabled"
	depends on !BR2_PACKAGE_BUSYBOX

comment "thingino-httpd-ssl needs mbedTLS"
	depends on !BR2_PACKAGE_MBEDTLS && !BR2_PACKAGE_THINGINO_MBEDTLS
```

## package/thingino-ircut/Config.in
```kconfig
config BR2_PACKAGE_THINGINO_IRCUT
	bool "thingino-ircut"
	select BR2_PACKAGE_JSONPATH
	help
	  Installs userspace scripts and configuration files to control IRCUT
```

## package/thingino-jct/Config.in
```kconfig
config BR2_PACKAGE_THINGINO_JCT
	bool "thingino-jct"
	help
	  JSON Configuration CLI Tool

	  https://github.com/themactep/jct
```

## package/thingino-jct/Config.in.host
```kconfig
config BR2_PACKAGE_HOST_THINGINO_JCT
	bool "host thingino-jct"
	help
	  Host build of the JSON Configuration Tool (jct).
	  Provides the `jct` CLI on the build host for editing
	  Thingino configuration files or generating payloads
	  during development workflows.
```

## package/thingino-kopt/Config.in
```kconfig
menuconfig BR2_PACKAGE_THINGINO_KOPT
	bool "Kernel Options"
	help
	  Per device kernel customization support.
	  Items selected here will override the default kernel configuration.

config BR2_PACKAGE_THINGINO_KOPT_ADC
	bool "ADC"
	depends on BR2_PACKAGE_THINGINO_KOPT
	help
	  Enable ADC (Analog to Digital) support

config BR2_PACKAGE_THINGINO_KOPT_CIFS
	bool "CIFS"
	depends on BR2_PACKAGE_THINGINO_KOPT
	select BR2_PACKAGE_CIFS_UTILS
	help
	  Enable CIFS (SMB) networking support

config BR2_PACKAGE_THINGINO_KOPT_DEVELOP
	bool "Developer Options"
	depends on BR2_PACKAGE_THINGINO_KOPT
	help
	  Enables Kernel Options for Development/Debugging (Valgrind, GDB, ltrace, etc)

config BR2_PACKAGE_THINGINO_KOPT_GADGET_SERIAL
	bool "USB Gadget Serial"
	depends on BR2_PACKAGE_THINGINO_KOPT
	help
	  Enable USB Gadget serial support

config BR2_PACKAGE_THINGINO_KOPT_JZ_MAC
	bool "Ethernet Support"
	depends on BR2_PACKAGE_THINGINO_KOPT
	help
	  Enable native wired Ethernet support on the SoC.

if BR2_PACKAGE_THINGINO_KOPT_JZ_MAC

choice
	prompt "MAC Version"
	default BR2_PACKAGE_THINGINO_KOPT_JZ_MAC_V12

config BR2_PACKAGE_THINGINO_KOPT_JZ_MAC_V12
	bool "JZ_MAC V12"
	help
	  Enable the Ingenic ethernet V12 driver

config BR2_PACKAGE_THINGINO_KOPT_JZ_MAC_V13
	bool "JZ_MAC V13"
	help
	  Enable the Ingenic ethernet V13 driver
endchoice

choice
	prompt "MAC Clock Rate"
	depends on BR2_PACKAGE_THINGINO_KOPT_JZ_MAC_V13
	default BR2_PACKAGE_THINGINO_KOPT_JZ_MAC_CLK_50MHZ

config BR2_PACKAGE_THINGINO_KOPT_JZ_MAC_CLK_25MHZ
	bool "25 MHz"
	help
	  Select 25 MHz clock for internal PHY

config BR2_PACKAGE_THINGINO_KOPT_JZ_MAC_CLK_50MHZ
	bool "50 MHz"
	help
	  Select 50 MHz clock for external PHY
endchoice

config BR2_PACKAGE_THINGINO_KOPT_JZ_MAC_CLK_VALUE
	int
	default 25000000 if BR2_PACKAGE_THINGINO_KOPT_JZ_MAC_CLK_25MHZ
	default 50000000

endif

config BR2_PACKAGE_THINGINO_KOPT_JZ_MAC_INTERNAL_PHY
	bool "JZ_MAC Internal PHY"
	depends on BR2_PACKAGE_THINGINO_KOPT_JZ_MAC
	depends on BR2_PACKAGE_THINGINO_KOPT_JZ_MAC_V13 && BR2_SOC_FAMILY_INGENIC_T21
	help
	  Enable support for the Internal MAC PHY on the T21 SoC

config BR2_PACKAGE_THINGINO_KOPT_MMC
	bool "MMC Support"
	depends on BR2_PACKAGE_THINGINO_KOPT
	select BR2_PACKAGE_THINGINO_MMC
	help
	  Enable MMC support for SD/MMC and SDIO devices

config BR2_PACKAGE_THINGINO_KOPT_MMC0
	bool "Enable MMC0"
	depends on BR2_PACKAGE_THINGINO_KOPT_MMC
	help
	  Enables the MMC0 on the SoC, typically used for SD/MMC cards.

config BR2_PACKAGE_THINGINO_KOPT_MMC0_1BIT
	bool "MMC0 1-Bit"
	depends on BR2_PACKAGE_THINGINO_KOPT_MMC0 && (BR2_SOC_FAMILY_INGENIC_T23 || BR2_SOC_FAMILY_INGENIC_T31)
	help
	  Force 1 bit mode for MMC0 on T23 based SoCs

config BR2_PACKAGE_THINGINO_KOPT_MMC0_BOOT
	bool "Boot from MMC"
	depends on BR2_PACKAGE_THINGINO_KOPT_MMC0
	help
	  Enables booting the rootfs from an MMC card

if BR2_PACKAGE_THINGINO_KOPT_MMC0

choice
	prompt "MMC0 PB Mode"
	default BR2_PACKAGE_THINGINO_KOPT_MMC0_PB_4BIT

config BR2_PACKAGE_THINGINO_KOPT_MMC0_PB_4BIT
	bool "MMC0 PB 4-Bit"
	help
	  Enables 4-bit support for MMC0 on GPIO PB.

config BR2_PACKAGE_THINGINO_KOPT_MMC0_PB_8BIT
	bool "MMC0 PB 8-Bit"
	help
	  Enables 8-bit support for MMC0 on GPIO PB.

endchoice

endif

config BR2_PACKAGE_THINGINO_KOPT_MMC1
	bool "Enable MMC1"
	depends on BR2_PACKAGE_THINGINO_KOPT_MMC
	help
	  Enables the MMC1 on the SoC, typically used for SDIO WiFi modules.

if BR2_PACKAGE_THINGINO_KOPT_MMC1

choice
	prompt "MMC1 Mode Selection"
	default BR2_PACKAGE_THINGINO_KOPT_MMC1_PA_4BIT

config BR2_PACKAGE_THINGINO_KOPT_MMC1_PA_4BIT
	bool "MMC1 PA 4-Bit"
	help
	  Enables 4-bit support for MMC1 on GPIO PA.

config BR2_PACKAGE_THINGINO_KOPT_MMC1_PB_4BIT
	bool "MMC1 PB 4-Bit"
	help
	  Enables 4-bit support for MMC1 on GPIO PB.

config BR2_PACKAGE_THINGINO_KOPT_MMC1_PB_8BIT
	bool "MMC1 PB 8-Bit"
	help
	  Enables 8-bit support for MMC1 on GPIO PB.

config BR2_PACKAGE_THINGINO_KOPT_MMC1_PC_4BIT
	bool "MMC1 PC 4-Bit"
	depends on BR2_SOC_FAMILY_INGENIC_T10 || BR2_SOC_FAMILY_INGENIC_T20 || BR2_SOC_FAMILY_INGENIC_T21
	help
	  Enables 4-bit support for MMC1 on GPIO PC.

config BR2_PACKAGE_THINGINO_KOPT_MMC1_PD_4BIT
	bool "MMC1 PD 4-Bit"
	depends on BR2_SOC_FAMILY_INGENIC_T10 || BR2_SOC_FAMILY_INGENIC_T20
	help
	  Enables 4-bit support for MMC1 on GPIO PD.

endchoice

endif

config BR2_PACKAGE_THINGINO_KOPT_NETFILTER
	bool "Netfilter"
	depends on BR2_PACKAGE_THINGINO_KOPT
	help
	  Build necessary kernel modules and dependencies to enable netfilter/iptables support.

config BR2_PACKAGE_THINGINO_KOPT_PWM
	bool "PWM"
	depends on BR2_PACKAGE_THINGINO_KOPT
	help
	  Enable PWM (Pulse Width Modulation) support

config BR2_PACKAGE_THINGINO_KOPT_RTC
	bool "RTC"
	depends on BR2_PACKAGE_THINGINO_KOPT
	help
	  Enables RTC (Real Time Clock) support

config BR2_PACKAGE_THINGINO_KOPT_SPI1_PB2
	bool "SPI1 PB2"
	depends on BR2_PACKAGE_THINGINO_KOPT
	help
	  Enable SPI1 on PB_2

config BR2_PACKAGE_THINGINO_KOPT_UART
	bool "UART Support"
	depends on BR2_PACKAGE_THINGINO_KOPT
	help
	  Enables additional UART ports

config BR2_PACKAGE_THINGINO_KOPT_UART_UART0
	bool "UART0"
	depends on BR2_PACKAGE_THINGINO_KOPT_UART
	help
	  Enables UART0 on the SoC

config BR2_PACKAGE_THINGINO_KOPT_UART_UART2
	bool "UART2"
	depends on BR2_PACKAGE_THINGINO_KOPT_UART
	help
	  Enables UART2 on the SoC

config BR2_PACKAGE_THINGINO_KOPT_DWC2
	bool "USB Support"
	depends on BR2_PACKAGE_THINGINO_KOPT
	help
	  Enable the DWC2 USB driver

if BR2_PACKAGE_THINGINO_KOPT_DWC2

choice
	prompt "DWC2 USB Mode Selection"
	default BR2_PACKAGE_THINGINO_KOPT_DWC2_OTG

config BR2_PACKAGE_THINGINO_KOPT_DWC2_OTG
	bool "Full USB support with OTG"
	select BR2_PACKAGE_USBNET
	select BR2_PACKAGE_USBNET_CDC_ETHER
	select BR2_PACKAGE_USBNET_CDC_NCM
	select BR2_PACKAGE_USBNET_ASIX
	help
	  Enable the DWC2 USB driver with OTG support.
	  Recommended for devices that have USB data ports.

config BR2_PACKAGE_THINGINO_KOPT_DWC2_WIFI_ONLY
	bool "USB Wi-Fi Module Only"
	help
	  Enable the DWC2 USB driver with WiFi-only support.
	  Recommended for devices that use WiFi chipsets internally connected via USB.

endchoice

endif

config BR2_PACKAGE_THINGINO_KOPT_I2C
	bool "I2C Support"
	depends on BR2_PACKAGE_THINGINO_KOPT
	help
	  Enables additional I2C ports

config BR2_PACKAGE_THINGINO_KOPT_I2C_BUS1
	bool "I2C1"
	depends on BR2_PACKAGE_THINGINO_KOPT_I2C
	help
	  Enables I2C1 on the SoC

config BR2_PACKAGE_THINGINO_KOPT_I2C_BUS2
	bool "I2C2"
	depends on BR2_PACKAGE_THINGINO_KOPT_I2C
	help
	  Enables I2C2 on the SoC

config BR2_PACKAGE_THINGINO_KOPT_USB_MASS_STORAGE
	bool "USB Storage"
	depends on BR2_PACKAGE_THINGINO_KOPT
	help
	  Enables USB Mass Storage device class support.

config BR2_PACKAGE_THINGINO_KOPT_EXTFS
	bool "EXT2/EXT4 Filesystem Support"
	depends on BR2_PACKAGE_THINGINO_KOPT
	help
	  Enables EXT2 and EXT4 filesystem support with all dependencies.

config BR2_PACKAGE_THINGINO_KOPT_DMIC
	bool "I2S DMIC Support"
	depends on BR2_PACKAGE_THINGINO_KOPT
	help
	  Enables I2S DMIC (Digital Microphone) support.
```

## package/thingino-ledd/Config.in
```kconfig
config BR2_PACKAGE_THINGINO_LEDD
	bool "thingino-ledd"
	help
	  Minimal daemon to blink leds to indicate boot status
```

## package/thingino-libble/Config.in
```kconfig
config BR2_PACKAGE_THINGINO_LIBBLE
	bool "thingino-libble"
	# Auto-select the appropriate BLE backend based on WiFi chip
	select BR2_PACKAGE_THINGINO_NIMBLE if BR2_PACKAGE_WIFI_ATBM6012BX || BR2_PACKAGE_WIFI_ATBM6031X || BR2_PACKAGE_WIFI_ATBM6032X
	select BR2_PACKAGE_THINGINO_BLUEZ if !BR2_PACKAGE_WIFI_ATBM6012BX && !BR2_PACKAGE_WIFI_ATBM6031X && !BR2_PACKAGE_WIFI_ATBM6032X
	help
	  BLE library for C++ applications.
	  Automatically uses NimBLE for ATBM WiFi chips with BLE support,
	  or BlueZ for other systems.
```
