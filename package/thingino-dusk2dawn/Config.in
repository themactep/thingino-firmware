## package/thingino-libcurl/Config.in
```kconfig
config BR2_PACKAGE_THINGINO_LIBCURL
	bool "thingino-libcurl"
	help
	  cURL is a tool for getting files from FTP, HTTP, Gopher,
	  Telnet, and Dict servers, using any of the supported
	  protocols.

	  https://curl.se/

if BR2_PACKAGE_THINGINO_LIBCURL

config BR2_PACKAGE_THINGINO_LIBCURL_CURL
	bool "curl binary"
	help
	  Install curl binary as well

config BR2_PACKAGE_THINGINO_LIBCURL_VERBOSE
	bool "verbose strings"
	help
	  Enable verbose text strings

config BR2_PACKAGE_THINGINO_LIBCURL_PROXY_SUPPORT
	bool "proxy support"
	default y
	help
	  Enable proxy support.

config BR2_PACKAGE_THINGINO_LIBCURL_COOKIES_SUPPORT
	bool "cookies support"
	default y
	help
	  Enable support for cookies.

config BR2_PACKAGE_THINGINO_LIBCURL_WEBSOCKETS_SUPPORT
	bool "websockets support"
	help
	  Enable support for websockets.

config BR2_PACKAGE_THINGINO_LIBCURL_DICT_SUPPORT
	bool "dict support"
	help
	  Enable support for dict.

config BR2_PACKAGE_THINGINO_LIBCURL_GOPHER_SUPPORT
	bool "Gopher support"
	help
	  Enable support for Gopher.

config BR2_PACKAGE_THINGINO_LIBCURL_IMAP_SUPPORT
	bool "IMAP support"
	help
	  Enable support for IMAP.

config BR2_PACKAGE_THINGINO_LIBCURL_LDAP_SUPPORT
	bool "LDAP support"
	help
	  Enable support for LDAP.

config BR2_PACKAGE_THINGINO_LIBCURL_LDAPS_SUPPORT
	bool "LDAPS support"
	help
	  Enable support for LDAPS.

config BR2_PACKAGE_THINGINO_LIBCURL_POP3_SUPPORT
	bool "POP3 support"
	help
	  Enable support for POP3.

config BR2_PACKAGE_THINGINO_LIBCURL_RTSP_SUPPORT
	bool "RTSP support"
	help
	  Enable support for RTSP.

config BR2_PACKAGE_THINGINO_LIBCURL_SMB_SUPPORT
	bool "SMB/CIFS support"
	help
	  Enable support for SMB/CIFS.

config BR2_PACKAGE_THINGINO_LIBCURL_SMTP_SUPPORT
	bool "SMTP support"
	help
	  Enable support for SMTP.

config BR2_PACKAGE_THINGINO_LIBCURL_TELNET_SUPPORT
	bool "Telnet support"
	help
	  Enable support for telnet.

config BR2_PACKAGE_THINGINO_LIBCURL_TFTP_SUPPORT
	bool "TFTP support"
	help
	  Enable support for TFTP.

# Packages must select that if they require a SSL/TLS-enabled libcurl.
# Those packages must also select one crypto package that can be used
# as a backend below.
config BR2_PACKAGE_THINGINO_LIBCURL_FORCE_TLS
	bool

choice
	prompt "SSL/TLS library to use"

config BR2_PACKAGE_THINGINO_LIBCURL_OPENSSL
	bool "OpenSSL"
	depends on BR2_PACKAGE_OPENSSL

config BR2_PACKAGE_THINGINO_LIBCURL_BEARSSL
	bool "BearSSL"
	depends on BR2_PACKAGE_BEARSSL

config BR2_PACKAGE_THINGINO_LIBCURL_GNUTLS
	bool "GnuTLS"
	depends on BR2_PACKAGE_GNUTLS

config BR2_PACKAGE_THINGINO_LIBCURL_MBEDTLS
	bool "mbed TLS"
	depends on BR2_PACKAGE_MBEDTLS

config BR2_PACKAGE_THINGINO_LIBCURL_WOLFSSL
	bool "WolfSSL"
	depends on BR2_PACKAGE_THINGINO_WOLFSSL
	depends on !BR2_STATIC_LIBS # wolfssl-all
	select BR2_PACKAGE_THINGINO_WOLFSSL_CURL

comment "WolfSSL needs a toolchain w/ dynamic library"
	depends on BR2_PACKAGE_THINGINO_WOLFSSL
	depends on BR2_STATIC_LIBS

config BR2_PACKAGE_THINGINO_LIBCURL_TLS_NONE
	bool "None"
	depends on !BR2_PACKAGE_THINGINO_LIBCURL_FORCE_TLS

endchoice

endif
```

## package/thingino-libubox/Config.in
```kconfig
config BR2_PACKAGE_THINGINO_LIBUBOX
	bool "thingino-libubox"
	depends on !BR2_STATIC_LIBS
	depends on BR2_TOOLCHAIN_HAS_SYNC_4
	select BR2_PACKAGE_THINGINO_JCT
	help
	  Thingino-managed libubox package wired to thingino-jct for
	  json-c compatibility.

	  This package provides the OpenWrt libubox libraries and
	  blobmsg/json helpers from the external tree.
```

## package/thingino-libwebsockets/Config.in
```kconfig
config BR2_PACKAGE_THINGINO_LIBWEBSOCKETS
	bool
	select BR2_PACKAGE_LIBWEBSOCKETS
	select BR2_PACKAGE_ZLIB
```

## package/thingino-live555/Config.in
```kconfig
config BR2_PACKAGE_THINGINO_LIVE555
	bool "LIVE555 Streaming Media Platform"
	depends on BR2_INSTALL_LIBSTDCPP
	select BR2_PACKAGE_LIVE555
	help
	  LIVE555 Streaming Media forms a set of C++ libraries for
	  multimedia streaming, using open standard protocols
	  (RTP/RTCP, RTSP, SIP).
	  http://www.live555.com/liveMedia/

comment "live555 needs a toolchain w/ C++"
	depends on !BR2_INSTALL_LIBSTDCPP

config THINGINO_LIVE555_USE_OPENRTSP
	bool "openrtsp"
	help
	  Install openRTSP app
```

## package/thingino-logo/Config.in
```kconfig
config BR2_PACKAGE_THINGINO_LOGO
	bool "thingino-logo"
	help
	  Thingino logo BGRA bitmaps for OSD overlay.
	  Installs to /usr/share/images/.
```

## package/thingino-mbedtls/Config.in
```kconfig
config BR2_PACKAGE_THINGINO_MBEDTLS
	bool "thingino-mbedtls"
	depends on !BR2_PACKAGE_MBEDTLS
	help
	  Thingino enhanced mbed TLS with WebRTC DTLS compatibility.
	  Based on mbed TLS (formerly known as PolarSSL) with additional
	  cipher suites and configurations optimized for embedded WebRTC
	  applications.

	  This shadow package provides enhanced DTLS support for WebRTC
	  while maintaining the lightweight footprint needed for embedded
	  systems.

	  https://tls.mbed.org/

if BR2_PACKAGE_THINGINO_MBEDTLS

config BR2_PACKAGE_THINGINO_MBEDTLS_PROGRAMS
	bool "mbedtls programs"
	depends on BR2_USE_MMU # fork()
	help
	  This option enables the installation and the build of
	  mbed TLS companion programs.

config BR2_PACKAGE_THINGINO_MBEDTLS_COMPRESSION
	bool "enable compression support"
	select BR2_PACKAGE_ZLIB
	help
	  Enable support for compression of the content data before it
	  enters the secure channel as described in RFC 3749.

	  Warning: TLS compression may make you vulnerable to the
	  CRIME attack. You should not enable it unless you know for
	  sure CRIME and similar attacks are not applicable to your
	  particular situation.

config BR2_PACKAGE_THINGINO_MBEDTLS_DTLS_SRTP
	bool "enable DTLS-SRTP support"
	default y
	help
	  Enable support for negotiation of DTLS-SRTP (RFC 5764)
	  through the use_srtp extension.

config BR2_PACKAGE_THINGINO_MBEDTLS_WEBRTC_DTLS
	bool "enable WebRTC DTLS compatibility"
	default y
	select BR2_PACKAGE_THINGINO_MBEDTLS_DTLS_SRTP
	help
	  Enable enhanced cipher suite support for WebRTC DTLS compatibility.
	  This includes RSA key exchange, additional hash algorithms, and
	  broader cipher suite support for better browser compatibility.
	  Note: This increases binary size but improves WebRTC interoperability.

endif

comment "thingino-mbedtls conflicts with mbedtls"
	depends on BR2_PACKAGE_MBEDTLS
```

## package/thingino-mmc/Config.in
```kconfig
config BR2_PACKAGE_THINGINO_MMC
	bool "thingino-mmc"
	help
	  Enables MMC (Multi Media Card) and SDIO platform support package
```

## package/thingino-mosquitto-212/Config.in.host
```kconfig
config BR2_PACKAGE_HOST_THINGINO_MOSQUITTO_212
	bool "host mosquitto (mosquitto_passwd)"
	select BR2_PACKAGE_HOST_MOSQUITTO
	help
	  Wrapper to pull in the upstream host mosquitto_passwd tool.
```

## package/thingino-mosquitto/Config.in
```kconfig
config BR2_PACKAGE_THINGINO_MOSQUITTO
	bool "mosquitto"
	select BR2_PACKAGE_MOSQUITTO
	help
	  Eclipse Mosquitto is an open source (EPL/EDL licensed) message
	  broker that implements the MQTT protocol versions 5.0, 3.1.1
	  and 3.1. Mosquitto is lightweight and is suitable for use on
	  all devices from low power single board computers to full
	  servers.

	  The MQTT protocol provides a lightweight method of carrying
	  out messaging using a publish/subscribe model. This makes it
	  suitable for Internet of Things messaging such as with low
	  power sensors or mobile devices such as phones,
	  embedded computers or microcontrollers.

	  The Mosquitto project also provides a C library for
	  implementing MQTT clients, and the very popular mosquitto_pub
	  and mosquitto_sub command line MQTT clients.

	  https://mosquitto.org/

config BR2_PACKAGE_THINGINO_MOSQUITTO_USE_MBEDTLS
	bool "use mbedTLS backend"
	depends on BR2_PACKAGE_THINGINO_MOSQUITTO
	default y if !BR2_PACKAGE_OPENSSL
	help
	  Build mosquitto with mbedTLS backend support. This option is only
	  enabled by default when OpenSSL is not available.

config BR2_PACKAGE_THINGINO_MOSQUITTO_LIBWEBSOCKETS
	bool "mosquitto-libwebsockets"
	depends on BR2_PACKAGE_THINGINO_MOSQUITTO
	select BR2_PACKAGE_LIBWEBSOCKETS
	select BR2_PACKAGE_THINGINO_LIBWEBSOCKETS
	help
	  Add support of websockets.

config BR2_PACKAGE_THINGINO_MOSQUITTO_BROKER
	bool "install the mosquitto broker"
	depends on BR2_USE_MMU # fork()
	depends on !BR2_STATIC_LIBS # include <dlfcn.h>
	depends on BR2_PACKAGE_THINGINO_MOSQUITTO
	select BR2_PACKAGE_MOSQUITTO_BROKER
	select BR2_PACKAGE_LIBWEBSOCKETS_EXT_POLL if BR2_PACKAGE_LIBWEBSOCKETS
	help
	  Build and install the mosquitto broker onto target.

config BR2_PACKAGE_THINGINO_MOSQUITTO_BROKER_DYNAMIC_SECURITY_PLUGIN
	bool "dynamic security plugin"
	depends on BR2_PACKAGE_THINGINO_MOSQUITTO_BROKER
	select BR2_PACKAGE_MOSQUITTO_BROKER_DYNAMIC_SECURITY_PLUGIN
	select BR2_PACKAGE_CJSON
	select BR2_PACKAGE_OPENSSL
	help
	  Build and install the dynamic security plugin for
	  mosquitto broker onto target.

comment "mosquitto broker needs a toolchain w/ dynamic library"
	depends on BR2_USE_MMU
	depends on BR2_STATIC_LIBS
	depends on BR2_PACKAGE_THINGINO_MOSQUITTO
```
