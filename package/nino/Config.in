## package/nino/Config.in
```kconfig
config BR2_PACKAGE_NINO
	bool "nino"
	help
	  Nino is a tiny, cross-platform, emacs-like terminal text editor
	  written in C, with UTF-8 support.

	  https://github.com/evanlin96069/nino
```

## package/onvif-simple-server/Config.in
```kconfig
config BR2_PACKAGE_ONVIF_SIMPLE_SERVER
	bool "ONVIF Simple Server"
	select BR2_PACKAGE_JSON_C
	select BR2_PACKAGE_LIBTOMCRYPT if !BR2_PACKAGE_MBEDTLS && !BR2_PACKAGE_THINGINO_WOLFSSL
	select BR2_PACKAGE_THINGINO_WOLFSSL_ASN if BR2_PACKAGE_THINGINO_WOLFSSL
	select BR2_PACKAGE_THINGINO_WOLFSSL_BASE64ENCODE if BR2_PACKAGE_THINGINO_WOLFSSL
	select BR2_PACKAGE_THINGINO_WOLFSSL_CODING if BR2_PACKAGE_THINGINO_WOLFSSL
	help
	  Thingino fork of roleoroleo's onvif_simple_server.
	  A light C implementation of an onvif server intended for use in resource-constrained devices.

	  https://github.com/themactep/thingino-onvif

config BR2_PACKAGE_ONVIF_SIMPLE_SERVER_ZLIB
	bool "Use ZLIB for templates"
	depends on BR2_PACKAGE_ONVIF_SIMPLE_SERVER
	select BR2_PACKAGE_ZLIB
	help
	  Enable support for compressed template files (.gz).
```

## package/plog/Config.in
```kconfig
config BR2_PACKAGE_PLOG
	bool "plog"
	help
	  Portable C++ logging library (header-only).

	  https://github.com/SergiusTheBest/plog
```

## package/prudynt-t-legacy/Config.in
```kconfig
config BR2_PACKAGE_PRUDYNT_T_LEGACY
	bool "Prudynt-T streamer (legacy)"
	depends on !BR2_SOC_FAMILY_INGENIC_A1
	select BR2_PACKAGE_FAAC
	select BR2_PACKAGE_INGENIC_LIB
	select BR2_PACKAGE_INGENIC_MUSL if BR2_TOOLCHAIN_USES_MUSL
	select BR2_PACKAGE_INGENIC_LIBIMP_CONTROL
	select BR2_PACKAGE_LIBCONFIG
	select BR2_PACKAGE_THINGINO_LIVE555
	select BR2_PACKAGE_THINGINO_FREETYPE
	select BR2_PACKAGE_THINGINO_FONTS
	select BR2_PACKAGE_THINGINO_OPUS
	select BR2_PACKAGE_LIBHELIX_AAC
	help
	  Video streamer for Ingenic T-series.
	  Legacy version.

	  https://github.com/gtxaspec/prudynt-t
```

## package/prudynt_t/Config.in
```kconfig
config BR2_PACKAGE_PRUDYNT_T
        bool "prudynt-t for thingino"
        select BR2_PACKAGE_INGENIC_LIBIMP_CONTROL
        select BR2_PACKAGE_LIBCONFIG
        select BR2_PACKAGE_THINGINO_LIVE555
        select BR2_PACKAGE_THINGINO_FONTS
        help
                Experimental streamer
```

## package/prudynt_v3/Config.in
```kconfig
config BR2_PACKAGE_PRUDYNT_V3
	bool "prudynt for t31"
	default n
	help
		Experimental port
```

## package/pryntu/Config.in
```kconfig
config BR2_PACKAGE_PRYNTU
	bool "pryntu"
	depends on BR2_PACKAGE_THINGINO_STREAMER_PRYNTU
	help
	  Pryntu is a clean-room modular camera streaming daemon.

if BR2_PACKAGE_PRYNTU

config BR2_PACKAGE_PRYNTU_CONTROL_API
	bool "Enable local HTTP control API"
	default y
	help
	  Enables the local HTTP admin API and `pryntuctl` utility.

config BR2_PACKAGE_PRYNTU_FIFO_COMPAT
	bool "Enable FIFO privacy compatibility"
	default y
	help
	  Enables PRIVACY command compatibility via `/run/pryntu/video_ctrl`.

endif
```

## package/raptor-ipc/Config.in
```kconfig
config BR2_PACKAGE_RAPTOR_IPC
	bool "Raptor streamer"
	select BR2_PACKAGE_GO2RTC
	select BR2_PACKAGE_INGENIC_LIBIMP_CONTROL
	help
	  Raptor, an innovative and open-source platform designed for modular, multi-platform IP camera streaming.
	  https://github.com/gtxaspec/raptor
```

## package/scriba/Config.in.host
```kconfig
config BR2_PACKAGE_HOST_SCRIBA
	bool "scriba for host"
	help
	  Flash chip programmer CLI for CH341A and EZP2019/2023 USB programmers.
	  Reads, writes, erases, and verifies SPI NOR, SPI NAND, and EEPROM chips.
	  Used by 'make scriba'.

	  https://github.com/themactep/scriba
```

## package/spi-tmi8152/Config.in
```kconfig
config BR2_PACKAGE_SPI_TMI8152
	bool "TMI8152 driver"
	select BR2_LINUX_KERNEL
	help
	  TMI8152 experimental driver
```

## package/subzeroclaw/Config.in
```kconfig
config BR2_PACKAGE_SUBZEROCLAW
	bool "subzeroclaw"
	select BR2_PACKAGE_CJSON
	select BR2_PACKAGE_THINGINO_LIBCURL
	help
	  SubZeroClaw is a skill-driven agentic runtime for edge hardware.
	  ~380 lines of C. Reads a skill (Markdown), calls an LLM, executes
	  shell commands, loops until done.

	  Configure via ~/.subzeroclaw/config and drop skill .md files in
	  ~/.subzeroclaw/skills/.

	  https://github.com/jmlago/subzeroclaw
```

## package/telegrambot/Config.in
```kconfig
config BR2_PACKAGE_TELEGRAMBOT
	bool "telegrambot"
	select BR2_PACKAGE_THINGINO_JCT
	select BR2_PACKAGE_THINGINO_LIBCURL
	select BR2_PACKAGE_THINGINO_WEBUI
	help
	  Minimal Telegram bot daemon in C for embedded systems.
```

## package/thingino-addons/Config.in
```kconfig
config BR2_PACKAGE_THINGINO_ADDONS
	bool "Thingino add-ons"
	help
	  Kernel modules, programs, and scripts to make your device better!

config BR2_PACKAGE_THINGINO_ADDONS_NETFILTER
	bool "Netfilter"
	depends on BR2_PACKAGE_THINGINO_ADDONS
	help
	  Build necessary kernel modules and dependencies to enable netfilter/iptables support.
```

## package/thingino-agent/Config.in
```kconfig
config BR2_PACKAGE_THINGINO_AGENT
	bool "thingino-agent"
	depends on BR2_PACKAGE_MBEDTLS || BR2_PACKAGE_THINGINO_MBEDTLS
	select BR2_PACKAGE_THINGINO_CORE
	select BR2_PACKAGE_THINGINO_JCT
	select BR2_PACKAGE_MBEDTLS_CERTGEN
	help
	  Standalone Thingino camera-agent groundwork.

	  Installs a local camera-agent core (`thingino-agentctl`) plus thin
	  backend adapters. The external API remains agent-owned; streamer-
	  specific glue stays behind adapter scripts.

	  The first shipped backend adapter targets prudynt, but the package
	  layout is backend-neutral and keeps the northbound API independent
	  from any particular streamer process.

	  The current lifecycle path runs a native local listener for non-TLS
	  mode and uses an in-package mbedTLS proxy for HTTPS exposure.

comment "thingino-agent needs mbedTLS"
	depends on !BR2_PACKAGE_MBEDTLS && !BR2_PACKAGE_THINGINO_MBEDTLS
```

## package/thingino-ap/Config.in
```kconfig
config BR2_PACKAGE_THINGINO_AP
	bool "thingino-ap"
	select BR2_PACKAGE_WPA_SUPPLICANT_AP_SUPPORT
	help
	  Local camera access via WiFi AP
```

## package/thingino-bluetooth/Config.in
```kconfig
config BR2_PACKAGE_THINGINO_BLUETOOTH
	bool "thingino-bluetooth"
	select BR2_PACKAGE_THINGINO_LIBBLE
	help
	  Thingino package that enables Bluetooth low energy support within the Thingino build system.
	  This package also provides Bluetooth provisioning capabilities via the Improv Wifi protocol. See www.improv-wifi.com
	  To enable BLE provisioning set the BR2_PACKAGE_THINGINO_BLUETOOTH_PROVISIONING=y in your device defconfig


config BR2_PACKAGE_THINGINO_BLUETOOTH_PROVISIONING
	bool "Improv-wifi bluetooth provisioning"
	help
	  This config option enable bluetooth provisioning with the Improv Wifi protocol. Must be accompanied with BR2_PACKAGE_THINGINO_BLUETOOTH
```

## package/thingino-bluez/Config.in
```kconfig
config BR2_PACKAGE_THINGINO_BLUEZ
	bool "thingino-bluez"
	help
	  BlueZ compilation of bluetooth/bluetooth.h library for use with thingino-libble
```

## package/thingino-button/Config.in
```kconfig
config BR2_PACKAGE_THINGINO_BUTTON
	bool "thingino-button"
	depends on BR2_USE_MMU # fork()
	help
		Minimal daemon to monitor and execute commands vis button events
```

## package/thingino-cloner/Config.in
```kconfig
config BR2_PACKAGE_HOST_THINGINO_CLONER
	bool "host thingino-cloner"
	help
	  USB flashing tool for Ingenic SoC devices.
	  Bootstraps a device over USB, then reads or writes SPI NOR flash.
	  Used by 'make cloner'.

	  https://github.com/gtxaspec/thingino-cloner
```

## package/thingino-core/Config.in
```kconfig
config BR2_PACKAGE_THINGINO_CORE
	bool "thingino-core"
	help
	  Core system setup tasks for Thingino firmware, including
	  generating /etc/thingino.json from layered configuration sources.
```

## package/thingino-daynight/Config.in
```kconfig
config BR2_PACKAGE_THINGINO_DAYNIGHT
	bool "thingino-daynight"
	help
	  Installs userspace scripts and configuration files for day/night
	  switching, IRCUT control, IR LED control, and sun-based automation.
```

## package/thingino-daynightd/Config.in
```kconfig
config BR2_PACKAGE_THINGINO_DAYNIGHTD
	bool "thingino-daynightd"
	help
	  Day/Night photosensing daemon — single source of truth
	  for automatic day/night mode switching on Thingino.
	  
	  Reads ISP sensor data from /proc/jz/isp/, runs a
	  hysteresis-based algorithm, applies mode changes via
	  /sbin/daynight, and exports live telemetry to
	  /run/thingino/ for all consumers.

if BR2_PACKAGE_THINGINO_DAYNIGHTD

config BR2_PACKAGE_THINGINO_DAYNIGHTD_AUTOSTART
	bool "Auto-start at boot"
	default y
	help
	  Automatically start daynightd at boot (priority S10,
	  before streamer and web UI).

endif
```

## package/thingino-developer/Config.in
```kconfig
config BR2_PACKAGE_THINGINO_DEVELOPER
	bool "thingino-developer"
	help
	  Enable developer options for Thingino.

#config BR2_LINUX_KERNEL_CONFIG_FRAGMENT_FILES
#	string
#	default "package/thingino-developer/thingino-developer.fragment" if BR2_PACKAGE_THINGINO_DEVELOPER
```

## package/thingino-devscripts/Config.in
```kconfig
config BR2_PACKAGE_THINGINO_DEVSCRIPTS
	bool "thingino-devscripts"
	help
	  Miscelaneous development scripts to run on the camera side.
```

## package/thingino-diag/Config.in
```kconfig
config BR2_PACKAGE_THINGINO_DIAG
	bool "thingino-diag"
	help
	  Installs userspace diagnostic utilities
```
