## package/thingino-uhttpd/Config.in
```kconfig
config BR2_PACKAGE_THINGINO_UHTTPD
	bool "thingino-uhttpd"
	depends on !BR2_STATIC_LIBS # dlopen(), ustream-ssl
	depends on BR2_TOOLCHAIN_HAS_SYNC_4 # json-c
	depends on BR2_USE_MMU # fork()
	depends on !BR2_PACKAGE_UHTTPD # conflicts with buildroot uhttpd

	select BR2_PACKAGE_LIBUBOX
	select BR2_PACKAGE_JSON_C
	select BR2_PACKAGE_LIBXCRYPT if BR2_TOOLCHAIN_USES_GLIBC
	help
	  uHTTPd web server with HTTPS support and optional Lua scripting.
	  Provides a secure, modern web server for thingino cameras with
	  TLS/SSL encryption, session management, and extensible Lua-based
	  web applications. Can be used standalone or with thingino-webui-lua
	  for a complete modern web interface.

	  Features:
	  - Native HTTPS support with wolfSSL or mbedTLS encryption
	  - Lua scripting for dynamic web applications
	  - Session-based authentication and security
	  - Automatic HTTP to HTTPS redirection
	  - RESTful API endpoints for automation
	  - Modern responsive web interface support

	  Can be used standalone as a web server or with thingino-webui-lua
	  for a complete modern camera management interface.

	  https://wiki.openwrt.org/doc/howto/http.uhttpd

if BR2_PACKAGE_THINGINO_UHTTPD

config BR2_PACKAGE_THINGINO_UHTTPD_TLS
	bool "Enable TLS/HTTPS support"
	default y
	help
	  Enable TLS/HTTPS support for uhttpd.
	  This provides secure encrypted connections to the camera's
	  web interface with modern TLS protocols.

if BR2_PACKAGE_THINGINO_UHTTPD_TLS

choice
	prompt "SSL/TLS library to use"
	default BR2_PACKAGE_THINGINO_UHTTPD_TLS_MBEDTLS if BR2_PACKAGE_THINGINO_MBEDTLS
	default BR2_PACKAGE_THINGINO_UHTTPD_TLS_WOLFSSL if BR2_PACKAGE_THINGINO_WOLFSSL

config BR2_PACKAGE_THINGINO_UHTTPD_TLS_MBEDTLS
	bool "mbedTLS"
	depends on BR2_PACKAGE_MBEDTLS
	help
	  Use thingino mbedTLS for TLS support.
	  Enhanced mbedTLS with WebRTC DTLS compatibility.

config BR2_PACKAGE_THINGINO_UHTTPD_TLS_OPENSSL
	bool "OpenSSL"
	depends on BR2_PACKAGE_OPENSSL
	help
	  Use OpenSSL for TLS support.

config BR2_PACKAGE_THINGINO_UHTTPD_TLS_WOLFSSL
	bool "wolfSSL"
	depends on BR2_PACKAGE_THINGINO_WOLFSSL
	depends on BR2_USE_WCHAR
	select BR2_PACKAGE_THINGINO_USTREAM_SSL_WOLFSSL
	select BR2_PACKAGE_THINGINO_WOLFSSL_ALL
	select BR2_PACKAGE_THINGINO_WOLFSSL_EXAMPLES
	select BR2_PACKAGE_THINGINO_WOLFSSL_KEYGEN
	select BR2_PACKAGE_THINGINO_WOLFSSL_CERTGEN
	select BR2_PACKAGE_THINGINO_WOLFSSL_ASN
	help
	  Use thingino wolfSSL for TLS support.
	  Includes wolfSSL tools for certificate generation.

endchoice

comment "mbedTLS not available"
	depends on !BR2_PACKAGE_THINGINO_MBEDTLS

comment "wolfSSL not available (needs wchar support)"
	depends on BR2_PACKAGE_THINGINO_WOLFSSL && !BR2_USE_WCHAR

comment "wolfSSL not available"
	depends on !BR2_PACKAGE_THINGINO_WOLFSSL

endif

config BR2_PACKAGE_THINGINO_UHTTPD_HTTP_REDIRECT
	bool "Redirect HTTP to HTTPS"
	default y
	depends on BR2_PACKAGE_THINGINO_UHTTPD_TLS
	help
	  Automatically redirect HTTP requests on port 80 to HTTPS
	  on port 443 for enhanced security.

config BR2_PACKAGE_THINGINO_UHTTPD_LUA
	bool "Enable Lua support"
	depends on BR2_PACKAGE_LUA
	help
	  Enable Lua scripting support in uhttpd for dynamic content
	  generation and server-side scripting. This is useful for
	  implementing session-based authentication and other
	  advanced web functionality.

config BR2_PACKAGE_THINGINO_UHTTPD_UBUS
	bool "Enable ubus support"
	depends on BR2_PACKAGE_UBUS
	help
	  Enable ubus support for inter-process communication
	  with other system services.

endif

comment "thingino-uhttpd needs a toolchain w/ dynamic library"
	depends on BR2_TOOLCHAIN_HAS_SYNC_4
	depends on BR2_USE_MMU
	depends on BR2_STATIC_LIBS

comment "thingino-uhttpd conflicts with uhttpd"
	depends on BR2_PACKAGE_UHTTPD
```

## package/thingino-ustream-ssl/Config.in
```kconfig
config BR2_PACKAGE_THINGINO_USTREAM_SSL
	bool "thingino-ustream-ssl"
	depends on BR2_USE_WCHAR
	depends on !BR2_PACKAGE_USTREAM_SSL
	depends on BR2_PACKAGE_THINGINO_WOLFSSL
	select BR2_PACKAGE_LIBUBOX
	select BR2_PACKAGE_THINGINO_WOLFSSL_ALL
	select BR2_PACKAGE_THINGINO_WOLFSSL_ASN
	help
	  A small SSL library that can be used to provide SSL/TLS
	  support to ustream. This version uses wolfSSL as the
	  SSL backend for optimal embedded performance.

	  https://git.openwrt.org/project/ustream-ssl.git

config BR2_PACKAGE_THINGINO_USTREAM_SSL_WOLFSSL
	bool
	default y if BR2_PACKAGE_THINGINO_USTREAM_SSL

comment "thingino-ustream-ssl needs a toolchain w/ wchar"
	depends on !BR2_USE_WCHAR

comment "thingino-ustream-ssl conflicts with ustream-ssl"
	depends on BR2_PACKAGE_USTREAM_SSL
```

## package/thingino-v4l2loopback/Config.in
```kconfig
config BR2_PACKAGE_THINGINO_V4L2LOOPBACK
	bool "v4l2loopback"
	select BR2_PACKAGE_V4L2LOOPBACK
	depends on BR2_LINUX_KERNEL
	help
	  This module allows you to create "virtual video devices".
	  Normal (v4l2) applications will read these devices as if
	  they were ordinary video devices, but the video will not be
	  read from e.g. a capture card but instead it is generated by
	  another application.

	  https://github.com/umlaeute/v4l2loopback

comment "v4l2loopback needs a Linux kernel to be built"
	depends on !BR2_LINUX_KERNEL
```

## package/thingino-vpn/Config.in
```kconfig
config BR2_PACKAGE_THINGINO_VPN
	bool

choice
	prompt "VPN Selection"
	default BR2_PACKAGE_THINGINO_VPN_WIREGUARD
	help
	  Select one VPN solution to include in the firmware.
	  Only one VPN can be selected at a time to minimize flash usage.

config BR2_PACKAGE_THINGINO_VPN_NONE
	bool "None"
	help
	  Do not include any VPN solution.

config BR2_PACKAGE_THINGINO_VPN_WIREGUARD
	bool "WireGuard"
	select BR2_PACKAGE_WIREGUARD_TOOLS
	select BR2_PACKAGE_WIREGUARD_LINUX_COMPAT
	select BR2_PACKAGE_THINGINO_VPN
	help
	  Include WireGuard VPN. Fast, modern, secure VPN tunnel.
	  WireGuard is included in the Linux kernel (when available)
	  or as a kernel module for older kernels.

	  https://www.wireguard.com/

config BR2_PACKAGE_THINGINO_VPN_ZEROTIER
	bool "ZeroTier-One"
	select BR2_PACKAGE_ZEROTIER_ONE
	select BR2_PACKAGE_THINGINO_VPN
	depends on BR2_INSTALL_LIBSTDCPP
	depends on BR2_TOOLCHAIN_HAS_THREADS
	help
	  Include ZeroTier-One VPN. Creates virtual Ethernet networks.
	  ZeroTier appears as a virtual network interface and works
	  like you are on the same physical LAN.

	  https://www.zerotier.com/

config BR2_PACKAGE_THINGINO_VPN_TAILSCALE
	bool "Tailscale"
	select BR2_PACKAGE_THINGINO_TAILSCALE
	select BR2_PACKAGE_THINGINO_VPN
	depends on FLASH_SIZE_MB >= 16
	help
	  Include Tailscale VPN. WireGuard-based mesh VPN with
	  centralized coordination. Easy to set up and manage.

	  https://tailscale.com/

endchoice

comment "ZeroTier-One requires a toolchain w/ C++, threads"
	depends on BR2_PACKAGE_THINGINO_VPN_ZEROTIER && (!BR2_INSTALL_LIBSTDCPP || !BR2_TOOLCHAIN_HAS_THREADS)

comment "Tailscale requires flash size > 8MB"
	depends on BR2_PACKAGE_THINGINO_VPN_TAILSCALE && FLASH_SIZE_MB < 16

# Include VPN package definitions (not directly selectable, controlled by choice above)
if BR2_PACKAGE_THINGINO_VPN
source "$BR2_EXTERNAL_THINGINO_PATH/package/thingino-tailscale/Config.in"
source "$BR2_EXTERNAL_THINGINO_PATH/package/zerotier-one/Config.in"
endif
```

## package/thingino-webserver/Config.in
```kconfig
config BR2_PACKAGE_THINGINO_WEBSERVER
	bool

choice
	prompt "Web Server"
	default BR2_PACKAGE_THINGINO_WEBSERVER_BUSYBOX
	help
	  Select the web server implementation for thingino.

config BR2_PACKAGE_THINGINO_WEBSERVER_BUSYBOX
	bool "BusyBox httpd"
	depends on BR2_PACKAGE_BUSYBOX
	select BR2_PACKAGE_BUSYBOX_HTTPD
	select BR2_PACKAGE_THINGINO_WEBSERVER
	help
	  Use BusyBox's lightweight httpd server.
	  Minimal footprint, suitable for embedded systems.

config BR2_PACKAGE_THINGINO_WEBSERVER_UHTTPD
	bool "uhttpd"
	depends on !BR2_STATIC_LIBS
	depends on BR2_TOOLCHAIN_HAS_SYNC_4
	depends on BR2_USE_MMU
	select BR2_PACKAGE_THINGINO_UHTTPD
	select BR2_PACKAGE_THINGINO_UHTTPD_TLS
	select BR2_PACKAGE_THINGINO_UHTTPD_TLS_MBEDTLS
	select BR2_PACKAGE_THINGINO_UHTTPD_HTTP_REDIRECT
	select BR2_PACKAGE_THINGINO_WEBSERVER
	help
	  Use thingino-uhttpd with optional TLS/HTTPS support.
	  Modern web server with Lua scripting capability.

config BR2_PACKAGE_THINGINO_WEBSERVER_NGINX
	bool "nginx"
	depends on BR2_USE_MMU
	select BR2_PACKAGE_NGINX
	select BR2_PACKAGE_NGINX_HTTP
	select BR2_PACKAGE_THINGINO_WEBSERVER
	help
	  Use nginx web server.
	  Full-featured HTTP server and reverse proxy.

endchoice

comment "BusyBox httpd needs BusyBox"
	depends on !BR2_PACKAGE_BUSYBOX

comment "uhttpd needs a toolchain w/ dynamic library, sync_4"
	depends on BR2_STATIC_LIBS || !BR2_TOOLCHAIN_HAS_SYNC_4
	depends on BR2_USE_MMU

comment "nginx needs MMU support"
	depends on !BR2_USE_MMU
```

## package/thingino-webui-lua/Config.in
```kconfig
config BR2_PACKAGE_THINGINO_WEBUI_LUA
	bool "thingino-webui-lua"
	#depends on BR2_PACKAGE_LUA
	select BR2_PACKAGE_LUA
	select BR2_PACKAGE_THINGINO_UHTTPD
	select BR2_PACKAGE_THINGINO_UHTTPD_LUA
	help
	  Modern Lua-based web interface for thingino cameras with
	  session-based authentication, HTTPS support, and responsive
	  design. This replaces the legacy haserl-based web interface
	  with a more secure and maintainable solution.

	  Features:
	  - Session-based authentication (no more basic auth)
	  - Modern responsive web interface
	  - JSON API for AJAX requests
	  - Secure session management
	  - HTTPS-first design
	  - Modular Lua architecture

	  Requires uhttpd with Lua support enabled.

if BR2_PACKAGE_THINGINO_WEBUI_LUA

config BR2_PACKAGE_THINGINO_WEBUI_LUA_DEBUG
	bool "Enable debug mode"
	help
	  Enable debug logging and development features in the
	  Lua web interface. This should be disabled in production.

endif

comment "thingino-webui-lua needs Lua support"
	depends on !BR2_PACKAGE_LUA
```
