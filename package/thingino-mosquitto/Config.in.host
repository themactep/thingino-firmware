## package/thingino-mosquitto/Config.in.host
```kconfig
config BR2_PACKAGE_HOST_THINGINO_MOSQUITTO
	bool "host mosquitto (mosquitto_passwd)"
	select BR2_PACKAGE_HOST_MOSQUITTO
	help
	  Wrapper to pull in the upstream host mosquitto_passwd tool.
```

## package/thingino-mxml/Config.in
```kconfig
config BR2_PACKAGE_THINGINO_MXML
	bool "thingino-mxml"
	help
	  Mini-XML is a small XML parsing library that you can use to
	  read XML and XML-like data files in your application without
	  requiring large non-standard libraries.

	  This is a Thingino shadow package providing the latest mxml v4.0.4
	  with modern API and security fixes, overriding the older
	  version in Buildroot.

	  https://www.msweet.org/mxml
```

## package/thingino-nimble/Config.in
```kconfig
config BR2_PACKAGE_THINGINO_NIMBLE
	bool "Apache Nimble 4.2 implementation (Bluetooth) for ATBM chips"
```

## package/thingino-odhcp6c/Config.in
```kconfig
config BR2_PACKAGE_THINGINO_ODHCP6C
	bool "thingino-odhcp6c"
	depends on BR2_USE_MMU # fork()
	depends on !BR2_STATIC_LIBS
	depends on BR2_TOOLCHAIN_HAS_SYNC_4
	select BR2_PACKAGE_THINGINO_LIBUBOX
	help
	  odhcp6c is a minimal DHCPv6 and RA-client for use in
	  embedded Linux systems, especially routers.

	  This is the Thingino-managed variant wired to thingino-libubox
	  and thingino-jct instead of upstream libubox/json-c.

	  https://git.openwrt.org/project/odhcp6c.git

comment "thingino-odhcp6c needs a toolchain w/ dynamic library"
	depends on BR2_USE_MMU
	depends on BR2_STATIC_LIBS
	depends on BR2_TOOLCHAIN_HAS_SYNC_4
```

## package/thingino-portal-lua/Config.in
```kconfig
config BR2_PACKAGE_THINGINO_PORTAL_LUA
	bool "thingino-portal-lua"
	depends on BR2_PACKAGE_THINGINO_UHTTPD
	depends on BR2_PACKAGE_LUA
	select BR2_PACKAGE_BUSYBOX_SHOW_OTHERS
	select BR2_PACKAGE_THINGINO_WPA_SUPPLICANT
	select BR2_PACKAGE_THINGINO_WPA_SUPPLICANT_AP_SUPPORT
	help
	  Thingino captive portal for initial camera configuration.
	  Uses uhttpd with Lua instead of busybox httpd with haserl.

	  Provides a web interface for configuring:
	  - Hostname
	  - Root password and SSH key
	  - WiFi network credentials
	  - WiFi access point mode
	  - Timezone settings

	  The portal automatically starts when no network configuration
	  is detected and provides captive portal functionality for
	  easy device setup.

comment "thingino-portal-lua needs uhttpd and lua"
	depends on !BR2_PACKAGE_THINGINO_UHTTPD || !BR2_PACKAGE_LUA
```

## package/thingino-portal-simple/Config.in
```kconfig
config BR2_PACKAGE_THINGINO_PORTAL_SIMPLE
	bool "thingino-portal-simple"
	select BR2_PACKAGE_THINGINO_WPA_SUPPLICANT_AP_SUPPORT
	help
	  Captive Portal Package for WiFi setup (HTML/JS + CGI)
```

## package/thingino-portal/Config.in
```kconfig
config BR2_PACKAGE_THINGINO_PORTAL
	bool "thingino-portal"
	select BR2_PACKAGE_THINGINO_WPA_SUPPLICANT_AP_SUPPORT
	help
	  Captive Portal Package for WiFi setup
```

## package/thingino-privacy-lite/Config.in
```kconfig
config BR2_PACKAGE_THINGINO_PRIVACY_LITE
	bool "thingino-privacy-lite"
	depends on BR2_PACKAGE_PRUDYNT_T
	help
	  Lightweight privacy backend plugin for prudynt.
	  It keeps stream sessions alive while reducing load by throttling
	  encoder bitrate/fps and muting the microphone when privacy is on.
```

## package/thingino-provision/Config.in
```kconfig
config BR2_PACKAGE_THINGINO_PROVISION
	bool "thingino-provision"
	help
	  Thingino Provisioning System

	  This package provides an automated provisioning system for Thingino devices.
	  It allows devices to fetch configuration from a provisioning server based on
	  their MAC address, featuring secure authentication.

	  Features:
	  - Device-specific configuration based on MAC address
	  - Secure authentication with salted password hashes
	  - Support for UENV, SYSTEM, and USER configuration sections
	  - DHCP-triggered provisioning support
```

## package/thingino-prusa-connect/Config.in
```kconfig
config BR2_PACKAGE_THINGINO_PRUSA_CONNECT
	bool "Thingino Prusa Connect integration"
	help
	  Upload Thingino camera metadata and snapshots directly to the
	  Prusa Connect cloud service. Includes:
	  - init script and daemon that periodically push /tmp/snapshot.jpg
	    and device information to the Prusa Connect API
	  - CLI helper for configuring tokens/fingerprints from SSH
	  - WebUI page (needs thingino-webui) for credential entry
```

## package/thingino-raptor/Config.in
```kconfig
config BR2_PACKAGE_THINGINO_RAPTOR
	bool "Raptor Streaming System"
	depends on !BR2_SOC_FAMILY = "a1"
	depends on BR2_PACKAGE_THINGINO_STREAMER_RAPTOR
	select BR2_PACKAGE_INGENIC_LIB
	select BR2_PACKAGE_INGENIC_MUSL if BR2_TOOLCHAIN_USES_MUSL
	select BR2_PACKAGE_INGENIC_UCLIBC if BR2_TOOLCHAIN_USES_UCLIBC
	select BR2_PACKAGE_LIBSCHRIFT
	select BR2_PACKAGE_THINGINO_FONTS
	select BR2_PACKAGE_THINGINO_LOGO
	select BR2_PACKAGE_COMPY
	select BR2_PACKAGE_THINGINO_RAPTOR_HAL
	select BR2_PACKAGE_THINGINO_RAPTOR_IPC
	select BR2_PACKAGE_THINGINO_RAPTOR_COMMON
	help
	  Raptor Streaming System (RSS) -- modular microservice streamer
	  for Ingenic SoCs. Replaces prudynt-t with independent daemons:
	  RVD (video), RAD (audio), RSD (RTSP), ROD (OSD), RHD (HTTP),
	  RIC (IR-cut), RMR (recording), plus raptorctl management CLI.

if BR2_PACKAGE_THINGINO_RAPTOR

menu "Daemon selection"

config BR2_PACKAGE_THINGINO_RAPTOR_FULL
	bool "Full (all daemons)"
	default y
	help
	  Build and install all raptor daemons. Disable to select
	  individual daemons below. RVD (video) and tools (raptorctl,
	  ringdump, rac) are always included.

config BR2_PACKAGE_THINGINO_RAPTOR_RSD
	bool "RSD (RTSP server)"
	default y if BR2_PACKAGE_THINGINO_RAPTOR_FULL

config BR2_PACKAGE_THINGINO_RAPTOR_RAD
	bool "RAD (audio capture/speaker)"
	default y if BR2_PACKAGE_THINGINO_RAPTOR_FULL

config BR2_PACKAGE_THINGINO_RAPTOR_RHD
	bool "RHD (HTTP snapshots/MJPEG)"
	default y if BR2_PACKAGE_THINGINO_RAPTOR_FULL

config BR2_PACKAGE_THINGINO_RAPTOR_ROD
	bool "ROD (OSD renderer)"
	default y if BR2_PACKAGE_THINGINO_RAPTOR_FULL

config BR2_PACKAGE_THINGINO_RAPTOR_RIC
	bool "RIC (IR-cut controller)"
	default y if BR2_PACKAGE_THINGINO_RAPTOR_FULL

config BR2_PACKAGE_THINGINO_RAPTOR_RMR
	bool "RMR (fMP4 recording)"
	default y if BR2_PACKAGE_THINGINO_RAPTOR_FULL

config BR2_PACKAGE_THINGINO_RAPTOR_RMD
	bool "RMD (motion detection)"
	default y if BR2_PACKAGE_THINGINO_RAPTOR_FULL

config BR2_PACKAGE_THINGINO_RAPTOR_WEBRTC
	bool "RWD (WebRTC/WHIP server)"
	default y if BR2_PACKAGE_THINGINO_RAPTOR_FULL
	depends on BR2_PACKAGE_THINGINO_RAPTOR_TLS
	select BR2_PACKAGE_MBEDTLS_DTLS_SRTP
	help
	  WebRTC streaming daemon with WHIP signaling, two-way audio
	  backchannel, and HTTPS. Requires TLS support (mbedTLS).

config BR2_PACKAGE_THINGINO_RAPTOR_RWC
	bool "RWC (USB webcam)"
	depends on BR2_PACKAGE_THINGINO_KOPT_GADGET_WEBCAM
	help
	  USB webcam daemon. Reads JPEG/H.264 frames from ring buffers
	  and feeds them to the UVC gadget. Requires USB Gadget Webcam
	  kernel option.

config BR2_PACKAGE_THINGINO_RAPTOR_WEBTORRENT
	bool "WebTorrent sharing (external WebRTC)"
	default y if BR2_PACKAGE_THINGINO_RAPTOR_WEBRTC
	depends on BR2_PACKAGE_THINGINO_RAPTOR_WEBRTC
	help
	  Peer-to-peer external sharing via WebTorrent trackers.
	  View camera without port forwarding.

config BR2_PACKAGE_THINGINO_RAPTOR_RAC
	bool "rac (audio record/playback tool)"
	default y if BR2_PACKAGE_THINGINO_RAPTOR_RAD
	depends on BR2_PACKAGE_THINGINO_RAPTOR_RAD

endmenu

menu "Codec and feature options"

config BR2_PACKAGE_THINGINO_RAPTOR_AAC
	bool "AAC audio support"
	default y
	select BR2_PACKAGE_FAAC
	select BR2_PACKAGE_LIBHELIX_AAC
	help
	  AAC audio codec for encoding and decoding.

config BR2_PACKAGE_THINGINO_RAPTOR_OPUS
	bool "Opus audio support"
	default y
	select BR2_PACKAGE_OPUS
	help
	  Opus audio codec support.

config BR2_PACKAGE_THINGINO_RAPTOR_MP3
	bool "MP3 audio decoding"
	default y if FLASH_SIZE_MB > 8
	select BR2_PACKAGE_LIBHELIX_MP3
	help
	  MP3 decoding for audio client (rac).

config BR2_PACKAGE_THINGINO_RAPTOR_TLS
	bool "TLS support (RTSPS, HTTPS)"
	default y
	select BR2_PACKAGE_MBEDTLS
	help
	  Enable mbedTLS for RTSPS, RWD HTTPS signaling, and
	  optional RHD HTTPS.

config BR2_PACKAGE_THINGINO_RAPTOR_IVS_DETECT
	bool "IVS detection (person/object/YOLO)"
	default n
	select BR2_PACKAGE_INGENIC_LIB_JZDL
	select BR2_PACKAGE_MAGIK_MODELS
	select BR2_PACKAGE_MAGIK_MODELS_YOLOV5
	help
	  JZDL YOLOv5 inference and motion bounding box tracking.
	  Installs JZDL (609KB) and YOLOv5 model (870KB).
	  Enable personDet separately in ingenic-lib for the
	  built-in person detection algorithm (+1.5MB).

config BR2_PACKAGE_THINGINO_RAPTOR_AUDIO_EFFECTS
	bool "Audio effects (NS/HPF/AGC)"
	default y
	select BR2_PACKAGE_INGENIC_LIB_AUDIOPROCESS
	help
	  Noise suppression, high-pass filter, and automatic
	  gain control. Requires libaudioProcess.so from Ingenic SDK.

config BR2_PACKAGE_THINGINO_RAPTOR_DEBUG
	bool "Debug build"
	help
	  Build with -O0 -g instead of -Os. Debug binaries are
	  significantly larger.

endmenu

source "$BR2_EXTERNAL_THINGINO_PATH/package/thingino-raptor/Config.in.conf"

endif # BR2_PACKAGE_THINGINO_RAPTOR
```

## package/thingino-rt-tests/Config.in
```kconfig
config BR2_PACKAGE_THINGINO_RT_TESTS
bool "thingino-rt-tests"
depends on BR2_USE_MMU # fork()
depends on !BR2_STATIC_LIBS # dlopen()
depends on BR2_TOOLCHAIN_HAS_THREADS
# No Python dependencies - hwlatdetect excluded for minimal footprint
help
  Real-time testing suite for embedded Linux systems.
  
  This package provides a comprehensive set of programs to test
  various real-time features of the Linux kernel, including:
  
  - cyclictest: High resolution timer latency test
  - pi_stress: Priority inheritance mutex stress test
  - signaltest: Signal handling latency test
  - rt-migrate-test: Real-time task migration test
  - ptsematest: POSIX semaphore test
  - sigwaittest: Signal wait test
  - svsematest: SysV semaphore test
  - pmqtest: POSIX message queue test
  - sendme: Signal round-trip test
  - pip_stress: Priority inheritance pipe stress test
  - hackbench: Scheduler benchmark

  Optimized for embedded targets with cross-compilation support
  and musl libc compatibility. Python components (hwlatdetect) and
  documentation are excluded to minimize footprint.
  
  https://git.kernel.org/pub/scm/utils/rt-tests/rt-tests.git

if BR2_PACKAGE_THINGINO_RT_TESTS

config BR2_PACKAGE_THINGINO_RT_TESTS_INIT_SCRIPT
bool "Install cyclictest init script"
default n
help
  Install a SysV init script to run cyclictest as a service
  for continuous real-time monitoring.

endif

comment "thingino-rt-tests needs a toolchain w/ threads, dynamic library"
depends on BR2_USE_MMU
depends on !BR2_TOOLCHAIN_HAS_THREADS || BR2_STATIC_LIBS
```

## package/thingino-rtsp-server/Config.in
```kconfig
config BR2_PACKAGE_THINGINO_RTSP_SERVER
	bool "Thingino RTSP Server"
	help
	  Minimal pure C RTSP server implementation for thingino firmware.

	  This is a lightweight replacement for live555 that eliminates
	  C++ dependencies while providing the essential RTSP server
	  functionality needed by prudynt.

	  Features:
	  - Pure C implementation (no C++ dependencies)
	  - Minimal memory footprint
	  - RTSP/RTP streaming support
	  - Compatible with prudynt integration
	  - Authentication support

	  https://github.com/themactep/thingino-firmware
```

## package/thingino-streamer/Config.in
```kconfig
config BR2_PACKAGE_THINGINO_STREAMER
	bool

choice
	prompt "Streamer"
	default BR2_PACKAGE_THINGINO_STREAMER_NONE if BR2_THINGINO_TOOLCHAIN
	default BR2_PACKAGE_THINGINO_STREAMER_NONE if BR2_SOC_FAMILY = "a1"
	default BR2_PACKAGE_THINGINO_STREAMER_NONE if !BR2_THINGINO_DEV_CAMERA
	default BR2_PACKAGE_THINGINO_STREAMER_RAPTOR
	help
	  Select the camera streamer to use.

config BR2_PACKAGE_THINGINO_STREAMER_NONE
	bool "None"
	help
	  No streamer.

config BR2_PACKAGE_THINGINO_STREAMER_PRUDYNT
	bool "Prudynt-T"
	depends on !BR2_SOC_FAMILY = "a1"
	select BR2_PACKAGE_PRUDYNT_T
	select BR2_PACKAGE_THINGINO_STREAMER
	help
	  Traditional monolithic streamer.

config BR2_PACKAGE_THINGINO_STREAMER_RAPTOR
	bool "Raptor Streaming System"
	depends on !BR2_SOC_FAMILY = "a1"
	select BR2_PACKAGE_THINGINO_RAPTOR
	select BR2_PACKAGE_THINGINO_STREAMER
	help
	  Modular microservice streamer (RSS).

config BR2_PACKAGE_THINGINO_STREAMER_STRERO
	bool "Strero"
	depends on !BR2_SOC_FAMILY = "a1"
	select BR2_PACKAGE_STRERO
	select BR2_PACKAGE_THINGINO_STREAMER
	help
	  Strero streaming stack.

config BR2_PACKAGE_THINGINO_STREAMER_TIMPS
	bool "timps"
	depends on !BR2_SOC_FAMILY = "a1"
	select BR2_PACKAGE_TIMPS
	select BR2_PACKAGE_THINGINO_STREAMER
	help
	  Tiny IMP Streamer — minimal, dependency-light RTSP / fMP4 / MJPEG
	  streamer. Built on vendor libimp (no live555/libconfig/libwebsockets).

endchoice

if BR2_PACKAGE_THINGINO_STREAMER
source "$BR2_EXTERNAL_THINGINO_PATH/package/prudynt-t/Config.in"
source "$BR2_EXTERNAL_THINGINO_PATH/package/thingino-raptor/Config.in"
source "$BR2_EXTERNAL_THINGINO_PATH/package/strero/Config.in"
source "$BR2_EXTERNAL_THINGINO_PATH/package/timps/Config.in"

endif
```

## package/thingino-sysupgrade/Config.in
```kconfig
config BR2_PACKAGE_THINGINO_SYSUPGRADE
	bool "thingino-sysupgrade"
	help
	  Enables FOTA (firmware-over-the-air) support package
```

## package/thingino-tailscale/Config.in
```kconfig
config BR2_PACKAGE_THINGINO_TAILSCALE
	bool "tailscale"
	select BR2_PACKAGE_TAILSCALE
	depends on !FLASH_SIZE_8
	help
	  Install Tailscale VPN on Thingino devices.
```

## package/thingino-ubus/Config.in
```kconfig
comment "thingino-ubus needs a toolchain w/ dynamic library"
	depends on BR2_TOOLCHAIN_HAS_SYNC_4
	depends on BR2_STATIC_LIBS

config BR2_PACKAGE_THINGINO_UBUS
	bool "thingino-ubus"
	depends on BR2_TOOLCHAIN_HAS_SYNC_4
	depends on !BR2_STATIC_LIBS
	select BR2_PACKAGE_THINGINO_LIBUBOX
	select BR2_PACKAGE_THINGINO_JCT
	help
	  Thingino-managed ubus package wired to the external
	  libubox and thingino-jct stack.

if BR2_PACKAGE_THINGINO_UBUS

config BR2_PACKAGE_THINGINO_UBUS_EXAMPLES
	bool "build and install ubus examples"
	help
	  Build and install client and server ubus examples.

endif
```
