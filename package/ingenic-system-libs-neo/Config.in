## package/thingino-onvif/Config.in
```kconfig
config BR2_PACKAGE_THINGINO_ONVIF
	bool "Thingino ONVIF"
	select BR2_PACKAGE_THINGINO_JCT
	select BR2_PACKAGE_THINGINO_MXML
	select BR2_PACKAGE_LIBTOMCRYPT if !BR2_PACKAGE_MBEDTLS && !BR2_PACKAGE_WOLFSSL
	select BR2_PACKAGE_THINGINO_WOLFSSL_ASN if BR2_PACKAGE_WOLFSSL
	select BR2_PACKAGE_THINGINO_WOLFSSL_BASE64ENCODE if BR2_PACKAGE_WOLFSSL
	select BR2_PACKAGE_THINGINO_WOLFSSL_CODING if BR2_PACKAGE_WOLFSSL
	help
	  Thingino fork of roleoroleo's ONVIF Simple Server.
	  A light C implementation of an ONVIF server intended for use in resource-constrained devices.
	  Uses thingino-mxml (v4.0.4) for secure XML parsing with latest security fixes.

	  https://github.com/themactep/thingino-onvif

config BR2_PACKAGE_THINGINO_ONVIF_SYNOLOGY_COMPAT
	bool "Synology Surveillance Station compatibility (non-compliant)"
	depends on BR2_PACKAGE_THINGINO_ONVIF
	help
	  Build the ONVIF server with compatibility shims for Synology
	  Surveillance Station: a synthetic CreateProfile response and a
	  deletable SynoProfileToken. This is deliberately non-compliant
	  with the ONVIF spec (CreateProfile shall return MaxNVTProfiles
	  when the profile limit is reached) and exists only to coax
	  Synology's non-standard camera setup flow. Enable only if you
	  must feed a Synology NVR. Also requires "adv_synology_nvr":
	  true in /etc/onvif.json at runtime.
```

## package/thingino-open-isp/Config.in
```kconfig
config BR2_PACKAGE_THINGINO_OPEN_ISP
	bool "Thingino open ISP stack (experimental)"
	depends on BR2_PACKAGE_OPEN_TX_ISP_SUPPORTED
	depends on BR2_THINGINO_DEV_CAMERA
	select BR2_PACKAGE_INGENIC_SDK
	select BR2_PACKAGE_INGENIC_LIB
	select BR2_PACKAGE_OPEN_TX_ISP
	select BR2_PACKAGE_OPENIMP if BR2_PACKAGE_OPENIMP_SUPPORTED
	select BR2_PACKAGE_INGENIC_LIB_LIBIMP if !BR2_PACKAGE_OPENIMP_SUPPORTED
	select BR2_PACKAGE_INGENIC_SYSTEM_LIBS_NEO
	select BR2_PACKAGE_INGENIC_SYSTEM_LIBS_NEO_LIBALOG
	select BR2_PACKAGE_INGENIC_SYSTEM_LIBS_NEO_LIBSYSUTILS
	select BR2_PACKAGE_LIBAUDIOPROCESS_NEO
	help
	  Select the open TX-ISP driver and the open-source
	  replacements for libalog.so, libsysutils.so, and
	  libaudioProcess.so.

	  OpenIMP is also selected on its currently supported T31 and
	  T40 targets. T23 and T41 retain the proprietary libimp.so
	  userspace ABI provider while using the open kernel ISP and neo
	  support libraries.

	  This is an opt-in development profile. Image tuning and sensor
	  coverage vary by SoC and camera.
```

## package/thingino-pkg/Config.in
```kconfig
config BR2_PACKAGE_THINGINO_PKG
	bool "thingino-pkg"
	select BR2_PACKAGE_THINGINO_LIBCURL
	help
	  Thingino Package Manager — installs, removes, and lists
	  precompiled bundle packages (.tgz files) on the device.

	  Commands: install, remove, list, info, files

	  https://github.com/themactep/thingino-firmware
```

## package/thingino-raptor-config/Config.in
```kconfig
config BR2_PACKAGE_THINGINO_RAPTOR_CONFIG
	bool "Raptor configuration (raptor.conf)"
	default y
	depends on BR2_PACKAGE_THINGINO_RAPTOR
	help
	  Renders /etc/raptor.conf from a dedicated Kconfig, kept out of the
	  camera defconfig. Edit with:

	    make br-thingino-raptor-config-menuconfig
	    make br-thingino-raptor-config-savedefconfig

	  The per-camera delta lives in <camera>/raptor.config; shared
	  defaults in configs/raptor/default.config.
```
