## package/send2xmpp/Config.in
```kconfig
config BR2_PACKAGE_SEND2XMPP
	bool "send2xmpp"
	help
	  Send messages and images to XMPP (Jabber) servers.

	  Pure shell + curl implementation of XMPP over BOSH (XEP-0124/0206)
	  with SASL PLAIN authentication, plus image upload via HTTP Upload
	  (XEP-0363). Suitable for resource-constrained devices.

	  Configuration via /etc/send2xmpp.conf or the "xmpp" section of
	  /etc/send2.json. See the package QUICKSTART.md for setup.
```

## package/sigmastar-lib/Config.in
```kconfig
config BR2_PACKAGE_SIGMASTAR_LIB
	bool "sigmastar-lib"
	depends on BR2_SOC_VENDOR_SIGMASTAR
	help
	  Prebuilt SigmaStar MI userspace libraries for the configured
	  Infinity family.

	  The Raptor HAL dlopens these rather than linking them, so they are
	  not link-time dependencies -- but an image without them has daemons
	  that start and then fail at the first HAL call.

	  Normally selected by sigmastar-sdk rather than chosen directly;
	  neither half of the vendor stack is useful alone.

	  https://github.com/johnchia/sigmastar-lib
```

## package/sigmastar-sdk/Config.in
```kconfig
config BR2_PACKAGE_SIGMASTAR_SDK
	bool "sigmastar-sdk"
	depends on BR2_SOC_VENDOR_SIGMASTAR
	depends on BR2_LINUX_KERNEL
	select BR2_PACKAGE_SIGMASTAR_LIB
	help
	  The kernel side of the SigmaStar vendor stack: the prebuilt mi_*
	  and mhal kernel modules, the sensor drivers built from source for
	  the configured Infinity family, the ISP tuning blobs and the VENC
	  firmware.

	  The vendor modules are prebuilt against Linux 4.9.84, which is why
	  this board pins that kernel: insmod checks vermagic and a mismatch
	  is fatal. The sensor drivers are compiled here and have no such
	  constraint; one is chosen at runtime by load_sigmastar from the
	  U-Boot `sensor` variable.

	  Selects sigmastar-lib, which carries the MI userspace libraries
	  the Raptor HAL dlopens. Neither half is useful alone.

	  https://github.com/johnchia/sigmastar-sdk
```

## package/sigmastar-uboot/Config.in
```kconfig
config BR2_PACKAGE_SIGMASTAR_UBOOT
	bool "sigmastar-uboot"
	depends on BR2_SOC_VENDOR_SIGMASTAR
	help
	  U-Boot for SigmaStar Infinity6-family SoCs, from OpenIPC's fork of
	  the vendor tree.

	  Builds a NOR boot image (BOOT.bin) into images/ and installs nothing
	  to the target. Producing it does not flash it: the boot partition is
	  the one place on this board where a bad write cannot be recovered in
	  software, so writing it needs a serial console and an SPI flash clip
	  on the bench.

	  A sibling of thingino-uboot rather than a variant of it. That package
	  is Ingenic silicon end to end -- jz_sfc flash controllers, per-SoC
	  isvp_* board defconfigs, a MIPS SPL -- and has no SigmaStar path to
	  extend.

	  https://github.com/openipc/u-boot-sigmastar
```

## package/thingino-avpu/Config.in
```kconfig
config BR2_PACKAGE_THINGINO_AVPU
	bool "thingino-avpu"
	default y if BR2_PACKAGE_THINGINO_ISP_OPEN && BR2_THINGINO_DEV_CAMERA && BR2_SOC_FAMILY = "t31" && KERNEL_VERSION_5
	depends on BR2_SOC_FAMILY = "t31"
	depends on KERNEL_VERSION_5
	depends on BR2_PACKAGE_THINGINO_ISP_OPEN
	depends on BR2_THINGINO_DEV_CAMERA
	help
	  Vendor T31 AVPU (el150) H.264/H.265 encoder driver.

	  The modern kernels (5.15, 7.x) do not build the vendor SDK, so
	  nothing provides /dev/avpu, and the vendored libimp's
	  IMP_System_Init (AL_Board_Create) fails without it. This builds the
	  SDK AVPU driver as a module and installs /etc/modules.d/10-avpu.

	  Only meaningful for the vendor 5.15 T31 tree; on 3.10/4.4 the
	  ingenic-sdk package already builds and loads avpu.
```

## package/thingino-ha/Config.in
```kconfig
config BR2_PACKAGE_THINGINO_HA
	bool "thingino-ha"
	depends on BR2_PACKAGE_THINGINO_MOSQUITTO_20X
	depends on BR2_PACKAGE_THINGINO_JCT
	select BR2_PACKAGE_THINGINO_SYSUPGRADE
	help
	  Home Assistant MQTT integration for Thingino cameras.
	  Provides automatic MQTT discovery so all camera entities
	  (motion, IR cut, day/night, privacy, lights, PTZ, OTA, etc.)
	  appear automatically in Home Assistant without manual YAML.
	  Includes a native HA update entity (Settings -> Updates) that
	  installs firmware via a config-preserving partial upgrade
	  (sysupgrade -p); requires the sysupgrade package.
	  Requires the MQTT broker settings to be configured under
	  the mqtt_sub section and Home Assistant with MQTT integration.
	  https://github.com/themactep/thingino-firmware
```

## package/thingino-imp-test/Config.in
```kconfig
config BR2_PACKAGE_THINGINO_IMP_TEST
	bool "thingino-imp-test"
	select BR2_PACKAGE_INGENIC_LIB
	select BR2_PACKAGE_INGENIC_MUSL if BR2_TOOLCHAIN_USES_MUSL
	select BR2_PACKAGE_INGENIC_UCLIBC if BR2_TOOLCHAIN_USES_UCLIBC
	help
	  Minimal IMP test tools:
	  - imp-test-audio: audio capture, isolated.
	  - imp-test-video: FrameSource chn0 -> encoder chn0 bring-up harness
	    (no OSD/RTSP), with a caller-stack canary and a SIGSEGV handler
	    that prints pc/ra/sp/gp. Takes an optional PollingStream timeout
	    argument (0 = non-blocking).

	  Also installs imp-test-expr: a libimp AE/exposure probe
	  (dlsym-based, no IMP link-time dependency). Reports which AE
	  APIs the running libimp exports, reads the current exposure
	  state via GetExpr, and can pin the AE integration time with
	  IMP_ISP_Tuning_SetExpr(MANUAL) (--manual-us/--manual-lines) or
	  cap it with SetAe_IT_MAX (--cap-us/--cap-lines). --watch N
	  samples whether the pinned exposure survives AE re-seizure.
	  Generation note: SetExpr exists on T10/T20/T21/T23/T30/T31-class
	  libs; T32/T40/T41-class libs use SetAeExprInfo instead (the
	  probe reports which is present).
```

## package/thingino-isp-guard/Config.in
```kconfig
config BR2_PACKAGE_THINGINO_ISP_GUARD
	bool "Boot guard for the open ISP stack"
	default n
	depends on BR2_PACKAGE_THINGINO_ISP_OPEN
	help
	  Install /etc/init.d/S10isp-guard, a crash-loop guard for the
	  open-tx-isp kernel modules: a boot that crashes or resets before
	  it has run 300 s with the ISP opened by a streamer (timps, prudynt,
	  raptor, ...) makes the next boot skip the ISP and sensor modules
	  and timps (the camera stays reachable over SSH and the web UI;
	  "S10isp-guard clear" re-arms it). Planned reboots and firmware
	  upgrades do not count; the first boot of a new image starts with a
	  clean guard state. The u-boot variable isp_open=auto|manual|off
	  selects the behaviour.

	  Meant for development and bring-up of the open stack. Do not
	  enable it on cameras that must keep streaming through repeated
	  power loss: two reboots within five minutes leave the streamer
	  off until someone clears the guard.
```

## package/thingino-isp-inspector/Config.in
```kconfig
config BR2_PACKAGE_THINGINO_ISP_INSPECTOR
	bool "thingino-isp-inspector"
	depends on BR2_THINGINO_DEV_PACKAGES
	help
	  Developer tool providing a WebUI dashboard for real-time
	  inspection and analysis of Ingenic ISP status registers
	  (/proc/jz/isp/isp-m0 and /proc/jz/isp/isp-fs).

	  Features:
	  - Live ISP parameter dashboard with color-coded health indicators
	  - Historical trend charts (FPS, gain, exposure, EV)
	  - Automatic issue detection (FPS drops, buffer starvation,
	    gain saturation, integration time anomalies)
	  - Optional LLM-assisted analysis via DeepSeek, OpenAI, or
	    compatible API (API key configured in browser)

	  Requires thingino-webui. Only useful on Ingenic cameras
	  with /proc/jz/isp/ support (T10/T20/T31/T40/T41).
```

## package/thingino-isp/Config.in
```kconfig
config BR2_PACKAGE_THINGINO_ISP
	bool

choice
	prompt "ISP stack"
	default BR2_PACKAGE_THINGINO_ISP_NONE if BR2_THINGINO_TOOLCHAIN
	default BR2_PACKAGE_THINGINO_ISP_NONE if BR2_SOC_FAMILY = "a1"
	default BR2_PACKAGE_THINGINO_ISP_NONE if !BR2_THINGINO_DEV_CAMERA
	default BR2_PACKAGE_THINGINO_ISP_OPEN if BR2_PACKAGE_OPEN_TX_ISP_SUPPORTED
	help
	  Select the ISP kernel and userspace implementation used by the
	  camera stack.  The open stack is the only provider; boards whose
	  SoC or kernel has no open-tx-isp support cannot select it.

config BR2_PACKAGE_THINGINO_ISP_NONE
	bool "None"
	# Ingenic camera profiles must use the open stack; a SoC/kernel with
	# no open-tx-isp support has no valid provider and fails the build.
	depends on !BR2_THINGINO_DEV_CAMERA || BR2_SOC_FAMILY = "a1"
	help
	  Do not select an ISP provider. Available only for non-camera
	  builds and the non-Ingenic A1 family.

config BR2_PACKAGE_THINGINO_ISP_OPEN
	bool "Open ISP stack (experimental)"
	depends on BR2_PACKAGE_OPEN_TX_ISP_SUPPORTED
	depends on BR2_THINGINO_DEV_CAMERA
	select BR2_PACKAGE_THINGINO_ISP
	# On kernel 7 the SDK is disabled and the open driver carries its own
	# sensors from sensor-src/, so do not force the SDK back on.
	select BR2_PACKAGE_INGENIC_SDK if !KERNEL_MODERN
	select BR2_PACKAGE_INGENIC_LIB
	select BR2_PACKAGE_OPEN_TX_ISP
	select BR2_PACKAGE_OPENIMP
	select BR2_PACKAGE_INGENIC_SYSTEM_LIBS_NEO
	select BR2_PACKAGE_INGENIC_SYSTEM_LIBS_NEO_LIBALOG
	select BR2_PACKAGE_INGENIC_SYSTEM_LIBS_NEO_LIBSYSUTILS
	select BR2_PACKAGE_LIBAUDIOPROCESS_NEO
	help
	  Use open-tx-isp on supported T10, T20, T21, T23, T30, T31,
	  T40, and T41 targets. OpenIMP always supplies the userspace
	  ABI; there is no proprietary libimp fallback. A target or
	  kernel without OpenIMP support fails the build instead.

	  Image tuning and sensor coverage remain experimental.

endchoice
```

## package/thingino-leds/Config.in
```kconfig
config BR2_PACKAGE_THINGINO_LEDS
	bool "thingino-leds"
	depends on BR2_mips_xburst2
	depends on BR2_PACKAGE_THINGINO_KOPT_LEDS
	default y
	help
	  Out-of-tree module that registers the GPIO LEDs configured via
	  BR2_THINGINO_LED_*_GPIO / _ACTIVE_LOW as /sys/class/leds/led_*
	  on XBurst2 (kernel 4.4), which has no board file like 3.10.
```

## package/thingino-mcu-wdt/Config.in
```kconfig
config BR2_PACKAGE_THINGINO_MCU_WDT
	bool "thingino-mcu-wdt"
	select BR2_PACKAGE_JSON_C
	select BR2_PACKAGE_I2C_TOOLS
	help
	  Disables the hardware watchdog on a discrete companion MCU (found on
	  some Ingenic camera boards, e.g. the MindMotion MM32F0020B1T on the
	  Cinnado B6 T23ZN/TM18NA LTE variant) as early as possible during boot,
	  and (on boards with an MCU-power-sequenced LTE modem) sends the I2C
	  command that powers the modem on.

	  On boards where this MCU is present, its watchdog can power-cycle the
	  whole SoC if not disabled quickly after boot. This package ships two
	  of the vendor's own extracted binaries (mcu_test, a diagnostic tool,
	  plus its libcommon.so dependency) and runs `mcu_test --wdt_disable`
	  from the earliest available init hook (/etc/init.d/S00mcuwdt, the
	  lowest-numbered S-script rcS's `find ... -name "S*"` glob will run),
	  rather than reimplementing the I2C wire protocol from scratch.

	  Only enable this for boards that actually have this MCU wired up.

	  NOTE: an earlier version of this package shipped a different vendor
	  binary, disable_mcu_wdt (extracted from a separate recovery-initramfs
	  tool, statically linked against only libc/libpthread). It reliably
	  failed with garbled I2C responses on live hardware -- the I2C bus,
	  pins, and timing were all independently confirmed correct (a plain
	  MCU version query and other mcu_test commands succeed cleanly on the
	  same bus), so the bug was specific to that one binary's own protocol
	  handling, not the transport. mcu_test --wdt_disable, using the
	  identical I2C bus/MCU, succeeds cleanly every time. Use mcu_test.

	  mcu_test needs libjson-c.so.5; Thingino's own json-c package builds
	  libjson-c.so (unversioned), so the init script symlinks it at runtime
	  rather than requiring a second copy of the library.

	  Also installs /etc/init.d/S01ltepower, which sends a raw MCU I2C
	  command (magic 0xACAC, cmd 0x4003, CRC16/XMODEM-framed, protocol
	  reverse-engineered from mcu_test's own mcu_cmd_send_try; the command
	  ID itself came from disassembling stock's lp_mgr daemon) to power on
	  the TM18NA LTE modem via i2ctransfer. Without this, the modem never
	  presents anything on USB D+/D+ at all -- confirmed via direct DWC2
	  HPRT0 register readback (prtpwr=1, host mode with port power on, but
	  prtconnsts=0/SE0, i.e. no device electrically attached) that this is
	  unrelated to any USB/kernel-level configuration. mcu_test has no CLI
	  option for this command (its option table has ~70 vestigial/dead
	  entries from a shared vendor SDK build that never reach any real
	  code -- confirmed via disassembly, not a guess), hence the separate
	  raw i2ctransfer script rather than another mcu_test invocation.
```

## package/thingino-motor/Config.in
```kconfig
config BR2_PACKAGE_THINGINO_MOTOR
	bool "thingino-motor"
	default y if BR2_THINGINO_MOTORS && BR2_SOC_FAMILY = "t31" && KERNEL_VERSION_5
	depends on BR2_SOC_FAMILY = "t31"
	depends on KERNEL_VERSION_5
	depends on BR2_THINGINO_MOTORS
	help
	  Vendor T31 TCU stepper-motor driver (the /dev/motor char device
	  that thingino-motors' motors-daemon drives for PTZ).

	  The modern 5.15 tree does not build the vendor SDK, so nothing
	  provides motor.ko: S59motor's `modprobe motor` fails, motors-daemon
	  never starts, and its WebSocket PTZ listener (:8089) never comes up
	  - the preview page then shows "PTZ unavailable - camera needs a
	  rebuild with the WebSocket control path". This builds the SDK motor
	  driver as a module and installs it under the kernel modules dir so
	  S59motor can load it.

	  Only meaningful for the vendor 5.15 T31 tree; on 3.10/4.4 the
	  ingenic-sdk package already builds and loads motor.ko.
```

## package/thingino-motors/Config.in
```kconfig
config BR2_PACKAGE_THINGINO_MOTORS
	bool "thingino-motors"
	select BR2_THINGINO_MOTORS_TCU if !BR2_THINGINO_MOTORS_SPI
	help
	  Userspace programs to manage motor hardware

config BR2_PACKAGE_THINGINO_MOTORS_DW9714_ONLY
	bool "DW9714 Focus Control"
	help
	  Enable support for DW9714 VCM, includes control script

config BR2_PACKAGE_THINGINO_MOTORS_WS
	bool "WebSocket PTZ control path"
	depends on BR2_PACKAGE_THINGINO_MOTORS
	depends on !BR2_PACKAGE_THINGINO_MOTORS_DW9714_ONLY
	depends on BR2_TOOLCHAIN_HAS_THREADS
	default y if BR2_PACKAGE_THINGINO_STREAMER_TIMPS
	help
	  Serve PTZ control over a WebSocket listener in motors-daemon
	  (ws://<camera>:8089/ws), replacing one CGI round trip per move
	  with a persistent connection. Costs ~25KB of text, -lpthread.
	  Falls back to the CGI path if the socket can't be opened.

	  Defaults on when timps is the streamer. Not selected outright:
	  select would bypass this symbol's own depends chain, same
	  failure class as WS_TLS below.

	  Switches thingino-motors.mk's source to Lu-Fi's fork, where this
	  unmerged feature lives - endorsed by the upstream maintainer as
	  the way to gate it without forcing every build onto a fork.

config BR2_PACKAGE_THINGINO_MOTORS_WS_TLS
	bool "wss:// (TLS) on the WebSocket PTZ listener"
	depends on BR2_PACKAGE_THINGINO_MOTORS_WS
	# depends on, not select: select closed a real Kconfig dependency
	# cycle against the uhttpd TLS default (regression 2026-08-29).
	depends on BR2_PACKAGE_MBEDTLS
	default y if BR2_PACKAGE_THINGINO_UHTTPD_TLS_MBEDTLS
	help
	  Also accept TLS-wrapped connections on the same port (ws:// and
	  wss:// share it; the daemon peeks at the first byte). Needed if
	  the web UI is served over https:// - otherwise the browser
	  blocks plain ws:// as mixed content and PTZ silently falls back
	  to one CGI round trip per command.

	  Reuses S95timps' certificate, no new one is minted. Costs ~9KB
	  of text plus ~21KB heap per connected TLS client (default max 4
	  clients).
```
