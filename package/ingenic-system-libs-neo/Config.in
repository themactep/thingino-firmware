## package/ingenic-system-libs-neo/Config.in
```kconfig
config BR2_PACKAGE_INGENIC_SYSTEM_LIBS_NEO
	bool "ingenic-system-libs-neo (replaces stock libalog + libsysutils)"
	default y if BR2_SOC_VENDOR_INGENIC
	help
	  Open-source drop-in replacements for Ingenic SDK
	  libalog.so and libsysutils.so. Thread-safe, 51% smaller.
	  The implementation is SoC-independent and supports all current
	  Ingenic targets. It can be selected without ingenic-lib.
	  Selected by default on Ingenic targets; turn it off to keep the
	  stock blobs.

	  https://github.com/gtxaspec/ingenic-system-libs-neo

if BR2_PACKAGE_INGENIC_SYSTEM_LIBS_NEO

config BR2_PACKAGE_INGENIC_SYSTEM_LIBS_NEO_LIBALOG
	bool "libalog (replaces stock libalog.so)"
	default y
	help
	  Open-source drop-in replacement for Ingenic libalog.so.

config BR2_PACKAGE_INGENIC_SYSTEM_LIBS_NEO_LIBSYSUTILS
	bool "libsysutils (replaces stock libsysutils.so)"
	default y
	help
	  Open-source drop-in replacement for Ingenic libsysutils.so.

endif
```

## package/libaudioprocess-neo/Config.in
```kconfig
config BR2_PACKAGE_LIBAUDIOPROCESS_NEO
	bool "libaudioprocess-neo (replaces stock libaudioProcess)"
	default y if BR2_SOC_VENDOR_INGENIC
	help
	  Pure C drop-in replacement for Ingenic's proprietary
	  libaudioProcess.so. It supports all Ingenic SoCs with one
	  build.
	  Supports AEC, AGC, NS, HPF, LPF, HS, DRC, EQ.
	  Selected by default on Ingenic targets; turn it off to keep the
	  stock blob.
	  The target-finalize hook preserves the replacement if another
	  selected package also provides libaudioProcess.so.

	  https://github.com/gtxaspec/libaudioProcess-neo
```

## package/open-tx-isp/Config.in
```kconfig
config BR2_PACKAGE_OPEN_TX_ISP_SUPPORTED
	bool
	default y if BR2_SOC_FAMILY = "t10" && KERNEL_VERSION_3
	default y if BR2_SOC_FAMILY = "t20" && KERNEL_VERSION_3
	default y if BR2_SOC_FAMILY = "t21" && KERNEL_VERSION_3
	default y if BR2_SOC_FAMILY = "t23" && KERNEL_VERSION_3
	default y if BR2_SOC_FAMILY = "t30" && KERNEL_VERSION_3
	default y if BR2_SOC_FAMILY = "t31" && BR2_INGENIC_SOC_MODEL != "c100" && (KERNEL_VERSION_3 || KERNEL_VERSION_4 || KERNEL_VERSION_5 || KERNEL_VERSION_7)
	default y if BR2_SOC_FAMILY = "t40" && KERNEL_VERSION_4
	default y if BR2_SOC_FAMILY = "t41" && KERNEL_VERSION_4

config BR2_PACKAGE_OPEN_TX_ISP
	bool
	depends on BR2_PACKAGE_OPEN_TX_ISP_SUPPORTED
	depends on BR2_PACKAGE_THINGINO_ISP_OPEN
	# On the modern kernels (5.15, 7.x) the SDK is disabled (its
	# sensor/audio/AVPU modules are vendor 4.4-only); the open driver then
	# carries its own sensors from sensor-src/, so it does not build
	# "after ingenic-sdk".
	depends on BR2_PACKAGE_INGENIC_SDK || KERNEL_MODERN
	depends on BR2_THINGINO_DEV_CAMERA
	help
	  Open-source replacement for the proprietary Ingenic TX-ISP
	  kernel driver. Builds the driver for the selected T10, T20,
	  T21, T23, T30, T31, T40, or T41 SoC and installs it under the
	  canonical tx-isp-<soc>.ko module name.

	  The active upstream targets are the vendor Linux 3.10.14 trees
	  for T10/T20/T21/T23/T30/T31 and Linux 4.4.94 trees for T40/T41.
	  The T31 driver also builds against the vendor Linux 5.15.170 tree
	  through a compatibility shim. The recovered drivers are
	  experimental and image quality is not yet OEM-equivalent on every
	  sensor.

	  This package builds after ingenic-sdk so its module replaces
	  the proprietary module while retaining the SDK sensor, audio,
	  and AVPU modules.

	  https://github.com/opensensor/open-tx-isp

	  If unsure, say N.
```

## package/openimp/Config.in
```kconfig
config BR2_PACKAGE_OPENIMP
	bool
	depends on BR2_PACKAGE_THINGINO_ISP_OPEN
	depends on BR2_THINGINO_DEV_CAMERA
	select BR2_PACKAGE_TINYALSA if BR2_SOC_FAMILY = "t31" && KERNEL_VERSION_7
	help
	  OpenIMP is an open-source implementation of the Ingenic IMP
	  (Image Media Process) library. It provides a
	  reverse-engineered implementation of libimp.so that can
	  replace the proprietary Ingenic library.

	  Current upstream builds support T20, T21, T23, T30, T31, T40,
	  and T41. This package installs the matching build/<soc>/libimp.so
	  in staging and on the target, then preserves that replacement
	  during target finalization.

	  T30 is video-only: its build deliberately refuses to export the
	  IMP audio entry points. T20/T21 reuse the T31 audio implementation;
	  T31/T40/T41 export the IMP_AI/IMP_AO capture and playback paths.
	  The audio-capable builds also export IMP_AENC/IMP_ADEC and the
	  encoder fisheye controls, so prudynt links against OpenIMP. Some
	  optional OSD/IVS entry points remain incomplete.

	  https://github.com/opensensor/openimp
```

## package/prudynt-t/Config.in
```kconfig
config BR2_PACKAGE_PRUDYNT_T
	bool "Prudynt-T streamer"
	depends on !BR2_SOC_FAMILY = "a1"
	depends on BR2_PACKAGE_THINGINO_STREAMER_PRUDYNT
	select BR2_PACKAGE_INGENIC_LIB
	select BR2_PACKAGE_INGENIC_LIB_LIBIMP if !BR2_PACKAGE_OPENIMP
	select BR2_PACKAGE_INGENIC_MUSL if BR2_TOOLCHAIN_USES_MUSL
	select BR2_PACKAGE_INGENIC_UCLIBC if BR2_TOOLCHAIN_USES_UCLIBC
	select BR2_PACKAGE_THINGINO_AGENT
	select BR2_PACKAGE_THINGINO_DAYNIGHTD
	select BR2_PACKAGE_THINGINO_JCT
	select BR2_PACKAGE_THINGINO_ONVIF
	select BR2_PACKAGE_THINGINO_SEND2
	select BR2_PACKAGE_INGENIC_SYSTEM_LIBS_NEO
	select BR2_PACKAGE_INGENIC_SYSTEM_LIBS_NEO_LIBALOG
	select BR2_PACKAGE_INGENIC_SYSTEM_LIBS_NEO_LIBSYSUTILS
	select BR2_PACKAGE_LIBAUDIOPROCESS_NEO
	select BR2_THINGINO_LIBSTDCPP
	help
	  Video streamer for Ingenic T-series.
	  Now uses JSON configuration format with json-c library.

	  https://github.com/gtxaspec/prudynt-t

if BR2_PACKAGE_PRUDYNT_T

choice
	prompt "Prudynt linking mode"
	default BR2_PACKAGE_PRUDYNT_T_HYBRID
	help
	  Choose how Prudynt links against its dependencies.

	  Dynamic: All libraries linked dynamically (smallest binary, more .so files)
	  Hybrid: live555 static, others dynamic (balanced, ~700KB flash savings)
	  Static: All libraries static (largest binary, no .so files needed)

config BR2_PACKAGE_PRUDYNT_T_HYBRID
	bool "Hybrid linking (live555 static)"
	help
	  Statically link live555 libraries (RTSP/RTP stack) while keeping
	  other libraries dynamic. This is a balanced approach that saves
	  flash space by embedding only the actually-used live555 code.

	  Binary size: ~1.6MB (includes live555)
	  Shared libs: ~600KB (audio codecs, etc.)
	  Total: ~2.2MB
	  Flash savings: ~700KB vs dynamic

	  Recommended for most deployments.

config BR2_PACKAGE_PRUDYNT_T_DYNAMIC
	bool "Dynamic linking"
	help
	  Link all libraries dynamically. This produces the smallest binary
	  but requires all shared libraries (.so) on the target filesystem.

	  Binary size: ~2.3MB
	  Shared libs: ~2MB
	  Total: ~4.3MB

config BR2_PACKAGE_PRUDYNT_T_STATIC
	bool "Static linking (full)"
	help
	  Statically link all libraries except system libraries (libc, libimp).
	  This produces the largest binary but requires minimal .so files.

	  Binary size: ~4MB+
	  Shared libs: minimal (system only)
	  Total: ~4.5MB

	  Only use if you need complete library independence.

endchoice

choice
	prompt "Prudynt privacy control backend"
	default BR2_PACKAGE_PRUDYNT_T_PRIVACY_BACKEND_LITE
	help
	  Select how /usr/sbin/privacy enforces privacy mode.

config BR2_PACKAGE_PRUDYNT_T_PRIVACY_BACKEND_OSD
	bool "OSD cover only (default)"
	help
	  Uses prudynt's built-in PRIVACY FIFO command only.

config BR2_PACKAGE_PRUDYNT_T_PRIVACY_BACKEND_LITE
	bool "Lightweight plugin (reduce encoder load + mute mic)"
	select BR2_PACKAGE_THINGINO_PRIVACY_LITE
	help
	  Installs and uses a privacy plugin that keeps RTSP alive while
	  reducing encoder workload (lower bitrate/fps) and muting the mic.
endchoice

config BR2_PACKAGE_PRUDYNT_T_AAC
	bool "Enable AAC audio support"
	depends on BR2_PACKAGE_PRUDYNT_T
	default y
	select BR2_PACKAGE_FAAC
	select BR2_PACKAGE_LIBHELIX_AAC
	help
	  Enable AAC audio codec support. This pulls in both faac and
	  libhelix-aac. Disable to drop AAC dependencies and reduce
	  binary size.

config BR2_PACKAGE_PRUDYNT_T_OPUS
	bool "Enable Opus audio support"
	depends on BR2_PACKAGE_PRUDYNT_T
	default y
	select BR2_PACKAGE_OPUS
	select BR2_PACKAGE_THINGINO_SOUNDS
	help
	  Enable Opus audio codec support. Disable to drop the opus
	  dependency and reduce binary size.

config BR2_PACKAGE_PRUDYNT_T_MP3
	bool "Enable MP3 audio support"
	depends on BR2_PACKAGE_PRUDYNT_T
	default y if FLASH_SIZE_MB > 8
	select BR2_PACKAGE_LIBHELIX_MP3
	help
	  Enable MP3 audio codec support. Disable to drop the libhelix-mp3
	  dependency and reduce binary size.

config BR2_PACKAGE_PRUDYNT_T_FLAC
	bool "Enable FLAC audio support"
	depends on BR2_PACKAGE_PRUDYNT_T
	default y if FLASH_SIZE_MB > 8
	select BR2_PACKAGE_LIBFLAC
	help
	  Enable FLAC audio codec support. Disable to drop the libflac
	  dependency and reduce binary size.

config BR2_PACKAGE_PRUDYNT_T_OSD_BURNIN
	bool "Burned-in timestamp overlay"
	depends on BR2_PACKAGE_PRUDYNT_T
	default y
	help
	  Render a hardware timestamp overlay directly into the video frames
	  using the IMP OSD engine.  The timestamp format is taken from the
	  "clock" OSD element in prudynt.json.

	  When disabled, timestamp information is still available via the
	  SEI-based subtitle track (no burn-in overhead).

config BR2_PACKAGE_PRUDYNT_T_OSD_FONT_8X8
	bool "8x8 burn-in font (full ASCII, wider glyphs)"
	depends on BR2_PACKAGE_PRUDYNT_T
	depends on BR2_PACKAGE_PRUDYNT_T_OSD_BURNIN
	help
	  Use the 8x8 public-domain bitmap font (dhepper/font8x8) for the
	  burned-in timestamp overlay instead of the default 5x7 font.

	  The 8x8 font covers full ASCII - lowercase letters and all
	  punctuation - while the 5x7 font is uppercase-only.  Glyphs are
	  wider (8px vs 5px), so the overlay region is roughly 60% larger
	  at the same scale; on high-resolution streams the auto-scaled
	  overlay may hit the IPU OSD region buffer limit sooner.

config BR2_PACKAGE_PRUDYNT_T_OSD_FONT_UNIFONT
	bool "Unifont 8x16 burn-in font (ASCII + Cyrillic)"
	depends on BR2_PACKAGE_PRUDYNT_T
	depends on BR2_PACKAGE_PRUDYNT_T_OSD_BURNIN
	help
	  Use the GNU Unifont 8x16 bitmap font (SIL OFL-1.1 / GPLv2+ with
	  font embedding exception) for the burned-in timestamp overlay.
	  Covers full ASCII plus the Cyrillic block (U+0400-U+045F), so
	  Cyrillic text in the burn-in format string renders natively.

	  Glyphs are 16px tall, roughly 2.3x the overlay region bytes of
	  the 8x8 font at the same scale; the auto-scaled overlay may hit
	  the IPU OSD region buffer limit sooner.  Takes precedence over
	  the 8x8 font option if both are enabled.

config BR2_PACKAGE_PRUDYNT_T_OSD_FONT_LIBSCHRIFT
	bool "libschrift burn-in font (antialiased TrueType, ASCII only)"
	depends on BR2_PACKAGE_PRUDYNT_T
	depends on BR2_PACKAGE_PRUDYNT_T_OSD_BURNIN
	select BR2_PACKAGE_LIBSCHRIFT
	select BR2_PACKAGE_THINGINO_FONTS
	help
	  Render the burned-in timestamp overlay with antialiased TrueType
	  glyphs via libschrift, reading /usr/share/fonts/default.ttf on
	  the camera at runtime (installed by thingino-fonts).

	  The glyph cache is single-byte (ASCII) only; Cyrillic and other
	  UTF-8 text in the burn-in format string needs the Unifont bitmap
	  font instead.

	  Adds ~17KB to the prudynt binary (libschrift is linked
	  statically, matching the pre-2026 wiring).

config BR2_PACKAGE_PRUDYNT_T_FFMPEG
	bool "Enable FFmpeg integration (parsers/bitstream filters)"
	depends on BR2_PACKAGE_PRUDYNT_T
	select BR2_PACKAGE_THINGINO_FFMPEG
	help
	  Enable FFmpeg-based H.264/H.265 parsing and bitstream filters (AUD insertion,
	  extract_extradata). Prudynt will link against the FFmpeg built by the
	  thingino-ffmpeg package in Buildroot.

config BR2_PACKAGE_PRUDYNT_T_PREBUFFER
	bool "Enable pre-trigger buffer for motion events"
	depends on BR2_PACKAGE_PRUDYNT_T
	default y if BR2_SOC_RAM_MB >= 128
	default n
	help
	  Enable pre-trigger video buffer to capture frames before motion
	  detection triggers. This provides context for motion events by
	  including 2-10 seconds of video before the trigger occurred.

	  Memory requirements (per channel):
	  - Full frames (3s): ~1.5-2MB RAM
	  - Keyframe-only (3s): ~0.5MB RAM
	  - Binary size: +3-4KB

	  Enabled by default on 128MB+ devices, disabled on 64MB to
	  conserve memory. When disabled, this feature is completely
	  removed at compile time with zero overhead. Motion detection
	  still works without prebuffer, but recordings will only capture
	  frames after the trigger.

config BR2_PACKAGE_PRUDYNT_T_WEBRTC
	bool "WebRTC support"
	depends on BR2_PACKAGE_PRUDYNT_T
	depends on BR2_TOOLCHAIN_HAS_THREADS
	depends on !BR2_STATIC_LIBS
#	select BR2_PACKAGE_LIBPEER
	select BR2_PACKAGE_LIBDATACHANNEL
	help
	  Enable WebRTC real-time streaming support for Prudynt-T.
	  Adds WebRTC peer-to-peer streaming capabilities using libpeer.

	  This feature allows direct browser-to-camera streaming without
	  requiring RTSP clients, enabling modern web applications to
	  access camera streams directly.

comment "WebRTC support needs a toolchain w/ threads, dynamic library"
	depends on BR2_PACKAGE_PRUDYNT_T && (!BR2_TOOLCHAIN_HAS_THREADS || BR2_STATIC_LIBS)

config BR2_PACKAGE_PRUDYNT_T_WEBSOCKETS
	bool "Enable WebSocket UI/control server"
	depends on BR2_PACKAGE_PRUDYNT_T
	select BR2_PACKAGE_LIBWEBSOCKETS
	help
	  Build the libwebsockets-based configuration UI and API server.
	  Disable this if you only need RTSP/HTTP interfaces and want to drop
	  the libwebsockets dependency.

config BR2_PACKAGE_PRUDYNT_T_EXECINFO
	bool "Enable execinfo backtraces"
	depends on BR2_PACKAGE_PRUDYNT_T
	depends on BR2_TOOLCHAIN_USES_MUSL
	select BR2_PACKAGE_LIBEXECINFO
	help
	  Enable crash backtraces using libexecinfo. This adds dependency
	  on libexecinfo and enables stack trace collection in crash handler.

	  Disabled by default.

config BR2_PACKAGE_PRUDYNT_T_DEBUG
	bool "Enable debug build"
	depends on BR2_PACKAGE_PRUDYNT_T
	select BR2_PACKAGE_GDB
	help
	  Enable debug build of Prudynt-T with memory safety checking.

	  This option enables:
	  - Debug symbols (-g)
	  - Disabled optimizations (-O0)
	  - AddressSanitizer for memory error detection (when supported)
	  - UndefinedBehaviorSanitizer for runtime checks
	  - Preserved debug information (no symbol stripping)

	  IMPORTANT: Debug builds require NFS configuration!

	  Debug components are installed to the NFS share to keep firmware
	  images small:
	  - Unstripped binary: $(THINGINO_NFS)/usr/bin/prudynt-debug
	  - Debug symbols: $(THINGINO_NFS)/usr/lib/debug/usr/bin/prudynt.debug
	  - Debug tools: $(THINGINO_NFS)/usr/bin/prudynt-*

	  The firmware image will only contain the stripped binary at
	  /usr/bin/prudynt to maintain minimal size for camera deployment.

	  To use debug builds:
	  1. Set BR2_THINGINO_NFS in buildroot configuration
	  2. Mount NFS on camera: mount -t nfs server:/path /mnt/nfs
	  3. Access debug tools: /mnt/nfs/usr/bin/prudynt-debug

	  Use this for development, debugging memory issues, and
	  troubleshooting crashes on camera hardware.

	  WARNING: Debug builds are significantly larger and slower.
	  Only use for development and debugging purposes.

comment "prudynt-t debug build requires NFS configuration! Set BR2_THINGINO_NFS to your NFS mount point (e.g., /nfs)."
	depends on BR2_PACKAGE_PRUDYNT_T_DEBUG
	depends on BR2_THINGINO_NFS = ""

endif # BR2_PACKAGE_PRUDYNT_T
```

## package/qemu-ingenic/Config.in.host
```kconfig
config BR2_PACKAGE_HOST_QEMU_INGENIC_ARCH_SUPPORTS
	bool
	default y if BR2_HOSTARCH = "x86_64"
	default y if BR2_HOSTARCH = "aarch64"

config BR2_PACKAGE_HOST_QEMU_INGENIC
	bool "qemu-ingenic for host"
	depends on BR2_PACKAGE_HOST_QEMU_INGENIC_ARCH_SUPPORTS
	help
	  QEMU system emulator for Ingenic XBurst/XBurst2 MIPS SoCs.

	  Pre-built qemu-system-mipsel with Ingenic T-series machine
	  types (T10/T20/T21/T23/T30/T31/T32/T40/T41/A1).

	  https://github.com/gtxaspec/qemu
```
