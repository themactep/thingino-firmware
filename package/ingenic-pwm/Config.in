## package/ingenic-pwm/Config.in
```kconfig
config BR2_PACKAGE_INGENIC_PWM
	bool "Ingenic PWM"
	help
	  Userspace program for controlling PWM channels on the Ingenic platform.
```

## package/ingenic-sdk/Config.in
```kconfig
config BR2_PACKAGE_INGENIC_SDK
	bool "Ingenic SDK"
	default y if !KERNEL_VERSION_7
	depends on !KERNEL_VERSION_7
	select BR2_LINUX_KERNEL
	help
	  Code from Ingenic SDK

config BR2_INGENIC_SDK_ISP_TRACE
	bool "ISP vtable trace"
	depends on BR2_PACKAGE_INGENIC_SDK
	help
	  Enable CONFIG_JZ_ISP_TRACE in the kernel. At module load time the
	  driver will dump the symbolic name of every jz_driver_common_interfaces
	  vtable entry to the kernel log. Useful for open-driver development.
	  Check dmesg | grep jz_isp_trace on the camera.

config BR2_INGENIC_SDK_JZ_AES
	bool "jz-aes hardware AES module"
	depends on BR2_PACKAGE_INGENIC_SDK
	help
	  Load the jz-aes kernel module at boot. Provides hardware AES-128
	  acceleration via /dev/aes (ECB/CBC, DMA, IRQ). Useful for TLS
	  offload (RTSPS, HTTPS) on Ingenic SoCs.
```

## package/ingenic-tflite-micro/Config.in
```kconfig
config BR2_PACKAGE_INGENIC_TFLITE_MICRO
	bool "ingenic-tflite-micro"
	help
	  TensorFlow Lite Micro for Ingenic MIPS SoCs.

	  A lightweight machine learning inference library
	  optimized for embedded MIPS processors.

	  Used for on-device wake word detection and other
	  ML inference tasks.
```

## package/ingenic-uclibc/Config.in
```kconfig
config BR2_PACKAGE_INGENIC_UCLIBC
	bool "ingenic-uclibc"
	depends on BR2_TOOLCHAIN_USES_UCLIBC
	help
	  Compatibility shim for Ingenic libraries with uClibc toolchain.
	  Provides glibc-specific functions that Ingenic libraries expect.
```

## package/ipctool/Config.in
```kconfig
config BR2_PACKAGE_IPCTOOL
	bool "ipctool"
	select BR2_PACKAGE_LIBYAML
	help
	  ipctool - IP cameras chip information tool
	  https://github.com/openipc/ipctool/
```

## package/jsonpath/Config.in
```kconfig
config BR2_PACKAGE_JSONPATH
	bool "jsonpath"
	select BR2_PACKAGE_JSON_C
	select BR2_PACKAGE_LIBUBOX
	help
	  JSON parsing utility

	  https://git.openwrt.org/project/jsonpath.git
```

## package/libaudioshim/Config.in
```kconfig
config BR2_PACKAGE_LIBAUDIOSHIM
	bool "libaudioshim"
	help
	  Audio shim library for Ingenic SoC platforms.

	  https://github.com/gtxaspec/libaudioshim
```

## package/libdatachannel/Config.in
```kconfig
config BR2_PACKAGE_LIBDATACHANNEL
	bool "libdatachannel (tiny WebRTC C++ library)"
	select BR2_PACKAGE_LIBJUICE
	select BR2_PACKAGE_USRSCTP
	select BR2_PACKAGE_PLOG
	select BR2_PACKAGE_LIBSRTP
	depends on BR2_TOOLCHAIN_HAS_THREADS
	depends on !BR2_STATIC_LIBS
	help
	  Minimal WebRTC C++ library for embedded/IoT (https://github.com/paullouisageneau/libdatachannel)

comment "libdatachannel needs a toolchain w/ threads, dynamic library"
	depends on !BR2_TOOLCHAIN_HAS_THREADS || BR2_STATIC_LIBS
```

## package/libflac/Config.in
```kconfig
config BR2_PACKAGE_LIBFLAC
	bool "libflac lightweight FLAC decoder"
	help
	  libflac bundles the ESP8266Audio port of Xiph's reference FLAC decoder,
	  providing a reduced dependency footprint for embedded systems.

	  https://github.com/earlephilhower/ESP8266Audio/tree/master/src/libflac
```

## package/libhelix-aac/Config.in
```kconfig
config BR2_PACKAGE_LIBHELIX_AAC
	bool "libhelix-aac Fixed-point HE-AAC decoder"
	help
	  libhelix-aac is a high-performance HE-AAC decoder for 32-bit fixed-point
	  processors developed by RealNetworks.

	  https://github.com/earlephilhower/ESP8266Audio/blob/master/src/libhelix-aac/readme.txt
```

## package/libhelix-mp3/Config.in
```kconfig
config BR2_PACKAGE_LIBHELIX_MP3
	bool "libhelix-mp3 Fixed-point MP3 decoder"
	help
	  libhelix-mp3 provides the Helix fixed-point MP3 decoder extracted from the
	  ESP8266Audio project and is suitable for resource-constrained systems.

	  https://github.com/earlephilhower/ESP8266Audio/tree/master/src/libhelix-mp3
```

## package/libimp-debug/Config.in
```kconfig
config BR2_PACKAGE_LIBIMP_DEBUG
	bool "libimp-debug"
	help
	  Debug tool for Ingenic IMP (Ingenic Media Platform).
	  Queries runtime state of the video pipeline, encoder,
	  framesource, audio, and ISP subsystems via shared memory IPC.

	  https://github.com/gtxaspec/libimp-debug
```

## package/libjuice/Config.in
```kconfig
config BR2_PACKAGE_LIBJUICE
	bool "libjuice"
	help
	  ICE library for WebRTC (dependency of libdatachannel)
```

## package/libpeer/Config.in
```kconfig
config BR2_PACKAGE_LIBPEER
	bool "libpeer"
	depends on BR2_TOOLCHAIN_HAS_THREADS
	depends on !BR2_STATIC_LIBS
	select BR2_PACKAGE_MBEDTLS_WEBRTC_DTLS if BR2_PACKAGE_MBEDTLS
	select BR2_PACKAGE_LIBSRTP
	help
	  libpeer is a lightweight WebRTC library for embedded systems.
	  It provides peer-to-peer communication capabilities with support
	  for video, audio, and data channels.

	  Features:
	  - WebRTC peer connection management
	  - SDP offer/answer negotiation
	  - ICE candidate handling
	  - DTLS encryption using mbedTLS
	  - SRTP media encryption
	  - Data channels (SCTP disabled for thingino)

	  This library is optimized for embedded Linux systems and
	  supports cross-compilation for MIPS and ARM architectures.

	  https://github.com/sepfy/libpeer

comment "libpeer needs a toolchain w/ threads, dynamic library"
	depends on !BR2_TOOLCHAIN_HAS_THREADS || BR2_STATIC_LIBS
```

## package/libschrift/Config.in
```kconfig
config BR2_PACKAGE_LIBSCHRIFT
	bool "libschrift"
	help
	  libschrift is a lightweight TrueType font rendering library.

	  https://github.com/tomolt/libschrift
```

## package/libsrt/Config.in
```kconfig
config BR2_PACKAGE_LIBSRT
	bool "libsrt"
	depends on BR2_INSTALL_LIBSTDCPP
	depends on BR2_TOOLCHAIN_HAS_THREADS
	select BR2_PACKAGE_MBEDTLS
	help
	  SRT (Secure Reliable Transport) is a UDP-based transport
	  protocol for low-latency live video streaming with ARQ
	  retransmission and AES encryption.

	  https://github.com/Haivision/srt

config BR2_PACKAGE_LIBSRT_STATIC_STDCXX
	bool "Statically link libstdc++ into libsrt"
	default y
	depends on BR2_PACKAGE_LIBSRT
	help
	  Link libstdc++ statically so libstdc++.so is not needed
	  on the device. Increases binary size slightly but removes
	  the ~1MB libstdc++.so runtime dependency.

	  If disabled, libstdc++.so will be installed on the device.
```

## package/lightnvr/Config.in
```kconfig
config BR2_PACKAGE_LIGHTNVR
	bool "lightnvr"
	select BR2_PACKAGE_THINGINO_FFMPEG
	select BR2_PACKAGE_SQLITE
	default n
	help
	  Experimental NVR for Ingenic SoC's.
	  Automatically enables FFmpeg with staging installation
	  and required libraries for CMake-based builds.
```

## package/llhttp/Config.in
```kconfig
config BR2_PACKAGE_LLHTTP
	bool "llhttp"
	help
	  Port of http_parser to llparse. HTTP request/response parser
	  library used by Node.js.

	  https://github.com/nodejs/llhttp
```

## package/logcat-mini/Config.in
```kconfig
config BR2_PACKAGE_LOGCAT_MINI
	bool "logcat-mini"
	default y
	help
	  Replacement tool for reading Android logging
	  facility, which is used by Ingenic IMP libraries.
	  Reduced features for space savings.
```

## package/logcat/Config.in
```kconfig
config BR2_PACKAGE_LOGCAT
	bool "logcat"
	default n
	help
	  Full featured userspace programs for reading the Android logging
	  facility, which is used by Ingenic IMP libraries.
```

## package/magik-models/Config.in
```kconfig
config BR2_PACKAGE_MAGIK_MODELS
	bool "magik-models"
	depends on BR2_PACKAGE_INGENIC_LIB_IVS
	help
	  Pre-trained JZDL neural network models for Ingenic SoCs.

if BR2_PACKAGE_MAGIK_MODELS

config BR2_PACKAGE_MAGIK_MODELS_YOLOV5
	bool "YOLOv5 (person/bicycle/car/motorcycle — 870KB)"
	default y
	help
	  4-class object detection model.

config BR2_PACKAGE_MAGIK_MODELS_PERSONDET
	bool "Person detection (898KB)"
	help
	  Single-class person detection model.

config BR2_PACKAGE_MAGIK_MODELS_FACEDET
	bool "Face detection (258KB)"
	help
	  Face detection model.

endif
```

## package/majestic/Config.in
```kconfig
config BR2_PACKAGE_MAJESTIC
	bool "Majestic streamer"
	select BR2_PACKAGE_INGENIC_LIBIMP_CONTROL
	select BR2_PACKAGE_JSON_C
	select BR2_PACKAGE_LIBWEBSOCKETS_OPENIPC
	select BR2_PACKAGE_LIBYAML
	select BR2_PACKAGE_MAJESTIC_FONTS
	select BR2_PACKAGE_MXML
	select BR2_PACKAGE_ZLIB
	select BR2_PACKAGE_LIBOGG_OPENIPC
	select BR2_PACKAGE_LAME
	select BR2_PACKAGE_MBEDTLS			if !BR2_SOC_INGENIC_T20
	select BR2_PACKAGE_MBEDTLS_DTLS_SRTP		if !BR2_SOC_INGENIC_T20
	select BR2_PACKAGE_OPUS				if !BR2_SOC_INGENIC_T20
	select BR2_PACKAGE_OPUS_FIXED_POINT		if !BR2_SOC_INGENIC_T20
	select BR2_PACKAGE_LIBEVENT_OPENIPC
	select BR2_PACKAGE_MBEDTLS_OPENIPC
	select BR2_PACKAGE_MBEDTLS_DTLS_SRTP		if BR2_SOC_INGENIC_T20
	select BR2_PACKAGE_OPUS_OPENIPC			if BR2_SOC_INGENIC_T20
	help
	  Tiny but powerful IPC streaming software
	  (non-commercial version for personal use only)
	  https://openipc.org
```

## package/mbedtls-certgen/Config.in
```kconfig
config BR2_PACKAGE_MBEDTLS_CERTGEN
	bool "mbedtls-certgen"
	depends on BR2_PACKAGE_MBEDTLS || BR2_PACKAGE_THINGINO_MBEDTLS
	help
	  A lightweight certificate generation utility using mbedTLS.

	  This tool generates self-signed SSL certificates for embedded
	  devices using the mbedTLS library. It provides a minimal
	  alternative to the full mbedTLS programs suite, saving
	  significant space (~500KB+) while providing only the
	  certificate generation functionality needed.

	  Features:
	  - RSA and ECDSA key generation
	  - Self-signed certificate creation
	  - Configurable validity periods
	  - Minimal memory footprint

	  https://github.com/themactep/thingino-firmware
```

## package/motors/Config.in
```kconfig
config BR2_PACKAGE_MOTORS
	bool "motors"
	depends on BR2_MOTORS
	select BR2_MOTORS_TCU if !BR2_MOTORS_MS419XX
	help
	  Userspace programs to manage motor hardware

config BR2_PACKAGE_MOTORS_DW9714_ONLY
    bool "DW9714 Focus Control"
    help
      Enable support for DW9714 VCM, includes control script
```

## package/mt7601sta/Config.in
```kconfig
config BR2_PACKAGE_MT7601STA
	bool "mt7601sta"
	depends on BR2_LINUX_KERNEL
	help
	  Wireless driver mt7601sta.

comment "mt7601sta needs a Linux kernel to be built"
	depends on !BR2_LINUX_KERNEL
```
