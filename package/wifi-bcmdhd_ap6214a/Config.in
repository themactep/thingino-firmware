## package/wifi-bcmdhd_ap6214a/Config.in
```kconfig
config BR2_PACKAGE_WIFI_BCMDHD_AP6214A
	bool "Broadcom 43438 (AP6214a)"
	select BR2_LINUX_KERNEL
	depends on KERNEL_VERSION_4 && BR2_SOC_INGENIC_C100
```

## package/wifi-hi3881/Config.in
```kconfig
config BR2_PACKAGE_WIFI_HI3881
	select BR2_LINUX_KERNEL
	select BR2_PACKAGE_THINGINO_KOPT_MMC
	bool "HiSilicon 3881"
```

## package/wifi-mt7601sta/Config.in
```kconfig
config BR2_PACKAGE_WIFI_MT7601STA
	bool "Mediatek MT7601STA"
	select BR2_LINUX_KERNEL
	help
	  Wireless driver mt7601sta.
```

## package/wifi-mt7601u/Config.in
```kconfig
config BR2_PACKAGE_WIFI_MT7601U
	bool "Mediatek MT7601U"
	select BR2_LINUX_KERNEL
	select BR2_PACKAGE_THINGINO_KOPT_DWC2
	select BR2_PACKAGE_THINGINO_KOPT_DWC2_WIFI_ONLY
	select BR2_PACKAGE_THINGINO_WPA_SUPPLICANT_WEXT
	select BR2_PACKAGE_LINUX_FIRMWARE
	select BR2_PACKAGE_LINUX_FIRMWARE_MEDIATEK_MT7601U
	help
	  Wireless driver MT7601U
```

## package/wifi-rtl8188eu/Config.in
```kconfig
config BR2_PACKAGE_WIFI_RTL8188EU
	bool "Realtek RTL8188EU"
	help
	  Realtek 8188EU
```

## package/wifi-rtl8188eus/Config.in
```kconfig
config BR2_PACKAGE_WIFI_RTL8188EUS
	bool "Realtek RTL8188EUS"
	select BR2_LINUX_KERNEL
	help
	  A standalone driver for the RTL8188EU/RTL8188EUS/RTL8188ETV USB Wi-Fi adapter.
	  https://github.com/aircrack-ng/rtl8188eus/
```

## package/wifi-rtl8188fu/Config.in
```kconfig
config BR2_PACKAGE_WIFI_RTL8188FU
	bool "Realtek RTL8188FU"
	select BR2_LINUX_KERNEL
	select BR2_PACKAGE_THINGINO_KOPT_DWC2
	select BR2_PACKAGE_THINGINO_KOPT_DWC2_WIFI_ONLY
	help
	  RTL8188FU wireless driver
```

## package/wifi-rtl8189es/Config.in
```kconfig
config BR2_PACKAGE_WIFI_RTL8189ES
	bool "Realtek RTL8189ES"
	select BR2_LINUX_KERNEL
	select BR2_PACKAGE_THINGINO_KOPT_MMC
	help
	  A driver for the RTL8189ES
	  https://github.com/jwrdegoede/rtl8189ES_linux
```

## package/wifi-rtl8189fs/Config.in
```kconfig
config BR2_PACKAGE_WIFI_RTL8189FS
	bool "Realtek RTL8189FS"
	select BR2_LINUX_KERNEL
	select BR2_PACKAGE_THINGINO_KOPT_MMC if KERNEL_VERSION = 3.10.14
	help
	  A driver for the RTL8189FS
	  https://github.com/jwrdegoede/rtl8189ES_linux
```

## package/wifi-rtl8192eu/Config.in
```kconfig
config BR2_PACKAGE_WIFI_RTL8192EU
	bool "Realtek RTL8192EU"
	select  BR2_LINUX_KERNEL
	select CONFIG_WIRELESS_EXT
	help
	  A standalone driver for the RTL8192EU USB Wi-Fi adapter.
	  https://github.com/Mange/rtl8192eu-linux-driver
```

## package/wifi-rtl8192fs/Config.in
```kconfig
config BR2_PACKAGE_WIFI_RTL8192FS
	bool "Realtek RTL8192FS"
	select BR2_LINUX_KERNEL
	select BR2_PACKAGE_THINGINO_KOPT_MMC
	help
	  A driver for the RTL8192FS
```

## package/wifi-rtl8733bu/Config.in
```kconfig
config BR2_PACKAGE_WIFI_RTL8733BU
	bool "Realtek RTL8733BU"
	select BR2_LINUX_KERNEL
	select BR2_PACKAGE_THINGINO_KOPT_DWC2
	select BR2_PACKAGE_THINGINO_KOPT_DWC2_WIFI_ONLY
	help
	  RTL8733BY wireless driver
```

## package/wifi-rtl8812au/Config.in
```kconfig
config BR2_PACKAGE_WIFI_RTL8812AU
	bool "Realtek RTL8812AU"
	select BR2_LINUX_KERNEL
	help
	  A standalone driver for the RTL8812AU / RTL8821AU Dual Band
	  USB Wi-Fi adapter.
	  https://github.com/aircrack-ng/rtl8812au/
```

## package/wifi-ssv6158-ble/Config.in
```kconfig
config BR2_PACKAGE_WIFI_SSV6158_BLE
	bool "SSV6158"
	select BR2_LINUX_KERNEL
	help
		Enable support for SSV6158 SDIO based WiFi chips.
```

## package/wifi-ssv615x/Config.in
```kconfig
config BR2_PACKAGE_WIFI_SSV615X
	bool "SSV615x"
	select BR2_LINUX_KERNEL
	select BR2_PACKAGE_THINGINO_KOPT_DWC2
	select BR2_PACKAGE_THINGINO_KOPT_DWC2_WIFI_ONLY
	help
	  SV615X wireless driver
```

## package/wifi-ssv6x5x/Config.in
```kconfig
menu "SSV6X5X"

config BR2_PACKAGE_WIFI_SSV6X5X
	select BR2_LINUX_KERNEL
    select BR2_PACKAGE_THINGINO_KOPT_DWC2
    select BR2_PACKAGE_THINGINO_KOPT_DWC2_WIFI_ONLY
	bool "Enable SSV6X5X WiFi support"
	default n
	help
	  Enable support for SSV6X5X USB based WiFi chips. You must select a specific chip model.

if BR2_PACKAGE_WIFI_SSV6X5X

choice
	prompt "Select SSV6X5X Chip Model"
	help
	  Select the specific SSV6X5X WiFi chip model for your build.

config BR2_PACKAGE_WIFI_SSV6X5X_SSV6051P
	bool "SSV6051P (PID: 6000)"

config BR2_PACKAGE_WIFI_SSV6X5X_SV6115
	bool "SV6115  (PID: 6011)"

config BR2_PACKAGE_WIFI_SSV6X5X_SV6151P
	bool "SV6151P (PID: 6000)"

config BR2_PACKAGE_WIFI_SSV6X5X_SV6152P
	bool "SV6152P (PID: 6000)"

config BR2_PACKAGE_WIFI_SSV6X5X_SV6155P
	bool "SV6155P (PID: 6000)"

config BR2_PACKAGE_WIFI_SSV6X5X_SV6156P
	bool "SV6156P (PID: 6000)"

config BR2_PACKAGE_WIFI_SSV6X5X_SV6166F
	bool "SV6166F (PID: 6000)"

config BR2_PACKAGE_WIFI_SSV6X5X_SV6167Q
	bool "SV6167Q (PID: 6000)"

config BR2_PACKAGE_WIFI_SSV6X5X_SV6245
	bool "SV6245  (PID: 6000)"

config BR2_PACKAGE_WIFI_SSV6X5X_SV6255P
	bool "SV6255P (PID: 6000)"

config BR2_PACKAGE_WIFI_SSV6X5X_SV6256P
	bool "SV6256P (PID: 6000)"

config BR2_PACKAGE_WIFI_SSV6X5X_SV6267Q
	bool "SV6267Q (PID: 6000)"

config BR2_PACKAGE_WIFI_SSV6X5X_SV6318
	bool "SV6318  (PID: 6011)"

config BR2_PACKAGE_WIFI_SSV6X5X_SV6355
	bool "SV6355  (PID: 6011)"

config BR2_PACKAGE_WIFI_SSV6X5X_SV6358
	bool "SV6358  (PID: 6011)"

endchoice

endif

endmenu
```

## package/wifi-ssw101b/Config.in
```kconfig
config BR2_PACKAGE_WIFI_SSW101B
	bool "Sigmastar SSW101B"
	select BR2_LINUX_KERNEL
	help
	  Wireless driver ssw101b.
	  SigmaStar ssw101b WiFi driver
```

## package/wifi-syn4343/Config.in
```kconfig
config BR2_PACKAGE_WIFI_SYN4343
	bool "Broadcom/Synaptics 4343x (BRCM4343x)"
	select BR2_LINUX_KERNEL
	select BR2_PACKAGE_THINGINO_KOPT_MMC
```

## package/wifi-syn43438/Config.in
```kconfig
config BR2_PACKAGE_WIFI_SYN43438
	bool "Broadcom/Synaptics 43438 (BRCM43430 Rev. 2)"
	select BR2_LINUX_KERNEL
```

## package/wifi-txw901u/Config.in
```kconfig
config BR2_PACKAGE_WIFI_TXW901U
	bool "TAIXIN SEMI TXW901U"
	select BR2_LINUX_KERNEL
	select BR2_PACKAGE_THINGINO_KOPT_DWC2
	select BR2_PACKAGE_THINGINO_KOPT_DWC2_WIFI_ONLY
	help
	  TaiXin Semiconductor TXW901-USB wireless driver
	  https://www.taixin-semi.com/
```

## package/wifi-wq9001/Config.in
```kconfig
config BR2_PACKAGE_WIFI_WQ9001
	bool "WUQI WQ9001"
	select BR2_LINUX_KERNEL
	select BR2_PACKAGE_THINGINO_KOPT_DWC2
	select BR2_PACKAGE_THINGINO_KOPT_DWC2_WIFI_ONLY
	help
	  WUQI Microelectronics WQ9001 wireless driver
	  https://www.wuqi-micro.com/
```

## package/wifi-ws73v100/Config.in
```kconfig
menu "WS73V100"

config BR2_PACKAGE_WIFI_WS73V100
	bool "HiSilicon WS73V100 wireless support"
	select BR2_LINUX_KERNEL
	help
	  HiSilicon WS73V100 wireless driver

if BR2_PACKAGE_WIFI_WS73V100

choice
	prompt "Interface type"
	default BR2_PACKAGE_WIFI_WS73V100_SDIO
	help
	  Select the interface type for WS73V100 wireless driver

config BR2_PACKAGE_WIFI_WS73V100_SDIO
	bool "SDIO"
	select BR2_PACKAGE_THINGINO_KOPT_MMC
	help
	  Enable SDIO support for WS73V100 wireless driver

config BR2_PACKAGE_WIFI_WS73V100_USB
	bool "USB"
	select BR2_PACKAGE_THINGINO_KOPT_DWC2
	select BR2_PACKAGE_THINGINO_KOPT_DWC2_WIFI_ONLY
	help
	  Enable USB support for WS73V100 wireless driver

endchoice

endif
endmenu
```

## package/wifi/Config.in
```kconfig
menuconfig BR2_PACKAGE_WIFI
	bool "Wireless Module"
	select BR2_PACKAGE_WIRELESS_TOOLS
	select BR2_PACKAGE_THINGINO_WPA_SUPPLICANT
	select BR2_PACKAGE_THINGINO_WPA_SUPPLICANT_PASSPHRASE
	select BR2_PACKAGE_THINGINO_WPA_SUPPLICANT_NL80211
	select BR2_PACKAGE_THINGINO_WPA_SUPPLICANT_DEBUG_SYSLOG
	select BR2_PACKAGE_WIRELESS_TOOLS_IWCONFIG
	select BR2_PACKAGE_THINGINO_PORTAL
	select BR2_PACKAGE_THINGINO_AP
	help
	  Thingino Wireless Packages
	  include essentials for a wirless connection.
	  You still need to add a Wi-Fi driver!

if BR2_PACKAGE_WIFI
source "$BR2_EXTERNAL_THINGINO_PATH/package/wifi-aic8800/Config.in"
source "$BR2_EXTERNAL_THINGINO_PATH/package/wifi-atbm6012b/Config.in"
source "$BR2_EXTERNAL_THINGINO_PATH/package/wifi-atbm6012bx/Config.in"
source "$BR2_EXTERNAL_THINGINO_PATH/package/wifi-atbm6031/Config.in"
source "$BR2_EXTERNAL_THINGINO_PATH/package/wifi-atbm6031x/Config.in"
source "$BR2_EXTERNAL_THINGINO_PATH/package/wifi-atbm6032/Config.in"
source "$BR2_EXTERNAL_THINGINO_PATH/package/wifi-atbm6032x/Config.in"
source "$BR2_EXTERNAL_THINGINO_PATH/package/wifi-atbm6041/Config.in"
source "$BR2_EXTERNAL_THINGINO_PATH/package/wifi-atbm6132s/Config.in"
source "$BR2_EXTERNAL_THINGINO_PATH/package/wifi-atbm6132u/Config.in"
source "$BR2_EXTERNAL_THINGINO_PATH/package/wifi-atbm6062s/Config.in"
source "$BR2_EXTERNAL_THINGINO_PATH/package/wifi-atbm6062u/Config.in"
source "$BR2_EXTERNAL_THINGINO_PATH/package/wifi-atbm6441/Config.in"
source "$BR2_EXTERNAL_THINGINO_PATH/package/wifi-atk9/Config.in"
source "$BR2_EXTERNAL_THINGINO_PATH/package/wifi-bcm43438/Config.in"
source "$BR2_EXTERNAL_THINGINO_PATH/package/wifi-hi3881/Config.in"
source "$BR2_EXTERNAL_THINGINO_PATH/package/wifi-mt7601u/Config.in"
source "$BR2_EXTERNAL_THINGINO_PATH/package/wifi-rtl8188eu/Config.in"
source "$BR2_EXTERNAL_THINGINO_PATH/package/wifi-rtl8188eus/Config.in"
source "$BR2_EXTERNAL_THINGINO_PATH/package/wifi-rtl8188fu/Config.in"
source "$BR2_EXTERNAL_THINGINO_PATH/package/wifi-rtl8189es/Config.in"
source "$BR2_EXTERNAL_THINGINO_PATH/package/wifi-rtl8189fs/Config.in"
source "$BR2_EXTERNAL_THINGINO_PATH/package/wifi-rtl8192eu/Config.in"
source "$BR2_EXTERNAL_THINGINO_PATH/package/wifi-rtl8812au/Config.in"
source "$BR2_EXTERNAL_THINGINO_PATH/package/wifi-ssv6x5x/Config.in"
source "$BR2_EXTERNAL_THINGINO_PATH/package/wifi-ssv6158/Config.in"
source "$BR2_EXTERNAL_THINGINO_PATH/package/wifi-ssv615x/Config.in"
source "$BR2_EXTERNAL_THINGINO_PATH/package/wifi-ssw101b/Config.in"
source "$BR2_EXTERNAL_THINGINO_PATH/package/wifi-syn43436/Config.in"
source "$BR2_EXTERNAL_THINGINO_PATH/package/wifi-syn43438/Config.in"
endif
```

## package/wolfssh/Config.in
```kconfig
config BR2_PACKAGE_WOLFSSH
	bool "wolfssh"
	depends on BR2_PACKAGE_THINGINO_WOLFSSL
	help
      wolfSSH is a small, fast, portable SSH implementation,
      including support for SCP and SFTP.

	  https://www.wolfssl.com/

if BR2_PACKAGE_WOLFSSH

config BR2_PACKAGE_WOLFSSH_ENABLE_INLINE
    bool "enable-inline"
    help
      Enable inline functions

config BR2_PACKAGE_WOLFSSH_ENABLE_EXAMPLES
    bool "enable-examples"
    help
      Enable examples

config BR2_PACKAGE_WOLFSSH_ENABLE_KEYGEN
    bool "enable-keygen"
    select BR2_PACKAGE_THINGINO_WOLFSSL_KEYGEN
    help
      Enable key generation

config BR2_PACKAGE_WOLFSSH_ENABLE_SCP
    bool "enable-scp"
    help
      Enable scp support

config BR2_PACKAGE_WOLFSSH_ENABLE_SFTP
    bool "enable-sftp"
    help
      Enable sftp support

config BR2_PACKAGE_WOLFSSH_ENABLE_SSHD
    bool "enable-sshd"
    help
      Enable SSHD support

config BR2_PACKAGE_WOLFSSH_ENABLE_SSHCLIENT
    bool "enable-sshclient"
    help
      Enable SSH client app

config BR2_PACKAGE_WOLFSSH_ENABLE_FWD
    bool "enable-fwd"
    help
      Enable TCP/IP Forwarding support

config BR2_PACKAGE_WOLFSSH_ENABLE_TERM
    bool "enable-term"
    help
      Enable pseudo-terminal support

config BR2_PACKAGE_WOLFSSH_ENABLE_SHELL
    bool "enable-shell"
    help
      Enable echoserver shell support

config BR2_PACKAGE_WOLFSSH_ENABLE_AGENT
    bool "enable-agent"
    help
      Enable ssh-agent support

config BR2_PACKAGE_WOLFSSH_ENABLE_CERTS
    bool "enable-certs"
    help
      Enable X.509 cert support

config BR2_PACKAGE_WOLFSSH_ENABLE_SMALLSTACK
    bool "enable-smallstack"
    help
      Enable small stack

config BR2_PACKAGE_WOLFSSH_ENABLE_ALL
    bool "enable-all"
    help
      Enable all wolfSSH features

config BR2_PACKAGE_WOLFSSH_ENABLE_DISTRO
    bool "enable-distro"
    help
      Enable wolfSSH distro build

config BR2_PACKAGE_WOLFSSH_ENABLE_CURVE25519
    bool "enable-curve25519"
    help
      Enable Curve25519 for key exchange

config BR2_PACKAGE_WOLFSSH_ENABLE_KYBER
    bool "enable-kyber"
    select BR2_PACKAGE_THINGINO_WOLFSSL_WOLFSSH
    select BR2_PACKAGE_THINGINO_WOLFSSL_EXPERIMENTAL
    select BR2_PACKAGE_THINGINO_WOLFSSL_KYBER
    help
      Enable Kyber

endif
```

## package/wolfssl-certgen/Config.in
```kconfig
config BR2_PACKAGE_WOLFSSL_CERTGEN
	bool "wolfssl-certgen"
	depends on BR2_PACKAGE_THINGINO_WOLFSSL
	help
	  Certificate generator for WolfSSL
```
