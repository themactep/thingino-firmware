## configs/cameras-testing/qemu_t40nn_usbncm/qemu_t40nn_usbncm_defconfig
```kconfig
# NAME: QEMU T40NN (Ethernet, USB direct NCM server)
# FRAG: soc-xburst2 core
BR2_ETHERNET=y
BR2_PACKAGE_THINGINO_KOPT_JZ_MAC=y
BR2_INGENIC_SOC_MODEL="t40n"
BR2_PACKAGE_THINGINO_KOPT_DWC2=y
BR2_PACKAGE_THINGINO_KOPT_DWC2_DUAL_ROLE=y
BR2_PACKAGE_USBNET=y
BR2_PACKAGE_USBNET_USB_DIRECT_NCM=y
BR2_SENSOR_1_NAME="imx307"
BR2_PACKAGE_HOST_QEMU_INGENIC=y
BR2_THINGINO_RMEM_MB=64
FLASH_SIZE_MB=16
```

## configs/cameras-testing/qemu_t41nq/qemu_t41nq_defconfig
```kconfig
# NAME: QEMU T41NQ (virtual WiFi)
# FRAG: soc-xburst2 core
BR2_INGENIC_SOC_MODEL="t41nq"
BR2_ETHERNET=y
BR2_SENSOR_1_NAME="gc4023"
BR2_PACKAGE_THINGINO_KOPT_DWC2=y
BR2_PACKAGE_THINGINO_KOPT_DWC2_OTG=y
BR2_THINGINO_RMEM_MB=64
BR2_PACKAGE_HOST_QEMU_INGENIC=y
BR2_THINGINO_SDCARD=y
BR2_PACKAGE_WIFI=y
BR2_PACKAGE_WIFI_HWSIM=y
BR2_PACKAGE_THINGINO_UBOOT_FLASH_CONTROLLER_SFC0_NOR=y
FLASH_SIZE_MB=16
```

## configs/cameras/hb_wifi_z6_t10l_jxh62_rtl8188eu/hb_wifi_z6_t10l_jxh62_rtl8188eu_defconfig
```kconfig
# NAME: HB-WIFI-Z6 (T10L, JXH62, RTL8188EU)
# FRAG: soc-xburst1 core
BR2_INGENIC_SOC_MODEL="t10l"
BR2_PACKAGE_THINGINO_KOPT_DWC2=y
BR2_PACKAGE_THINGINO_KOPT_MMC0=y
BR2_PACKAGE_THINGINO_KOPT_MMC0_PB_4BIT=y
BR2_PACKAGE_WIFI=y
BR2_PACKAGE_WIFI_RTL8188EUS=y
BR2_SENSOR_1_NAME="jxh62"
BR2_THINGINO_AUDIO=y
BR2_THINGINO_BUTTON=y
BR2_THINGINO_LED_B_GPIO=20
BR2_THINGINO_RMEM_MB=14
BR2_THINGINO_SDCARD=y
FLASH_SIZE_MB=8
```

## configs/cameras/moes_wcm-p52_t31l_sc3332p_atbm6012bx/moes_wcm-p52_t31l_sc3332p_atbm6012bx_defconfig
```kconfig
# NAME: MOES WCM-P52 (T31L, SC3332P, ATBM6012BX)
# FRAG: soc-xburst1 core
BR2_INGENIC_SOC_MODEL="t31l"
BR2_ISP_CH0_PRE_DEQUEUE_INTERRUPT_PROCESS=y
BR2_ISP_CH0_PRE_DEQUEUE_INTERRUPT_PROCESS_VALUE=0
BR2_ISP_CH0_PRE_DEQUEUE_TIME=y
BR2_ISP_CH0_PRE_DEQUEUE_TIME_VALUE=14
BR2_ISP_CH0_PRE_DEQUEUE_VALID_LINES=y
BR2_ISP_CH0_PRE_DEQUEUE_VALID_LINES_VALUE=540
BR2_ISP_CLK_250MHZ=y
BR2_PACKAGE_THINGINO_KOPT_MMC0=y
BR2_PACKAGE_THINGINO_KOPT_MMC0_PB_4BIT=y
BR2_PACKAGE_WIFI=y
BR2_PACKAGE_WIFI_ATBM6012BX=y
BR2_SENSOR_1_NAME="sc3332p"
BR2_SENSOR_1_PARAMS="shvflip=1"
BR2_THINGINO_AUDIO=y
BR2_THINGINO_BUTTON=y
BR2_THINGINO_LED_G_GPIO=16
BR2_THINGINO_LED_R_GPIO=17
BR2_THINGINO_MOTORS=y
BR2_THINGINO_RMEM_MB=28
BR2_THINGINO_SDCARD=y
FLASH_SIZE_MB=8

# Stock firmware loads tx-isp-t31 with:
# isp_clk=240000000
# isp_ch0_pre_dequeue_time=14
# isp_ch0_pre_dequeue_interrupt_process=0
# isp_ch0_pre_dequeue_valid_lines=540
# isp_memopt=1
```

## configs/cameras/noname_t10l_jxh42_mt7601/noname_t10l_jxh42_mt7601_defconfig
```kconfig
# NAME: Noname (T10L, JXH42, MT7601)
# FRAG: soc-xburst1 core
BR2_INGENIC_SOC_MODEL="t10l"
BR2_PACKAGE_THINGINO_KOPT_MMC0=y
BR2_PACKAGE_THINGINO_KOPT_MMC0_PB_4BIT=y
BR2_PACKAGE_WIFI=y
BR2_PACKAGE_WIFI_MT7601U=y
BR2_SENSOR_1_NAME="jxh42"
BR2_THINGINO_AUDIO=y
BR2_THINGINO_BUTTON=y
BR2_THINGINO_LED_R_GPIO=20
BR2_THINGINO_RMEM_MB=14
BR2_THINGINO_SDCARD=y
FLASH_SIZE_MB=8
```

## configs/cameras/shelly_s1_t23n_mis20c1_atbm6132cu/shelly_s1_t23n_mis20c1_atbm6132cu_defconfig
```kconfig
# NAME: Shelly S1 (T23N, MIS20C1, ATBM6132CU)
# FRAG: soc-xburst1 core
BR2_INGENIC_SOC_MODEL="t23n"
BR2_PACKAGE_THINGINO_KOPT_MMC0=y
BR2_PACKAGE_THINGINO_KOPT_MMC0_PB_4BIT=y
BR2_PACKAGE_WIFI=y
BR2_PACKAGE_WIFI_ATBM6132CU=y
BR2_SENSOR_1_NAME="mis20c1"
BR2_THINGINO_AUDIO=y
BR2_THINGINO_BUTTON=y
BR2_THINGINO_LED_B_GPIO=40
BR2_THINGINO_PWM_ENABLE=y
BR2_THINGINO_SDCARD=y
FLASH_SIZE_MB=32
```

## configs/cameras/sonoff_s3w_t23n_sc231hai_atb6132cu/sonoff_s3w_t23n_sc231hai_atb6132cu_defconfig
```kconfig
# NAME: Sonoff S3W (T23N, SC231HAI, ATBM6132CU)
# FRAG: soc-xburst1 core
BR2_INGENIC_SOC_MODEL="t23n"
BR2_ISP_CLK_220MHZ=y
BR2_PACKAGE_THINGINO_KOPT_MMC0=y
BR2_PACKAGE_THINGINO_KOPT_MMC0_PB_4BIT=y
BR2_PACKAGE_WIFI=y
BR2_PACKAGE_WIFI_ATBM6132CU=y
BR2_PACKAGE_WIFI_ATBM6132CU_6162=y
BR2_SENSOR_1_NAME="sc231hai"
BR2_THINGINO_AUDIO=y
BR2_THINGINO_BUTTON=y
BR2_THINGINO_LED_B_ACTIVE_LOW=true
BR2_THINGINO_LED_B_GPIO=9
BR2_THINGINO_PWM_ENABLE=y
BR2_THINGINO_SDCARD=y
FLASH_SIZE_MB=16
```

## configs/cameras/tplink_tapo_c100_t31l_sc2336_wq9001/tplink_tapo_c100_t31l_sc2336_wq9001_defconfig
```kconfig
# NAME: TP-Link Tapo C100 (T31L, SC2336, WQ9001)
# FRAG: soc-xburst1 core
BR2_INGENIC_SOC_MODEL="t31l"
BR2_PACKAGE_THINGINO_KOPT_GADGET_WEBCAM=y
BR2_PACKAGE_THINGINO_KOPT_MMC0=y
BR2_PACKAGE_THINGINO_KOPT_MMC0_PB_4BIT=y
BR2_PACKAGE_WIFI=y
BR2_PACKAGE_WIFI_WQ9001=y
BR2_SENSOR_1_NAME="sc2336"
BR2_THINGINO_AUDIO=y
BR2_THINGINO_BUTTON=y
BR2_THINGINO_LED_G_GPIO=42
BR2_THINGINO_LED_R_GPIO=43
BR2_THINGINO_PWM_ENABLE=y
BR2_THINGINO_SDCARD=y
FLASH_SIZE_MB=8
```

## configs/cameras/vicohome_cg721_t31zl_gc2063_hi3881/vicohome_cg721_t31zl_gc2063_hi3881_defconfig
```kconfig
# NAME: Vicohome CG721 / ST-G1 (T31ZL, GC2063, HI3881)
# FRAG: soc-xburst1 core
BR2_INGENIC_SOC_MODEL="t31zl"
BR2_PACKAGE_THINGINO_KOPT_MMC0=y
BR2_PACKAGE_THINGINO_KOPT_MMC0_PB_4BIT=y
BR2_PACKAGE_THINGINO_KOPT_MMC1=y
BR2_PACKAGE_THINGINO_KOPT_MMC1_PA_4BIT=y
BR2_PACKAGE_WIFI=y
BR2_PACKAGE_WIFI_HI3881=y
BR2_SENSOR_1_NAME="gc2063"
BR2_THINGINO_AUDIO=y
BR2_THINGINO_BUTTON=y
BR2_THINGINO_SDCARD=y
FLASH_SIZE_MB=16
```

## configs/cameras/wyze_cam4_t41nq_os04d10_atbm6062s/wyze_cam4_t41nq_os04d10_atbm6062s_defconfig
```kconfig
# NAME: Wyze Cam 4 (T41NQ, OS04D10, ATBM6062S)
# FRAG: soc-xburst2 core
BR2_AVPU_CLK_600MHZ=y
BR2_AVPU_SCLKA=y
BR2_INGENIC_SOC_MODEL="t41nq"
BR2_LINUX_KERNEL_EXT_THINGINO_KOPT=y
BR2_PACKAGE_THINGINO_KOPT_DWC2=y
BR2_PACKAGE_THINGINO_KOPT_DWC2_OTG=y
BR2_PACKAGE_THINGINO_RAPTOR_CONF_IMAGE_SINTER="128"
BR2_PACKAGE_THINGINO_RAPTOR_CONF_IMAGE_TEMPER="128"
BR2_PACKAGE_THINGINO_RAPTOR_CONF_IRCUT_NIGHT_GAIN="350000"
BR2_PACKAGE_THINGINO_RAPTOR_CONF_IRCUT_PROBE_GAIN_PCT="95"
BR2_PACKAGE_THINGINO_RAPTOR_CONF_IRCUT_PROBE_HOLDOFF_SEC="30"
BR2_PACKAGE_THINGINO_RAPTOR_CONF_IRCUT_PROBE_RECHECK_SEC="120"
BR2_PACKAGE_THINGINO_SECUREBOOP=y
BR2_PACKAGE_THINGINO_UBOOT_FLASH_CONTROLLER_JZ_SFC=n
BR2_PACKAGE_THINGINO_UBOOT_FLASH_CONTROLLER_SFC0_NOR=y
BR2_PACKAGE_WIFI=y
BR2_PACKAGE_WIFI_ATBM6062S=y
BR2_SENSOR_1_NAME="os04d10"
BR2_THINGINO_AUDIO=y
BR2_THINGINO_BUTTON=y
BR2_THINGINO_RMEM_MB=64
BR2_THINGINO_SDCARD=y
FLASH_SIZE_MB=16
```

## configs/cameras/wyze_campan3_t31x_gc2053_atbm6031/wyze_campan3_t31x_gc2053_atbm6031_defconfig
```kconfig
# NAME: Wyze Cam Pan v3 (T31X, GC2053, ATBM6031)
# FRAG: soc-xburst1 core
BR2_AVPU_CLK_600MHZ=y
BR2_INGENIC_SOC_MODEL="t31x"
BR2_ISP_CLK_200MHZ=y
BR2_PACKAGE_THINGINO_KOPT_DWC2=y
BR2_PACKAGE_THINGINO_KOPT_DWC2_OTG=y
BR2_PACKAGE_THINGINO_KOPT_MMC0=y
BR2_PACKAGE_THINGINO_KOPT_MMC0_PB_4BIT=y
BR2_PACKAGE_THINGINO_KOPT_MMC1=y
BR2_PACKAGE_THINGINO_KOPT_MMC1_PB_4BIT=y
BR2_PACKAGE_THINGINO_SECUREBOOP=y
BR2_PACKAGE_THINGINO_SECUREBOOP_T31_MODULUS="015bf2d1ea7b7a59202c595d1016f81ca50f67ee8fcaac5bc5d1f424cd1f58488ef1fb7c16a04bd1c42a4beaa5acf2ddd5843381f96f20dcce06726355eae4e8cbf0f2207143c4de49ddef989fa10c2ceb07904fa0cfbd44a7ec52e2e244d8fcadcc5e04fb37a90edc482e29c0175a6395c9390beed1e4c001732720d3e870b3c12d37088b6efeeae8ad37b7420055057acdad58e46eb1de18ef533a22e16b0c60d2ccc3d01c6ea1551887973e01a75d5e6d6fb5e0702d384a0b916e7e246174c3cd769b4b89e4873a0afac7e99642fefc9d1d859d07581bca736e0132cdaf6db1e5706fd8297abb982353de02a173c075c605090a9715817520d0bd212703a7"
BR2_PACKAGE_WIFI=y
BR2_PACKAGE_WIFI_ATBM6031=y
BR2_PACKAGE_WYZE_ACCESSORY=y
BR2_PACKAGE_WYZE_ACCESSORY_CAR=y
BR2_PACKAGE_WYZE_ACCESSORY_SPOTLIGHT=y
BR2_SENSOR_1_NAME="gc2053"
BR2_SENSOR_1_PARAMS="sensor_max_fps=30 data_interface=1"
BR2_THINGINO_AUDIO=y
BR2_THINGINO_BUTTON=y
BR2_THINGINO_DFU=y
BR2_THINGINO_LED_B_GPIO=38
BR2_THINGINO_LED_R_GPIO=39
BR2_THINGINO_MOTORS=y
BR2_THINGINO_PWM_ENABLE=y
BR2_THINGINO_SDCARD=y
FLASH_SIZE_MB=16
```

## configs/cameras/wyze_campan3_t31x_gc2053_atbm6031_mmc/wyze_campan3_t31x_gc2053_atbm6031_mmc_defconfig
```kconfig
# NAME: Wyze Cam Pan v3 MMC Boot (T31X, GC2053, ATBM6031)
# FRAG: soc-xburst1 core
BR2_AVPU_CLK_600MHZ=y
BR2_ISP_CLK_200MHZ=y
BR2_PACKAGE_THINGINO_KOPT_DWC2=y
BR2_PACKAGE_THINGINO_KOPT_DWC2_OTG=y
BR2_PACKAGE_THINGINO_KOPT_MMC0=y
BR2_PACKAGE_THINGINO_KOPT_MMC0_PB_4BIT=y
BR2_PACKAGE_THINGINO_KOPT_MMC0_BOOT=y
BR2_PACKAGE_THINGINO_KOPT_MMC1=y
BR2_PACKAGE_THINGINO_KOPT_MMC1_PB_4BIT=y
BR2_PACKAGE_WIFI=y
BR2_PACKAGE_WIFI_ATBM6031=y
BR2_PACKAGE_WYZE_ACCESSORY=y
BR2_PACKAGE_WYZE_ACCESSORY_CAR=y
BR2_PACKAGE_WYZE_ACCESSORY_SPOTLIGHT=y
BR2_SENSOR_1_NAME="gc2053"
BR2_SENSOR_1_PARAMS="sensor_max_fps=30 data_interface=1"
BR2_INGENIC_SOC_MODEL="t31x"
BR2_THINGINO_AUDIO=y
BR2_THINGINO_BUTTON=y
BR2_THINGINO_MOTORS=y
BR2_THINGINO_PWM_ENABLE=y
BR2_THINGINO_SDCARD=y
BR2_PACKAGE_THINGINO_SECUREBOOP=y
BR2_PACKAGE_THINGINO_SECUREBOOP_T31_MODULUS="015bf2d1ea7b7a59202c595d1016f81ca50f67ee8fcaac5bc5d1f424cd1f58488ef1fb7c16a04bd1c42a4beaa5acf2ddd5843381f96f20dcce06726355eae4e8cbf0f2207143c4de49ddef989fa10c2ceb07904fa0cfbd44a7ec52e2e244d8fcadcc5e04fb37a90edc482e29c0175a6395c9390beed1e4c001732720d3e870b3c12d37088b6efeeae8ad37b7420055057acdad58e46eb1de18ef533a22e16b0c60d2ccc3d01c6ea1551887973e01a75d5e6d6fb5e0702d384a0b916e7e246174c3cd769b4b89e4873a0afac7e99642fefc9d1d859d07581bca736e0132cdaf6db1e5706fd8297abb982353de02a173c075c605090a9715817520d0bd212703a7"
BR2_TARGET_UBOOT_BOARDNAME="isvp_t31x_msc0"
BR2_TARGET_UBOOT_BOARD_DEFCONFIG="isvp_t31x_msc0"
BR2_TARGET_UBOOT_FORMAT_CUSTOM_NAME="u-boot-with-tpl-mmc-lzma.bin"
BR2_PACKAGE_THINGINO_UBOOT_ROOT="/dev/mmcblk0p2"
BR2_PACKAGE_THINGINO_UBOOT_ROOTFSTYPE="ext4"
BR2_TARGET_ROOTFS_EXT2=y
BR2_TARGET_ROOTFS_EXT2_4=y
BR2_TARGET_ROOTFS_EXT2_SIZE="64M"
BR2_TARGET_ROOTFS_EXT2_MKFS_OPTIONS="-O ^metadata_csum,^64bit"
FLASH_SIZE_MB=16
```

## configs/cameras/wyze_vdb2_t31x_sc301iot_atbm6031/wyze_vdb2_t31x_sc301iot_atbm6031_defconfig
```kconfig
# NAME: Wyze Video Doorbell v2 (T31X, SC301IoT, ATBM6031)
# FRAG: soc-xburst1 core
BR2_AVPU_CLK_600MHZ=y
BR2_INGENIC_SOC_MODEL="t31x"
BR2_ISP_CLK_200MHZ=y
BR2_PACKAGE_THINGINO_KOPT_DWC2=y
BR2_PACKAGE_THINGINO_KOPT_DWC2_OTG=y
BR2_PACKAGE_THINGINO_KOPT_MMC0=y
BR2_PACKAGE_THINGINO_KOPT_MMC0_PB_4BIT=y
BR2_PACKAGE_THINGINO_KOPT_MMC1=y
BR2_PACKAGE_THINGINO_KOPT_MMC1_PB_4BIT=y
BR2_PACKAGE_THINGINO_KOPT_MMC=y
BR2_PACKAGE_THINGINO_KOPT_UART=y
BR2_PACKAGE_THINGINO_KOPT_UART_UART0=y
BR2_PACKAGE_THINGINO_SECUREBOOP=y
BR2_PACKAGE_THINGINO_SECUREBOOP_T31_MODULUS="c9c9bbb2e0f09ed96d254c461d0d44f2ff59c9e517b68fa286cd0f7ba2f779a925c4c9c016f9640e6d652748d4ae00ed60b6220dda9331bb1e29341685c9c7d3a3cda65df0a15ed01702c0091d9035898a326a30536587c467650d3ff37dc150bb2583bd698ae976d58a1690e590b4f3fa12a5279def01be37c02cb0bcf7b63dc91af40de61e36e7aa97c595d05f7faee070d54fc329c9510681d65937c1158127fa0c2232b8b482ec38950eca2988bc6e0435feac50e8f7d4d17d8ef5834dbe26221dcaa881fb261318d3faa4f7a81706f9b8b067bf564154ca6f4c25e2103a6f4acbe62698d6cfd189a7eed5b56ff5a2412eabb2a330101749a8ba2d591e67"
BR2_PACKAGE_WIFI=y
BR2_PACKAGE_WIFI_ATBM6031=y
BR2_SENSOR_1_NAME="sc301iot"
BR2_THINGINO_AUDIO=y
BR2_THINGINO_BUTTON=y
BR2_THINGINO_DEV_DOORBELL=y
BR2_THINGINO_DFU=y
BR2_THINGINO_LED_B_GPIO=39
BR2_THINGINO_LED_Y_GPIO=38
BR2_THINGINO_PWM_ENABLE=y
BR2_THINGINO_RMEM_MB=42
BR2_THINGINO_SDCARD=y
FLASH_SIZE_MB=16
```

## configs/cameras/xiaomi_mjsxj03hl_t31n_jxq03p_rtl8189ftv/xiaomi_mjsxj03hl_t31n_jxq03p_rtl8189ftv_defconfig
```kconfig
# NAME: Xiaomi MJSXJ03HL (T31N, JXQ03P, RTL8189FTV)
# FRAG: soc-xburst1 core
BR2_AVPU_VPLL=y
BR2_INGENIC_SOC_MODEL="t31n"
BR2_PACKAGE_THINGINO_KOPT_DWC2=y
BR2_PACKAGE_THINGINO_KOPT_DWC2_OTG=y
BR2_PACKAGE_THINGINO_KOPT_MMC0=y
BR2_PACKAGE_THINGINO_KOPT_MMC0_PB_4BIT=y
BR2_PACKAGE_THINGINO_KOPT_MMC1=y
BR2_PACKAGE_THINGINO_KOPT_MMC1_PB_4BIT=y
BR2_PACKAGE_WIFI=y
BR2_PACKAGE_WIFI_RTL8189FS=y
BR2_SENSOR_1_NAME="jxq03p"
BR2_TARGET_UBOOT_BOARDNAME="isvp_t31_xiaomi_sfcnor"
BR2_TARGET_UBOOT_FORMAT_CUSTOM_NAME="u-boot-with-spl-lzma.bin"
BR2_THINGINO_AUDIO=y
BR2_THINGINO_BUTTON=y
BR2_THINGINO_DFU=y
BR2_THINGINO_LED_B_GPIO=38
BR2_THINGINO_LED_Y_GPIO=39
BR2_THINGINO_RMEM_MB=30
BR2_THINGINO_SDCARD=y
BR2_PACKAGE_THINGINO_SECUREBOOP=y
BR2_PACKAGE_THINGINO_SECUREBOOP_T31_MODULUS="9c2aedc63a39f2e44981f362852f00519ad5244ba5204161868fa0591df22f627fbc0cd6073050dee622b60dc2357cfc8e611261fb5aff210d32f27988921ef7e269f22ff80cb5f58257ee7b46ed2ca6bee043424d7e4c4d6e5ecac1fa51502bb94c0fd7b57bcd03019869b573321bb038a1d3be679cace640848d26ea541fb593c88dff7f96accdf76d8336d3d046b25a7ba3d471ecda5449bf8254cb70be1ef087b8f328890f646a3e576cfce4364e820c49f1a384bc289d0c30466070130f2b1f4e36c9db67eeb613b0ed5e2cb441a4bccee1e112d73989dfaa5fd688d591c75851f7dd3a197d4d760c97802c1d99187c534dd8fc18e663884bfdab57a354"
FLASH_SIZE_MB=16
```

## configs/cameras/xiaomi_mjsxj05hl_t31l_gc2053_atbm6031/xiaomi_mjsxj05hl_t31l_gc2053_atbm6031_defconfig
```kconfig
# NAME: Xiaomi MJXJ05HL (T31L, GC2053, ATBM6031)
# FRAG: soc-xburst1 core
BR2_INGENIC_SOC_MODEL="t31l"
BR2_PACKAGE_THINGINO_KOPT_DWC2=y
BR2_PACKAGE_THINGINO_KOPT_DWC2_OTG=y
BR2_PACKAGE_THINGINO_KOPT_MMC0=y
BR2_PACKAGE_THINGINO_KOPT_MMC0_PB_4BIT=y
BR2_PACKAGE_THINGINO_KOPT_MMC1=y
BR2_PACKAGE_THINGINO_KOPT_MMC1_PB_4BIT=y
BR2_PACKAGE_WIFI=y
BR2_PACKAGE_WIFI_ATBM6031=y
BR2_SENSOR_1_NAME="gc2053"
BR2_TARGET_UBOOT_BOARDNAME="isvp_t31_xiaomi_alt_sfcnor"
BR2_TARGET_UBOOT_FORMAT_CUSTOM_NAME="u-boot-with-spl-lzma.bin"
BR2_THINGINO_AUDIO=y
BR2_THINGINO_DFU=y
BR2_THINGINO_LED_B_GPIO=38
BR2_THINGINO_LED_Y_GPIO=39
BR2_THINGINO_RMEM_MB=32
BR2_THINGINO_SDCARD=y
BR2_PACKAGE_THINGINO_SECUREBOOP=y
BR2_PACKAGE_THINGINO_SECUREBOOP_T31_MODULUS="3b36cba8b3370c735755783baf35d032d1ae72f63b0fdff6fb651baab827405904402e02b8ae5473841cc21b75ab2bd22cb1367828571cf38b99c1e4379bd97e036012e44c3f8d25a409b1db1894cf675321f2e1e35dbebc3f3d3295087e04041916797047eea066ae2d90bebedf38593df19a1b7f1fdc60dd4538459d7320aa68bc2b3760f3432a47f8bf6a780ea85f5092eedd40b0a4194d78df96c397e55a45020f6478fafb9e7660cc7511cd9c64dda012f6ae07dd16bc0a2cab92ad8cf57626b3f60adad16ee35329152937cb813d824cdd27329293497554c2e7660113fa0eb1da66798f0c5d3d2c2923e664efec387a826cfb7689f803ed819ff1df58"
FLASH_SIZE_MB=16
```

## package/buildscope/Config.in.host
```kconfig
# The released binaries are static musl, built natively on each
# architecture rather than cross-linked, so the only thing that has to
# match is the machine the build runs on.
config BR2_PACKAGE_HOST_BUILDSCOPE_PREBUILT_ARCH_SUPPORTS
	bool
	default y if BR2_HOSTARCH = "x86_64"
	default y if BR2_HOSTARCH = "aarch64"

config BR2_PACKAGE_HOST_BUILDSCOPE
	bool "buildscope for host"
	depends on BR2_PACKAGE_HOST_BUILDSCOPE_PREBUILT_ARCH_SUPPORTS || \
		BR2_PACKAGE_HOST_RUSTC_ARCH_SUPPORTS
	help
	  Size and composition analyzer for Buildroot output
	  trees.

	  Attributes the rootfs to the packages that installed
	  it, reads real usage out of every image (squashfs,
	  jffs2, uImage, U-Boot env), and checks each partition
	  against its declared layout. 'make pack' then writes
	  images/buildscope-report.json, which the viewer at
	  buildscope.thingino.com renders.

	  https://github.com/thingino/buildscope

if BR2_PACKAGE_HOST_BUILDSCOPE

choice
	prompt "buildscope variant"
	default BR2_PACKAGE_HOST_BUILDSCOPE_PREBUILT
	help
	  Take the binary published with a buildscope release, or
	  compile the CLI here.

config BR2_PACKAGE_HOST_BUILDSCOPE_PREBUILT
	bool "buildscope (pre-built)"
	depends on BR2_PACKAGE_HOST_BUILDSCOPE_PREBUILT_ARCH_SUPPORTS
	help
	  Download the static binary attached to the release.
	  One 1.6MB fetch, kept in the Buildroot download cache
	  and shared by every camera in the tree, and no Rust
	  toolchain is downloaded or built.

config BR2_PACKAGE_HOST_BUILDSCOPE_FROM_SOURCE
	bool "buildscope (build from source)"
	depends on BR2_PACKAGE_HOST_RUSTC_ARCH_SUPPORTS
	select BR2_PACKAGE_HOST_RUSTC
	help
	  Compile the CLI from the pinned commit. buildscope is
	  the only Rust in a thingino build, so this pulls the
	  whole host toolchain in behind it: on the order of
	  2.5GB per output directory, plus the compile, for a
	  1.5MB tool.

	  Pick this to test a buildscope change that is not in a
	  release yet, or on a host the releases do not cover.

endchoice

endif
```
