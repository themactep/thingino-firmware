## configs/configs/cameras/ginzzu_op200_t31l_gc2083_ssv6155/ginzzu_op200_t31l_gc2083_ssv6155_defconfig
```kconfig
# NAME: Ginzzu OP200 (T31L, GC2083, SSV6155)
# MODULE: t31l_gc2083_ssv6155
BR2_AVPU_VPLL=y
BR2_ISP_CLK_200MHZ=y
BR2_ISP_CH0_PRE_DEQUEUE_TIME=y
BR2_ISP_CH0_PRE_DEQUEUE_TIME_VALUE=14
BR2_ISP_CH0_PRE_DEQUEUE_INTERRUPT_PROCESS=y
BR2_ISP_CH0_PRE_DEQUEUE_INTERRUPT_PROCESS_VALUE=0
BR2_ISP_CH0_PRE_DEQUEUE_VALID_LINES=y
BR2_ISP_CH0_PRE_DEQUEUE_VALID_LINES_VALUE=540
BR2_SENSOR_PARAMS="data_interface=1 shvflip=1"
BR2_THINGINO_AUDIO=y
BR2_THINGINO_BUTTON=y
BR2_THINGINO_MOTORS=y
BR2_THINGINO_MOTORS_TCU=y
BR2_THINGINO_SDCARD=y
FLASH_SIZE_16=y
```

## configs/configs/cameras/jooan_a2r_t23n_sc1a4t_atbm6012bx/jooan_a2r_t23n_sc1a4t_atbm6012bx_defconfig
```kconfig
# NAME: Jooan A2R-U (T23N, SC1A4T, ATBM6012BX)
# MODULE: t23n_sc1a4t_atbm6012bx
BR2_PACKAGE_THINGINO_KOPT_MMC0=y
BR2_PACKAGE_THINGINO_KOPT_MMC0_PB_4BIT=y
BR2_THINGINO_AUDIO=y
BR2_THINGINO_BUTTON=y
BR2_THINGINO_MOTORS=y
BR2_THINGINO_PWM_ENABLE=y
BR2_THINGINO_SDCARD=y
FLASH_SIZE_8=y
```

## configs/configs/cameras/jooan_c9ts_t23n_sc2336p_atbm6132u/jooan_c9ts_t23n_sc2336p_atbm6132u_defconfig
```kconfig
# NAME: Jooan C9TS-U (T23N, SC2336P, ATBM6132U)
# MODULE: t23n_sc2336p_atbm6132u
BR2_ISP_CLK_300MHZ=y
BR2_PACKAGE_THINGINO_KOPT_MMC0=y
BR2_PACKAGE_THINGINO_KOPT_MMC0_PB_4BIT=y
BR2_THINGINO_AUDIO=y
BR2_THINGINO_BUTTON=y
BR2_THINGINO_MOTORS=y
BR2_THINGINO_SDCARD=y
FLASH_SIZE_8=y
```

## configs/configs/modules/c100_gc2053_bcmdhd_ap6214a_defconfig
```kconfig
# NAME: C100, GC2063, BCMDHD_AP6214A
# FRAG: soc toolchain-glibc ccache brand rootfs kernel system target uboot
BR2_PACKAGE_WIFI=y
BR2_PACKAGE_WIFI_BCMDHD_AP6214A=y
BR2_SENSOR_GC2053=y
BR2_SOC_INGENIC_C100=y
```

## configs/configs/modules/t21n_jxf37_rtl8188ftv_defconfig
```kconfig
# NAME: T21N, JXF37, RTL8188FTV
# FRAG: soc toolchain ccache brand rootfs kernel system target uboot
BR2_PACKAGE_WIFI=y
BR2_PACKAGE_WIFI_RTL8188FU=y
BR2_SENSOR_JXF37=y
BR2_SOC_INGENIC_T21N=y
```

## configs/configs/modules/t23dl_jxh63p_txw901u_defconfig
```kconfig
# NAME: T23DL, JXH63P, TXW901U
# FRAG: soc toolchain ccache brand rootfs kernel system target uboot
BR2_SOC_INGENIC_T23DL=y
BR2_SENSOR_JXH63P=y
BR2_PACKAGE_WIFI=y
BR2_PACKAGE_WIFI_TXW901U=y
```

## configs/configs/modules/t23n_sc2336ps0+sc2336ps1_atbm6132u_defconfig
```kconfig
# NAME: T23N, SC2336P+SC2336PS1, ATBM6132U
# FRAG: soc toolchain ccache brand rootfs kernel system target uboot
BR2_SOC_INGENIC_T23N=y
BR2_THINGINO_IMAGE_SENSOR_QTY_2=y
BR2_SENSOR_1_SC2336PS0=y
BR2_SENSOR_2_SC2336PS1=y
BR2_PACKAGE_WIFI=y
BR2_PACKAGE_WIFI_ATBM6132U=y
```

## configs/configs/modules/t23n_sc3332p_ws73v100_defconfig
```kconfig
# NAME: T23N, SC3332P, WS73V100
# FRAG: soc toolchain ccache brand rootfs kernel system target uboot
BR2_SOC_INGENIC_T23N=y
BR2_SENSOR_SC3332P=y
BR2_PACKAGE_WIFI_WS73V100=y
BR2_PACKAGE_WIFI_WS73V100_USB=y
```

## configs/configs/modules/t31l_gc2083_eth_defconfig
```kconfig
# NAME: T31L, GC2083, ETH
# FRAG: soc toolchain ccache brand rootfs kernel system target uboot
BR2_ETHERNET=y
BR2_PACKAGE_THINGINO_KOPT_JZ_MAC_V13=y
BR2_SENSOR_GC2083=y
BR2_SOC_INGENIC_T31L=y
```

## configs/configs/modules/t41nq_sc5336_atbm6132u_defconfig
```kconfig
# NAME: T41NQ, SC5336, ATBM6132U
# FRAG: soc-xburst2 toolchain-xburst2 ccache brand rootfs kernel system target uboot
BR2_SENSOR_SC5336=y
BR2_SOC_INGENIC_T41NQ=y
BR2_PACKAGE_THINGINO_UBOOT_FLASH_CONTROLLER_JZ_SFC=n
BR2_PACKAGE_THINGINO_UBOOT_FLASH_CONTROLLER_SFC0_NOR=y
BR2_PACKAGE_WIFI=y
BR2_PACKAGE_WIFI_ATBM6132U=y
```

## configs/github/build_cache_defconfig
```kconfig
# NAME: dl-cache superset — XBurst1 / T31X, ALL Wi-Fi drivers + all features
# FRAG: soc-xburst1 core ssl
# NOTE: build_cache is the ONE config allowed to select many Wi-Fi drivers at once
#       (package/wifi/wifi.mk downgrades the multi-driver check to a warning for it),
#       so `make source` here pulls every driver's source into the dl cache.
BR2_INGENIC_SOC_MODEL="t31x"
BR2_PACKAGE_WIFI=y
# --- every Wi-Fi driver the tree defines ---
BR2_PACKAGE_WIFI_AIC8800=y
BR2_PACKAGE_WIFI_ATBM6012B=y
BR2_PACKAGE_WIFI_ATBM6012BX=y
BR2_PACKAGE_WIFI_ATBM6031=y
BR2_PACKAGE_WIFI_ATBM6031X=y
BR2_PACKAGE_WIFI_ATBM6032=y
BR2_PACKAGE_WIFI_ATBM6032X=y
BR2_PACKAGE_WIFI_ATBM6041=y
BR2_PACKAGE_WIFI_ATBM6062CU=y
BR2_PACKAGE_WIFI_ATBM6062S=y
BR2_PACKAGE_WIFI_ATBM6062U=y
BR2_PACKAGE_WIFI_ATBM6132S=y
BR2_PACKAGE_WIFI_ATBM6132U=y
BR2_PACKAGE_WIFI_ATBM6162S=y
BR2_PACKAGE_WIFI_ATBM6162U=y
BR2_PACKAGE_WIFI_ATBM6441=y
BR2_PACKAGE_WIFI_ATBM6461=y
BR2_PACKAGE_WIFI_ATK9=y
BR2_PACKAGE_WIFI_BCM43438=y
BR2_PACKAGE_WIFI_BCMDHD_AP6214A=y
BR2_PACKAGE_WIFI_HI3881=y
BR2_PACKAGE_WIFI_MT7601U=y
BR2_PACKAGE_WIFI_RTL8188EU=y
BR2_PACKAGE_WIFI_RTL8188EUS=y
BR2_PACKAGE_WIFI_RTL8188FU=y
BR2_PACKAGE_WIFI_RTL8189ES=y
BR2_PACKAGE_WIFI_RTL8189FS=y
BR2_PACKAGE_WIFI_RTL8192EU=y
BR2_PACKAGE_WIFI_RTL8192FS=y
BR2_PACKAGE_WIFI_RTL8733BU=y
BR2_PACKAGE_WIFI_RTL8812AU=y
BR2_PACKAGE_WIFI_SSV6158=y
BR2_PACKAGE_WIFI_SSV6X5X=y
BR2_PACKAGE_WIFI_SSV6X5X_SSV6051P=y
BR2_PACKAGE_WIFI_SSV6X5X_SV6115=y
BR2_PACKAGE_WIFI_SSW101B=y
BR2_PACKAGE_WIFI_SYN4343=y
BR2_PACKAGE_WIFI_TXW901U=y
BR2_PACKAGE_WIFI_WQ9001=y
BR2_PACKAGE_WIFI_WS73V100=y
# --- features (pull their packages + host-tool deps) ---
BR2_PACKAGE_THINGINO_MOSQUITTO_20X=y
BR2_THINGINO_AUDIO=y
BR2_THINGINO_MOTORS=y
BR2_THINGINO_MOTORS_TCU=y
BR2_THINGINO_SDCARD=y
BR2_THINGINO_PWM_ENABLE=y
FLASH_SIZE_MB=128
BR2_THINGINO_DFU=y
BR2_PACKAGE_WYZE_ACCESSORY=y
BR2_PACKAGE_WYZE_ACCESSORY_CAR=y
BR2_PACKAGE_WYZE_ACCESSORY_SPOTLIGHT=y
BR2_SENSOR_1_NAME="gc2053"
BR2_SENSOR_1_PARAMS="sensor_max_fps=30 data_interface=1"
BR2_THINGINO_LED_B_GPIO=39
BR2_THINGINO_LED_B_ACTIVE_LOW=y
BR2_THINGINO_LED_R_GPIO=38
BR2_THINGINO_LED_R_ACTIVE_LOW=y
```

## configs/github/build_cache_xburst1_44_defconfig
```kconfig
# NAME: dl-cache variant — XBurst1 + 4.4 kernel (TOOLCHAIN_SOC_TAG=xburst1_4_4)
# FRAG: soc-xburst1 core ssl
# Minimal: exists only to pull the xburst1_4_4 toolchain + 4.4 kernel + u-boot.
# Packages/wifi are already covered by the main build_cache entry.
BR2_INGENIC_SOC_MODEL="t31l"
KERNEL_VERSION_4=y
BR2_PACKAGE_WIFI=y
BR2_PACKAGE_WIFI_ATBM6031=y
BR2_SENSOR_1_NAME="sc2336"
FLASH_SIZE_MB=8
```

## configs/github/build_cache_xburst2_defconfig
```kconfig
# NAME: dl-cache variant — XBurst2 / T41NQ (TOOLCHAIN_SOC_TAG=xburst2)
# FRAG: soc-xburst2 core ssl
# Minimal: exists only to pull the xburst2 toolchain + kernel + u-boot.
# Packages/wifi are already covered by the main build_cache entry.
BR2_INGENIC_SOC_MODEL="t41nq"
BR2_PACKAGE_WIFI=y
BR2_PACKAGE_WIFI_ATBM6031=y
BR2_SENSOR_1_NAME="sc5336"
FLASH_SIZE_MB=128
```

## configs/ingenic_n23_b08_4_defconfig
```kconfig
# OpenIPC Buildroot for N23-B08-4 module (T31N + GC2053)

# OpenIPC
BR2_SOC_INGENIC=y
BR2_SOC_INGENIC_T31=y
BR2_SOC_INGENIC_T31N=y
BR2_SENSOR_MODEL="gc2053"

# Architecture
BR2_mipsel=y
BR2_mips_xburst=y
# BR2_MIPS_SOFT_FLOAT is not set
BR2_MIPS_FP32_MODE_32=y
# BR2_MIPS_FP32_MODE_XX is not set
BR2_MIPS_NAN_LEGACY=y
BR2_MIPS_OABI32=y

# BR2_TOOLCHAIN_BUILDROOT=y
BR2_TOOLCHAIN_EXTERNAL=y

# Toolchain
BR2_TOOLCHAIN=y
BR2_TOOLCHAIN_USES_MUSL=y
BR2_TOOLCHAIN_BUILDROOT_VENDOR="openipc"
BR2_TOOLCHAIN_BUILDROOT_MUSL=y
BR2_TOOLCHAIN_BUILDROOT_LIBC="musl"
BR2_TOOLCHAIN_BUILDROOT_CXX=y

# Kernel Header Options
BR2_KERNEL_HEADERS_AS_KERNEL=y
# BR2_KERNEL_HEADERS_VERSION is not set
BR2_PACKAGE_HOST_LINUX_HEADERS_CUSTOM_3_10=y
BR2_PACKAGE_LINUX_HEADERS=y
BR2_PACKAGE_MUSL_ARCH_SUPPORTS=y
BR2_PACKAGE_MUSL_SUPPORTS=y
BR2_PACKAGE_MUSL=y
BR2_PACKAGE_UCLIBC_ARCH_SUPPORTS=y
BR2_PACKAGE_UCLIBC_SUPPORTS=y
BR2_PACKAGE_GLIBC_ARCH_SUPPORTS=y
BR2_PACKAGE_GLIBC_SUPPORTS=y

# Binutils Options
BR2_PACKAGE_HOST_BINUTILS_SUPPORTS_CFI=y
BR2_BINUTILS_VERSION_2_39_X=y
BR2_BINUTILS_VERSION="2.39"
BR2_BINUTILS_EXTRA_CONFIG_OPTIONS=""

# GCC Options
BR2_PACKAGE_HOST_GDB_ARCH_SUPPORTS=y
BR2_GCC_VERSION_12_X=y
BR2_GCC_VERSION="12.2.0"
BR2_EXTRA_GCC_CONFIG_OPTIONS="--with-float=hard"

# Host GDB Options
# BR2_PACKAGE_HOST_GDB is not set


BR2_GLOBAL_PATCH_DIR="$(BR2_EXTERNAL_INGENIC_PATH)/../general/package/all-patches"
BR2_PER_PACKAGE_DIRECTORIES=y

BR2_TARGET_GENERIC_HOSTNAME="n23b084"
BR2_TARGET_GENERIC_ISSUE="Welcome to OpenIPC"
# BR2_TARGET_TZ_INFO is not set
BR2_ROOTFS_OVERLAY="$(BR2_EXTERNAL_INGENIC_PATH)/../general/overlay"
BR2_ROOTFS_POST_BUILD_SCRIPT="$(BR2_EXTERNAL_INGENIC_PATH)/../scripts/executing_commands_for_musl.sh"

# Kernel
BR2_LINUX_KERNEL=y
BR2_LINUX_KERNEL_CUSTOM_VERSION=y
BR2_LINUX_KERNEL_CUSTOM_VERSION_VALUE="3.10.14"
BR2_LINUX_KERNEL_VERSION="3.10.14"
BR2_LINUX_KERNEL_PATCH=""
BR2_LINUX_KERNEL_USE_CUSTOM_CONFIG=y
BR2_LINUX_KERNEL_CUSTOM_CONFIG_FILE="$(BR2_EXTERNAL_INGENIC_PATH)/board/t31/kernel/n23_b08_4.config"
BR2_LINUX_KERNEL_CONFIG_FRAGMENT_FILES=""
BR2_LINUX_KERNEL_CUSTOM_LOGO_PATH=""
BR2_LINUX_KERNEL_UIMAGE=y
BR2_LINUX_KERNEL_LZMA=y

# Linux Kernel Extensions
BR2_LINUX_KERNEL_EXT_INGENIC_PATCHER=y
BR2_LINUX_KERNEL_EXT_INGENIC_PATCHER_LIST="$(BR2_EXTERNAL_INGENIC_PATH)/board/t31/kernel/patches $(BR2_EXTERNAL_INGENIC_PATH)/board/t31/kernel/overlay"

# Target packages
BR2_PACKAGE_BUSYBOX=y
BR2_PACKAGE_BUSYBOX_CONFIG="$(BR2_EXTERNAL_INGENIC_PATH)/../general/package/busybox/busybox.config"
# BR2_PACKAGE_LAME is not set
# BR2_PACKAGE_GDB is not set
BR2_PACKAGE_UBOOT_TOOLS=y
BR2_PACKAGE_HASERL=y
# BR2_PACKAGE_FDK_AAC is not set
# BR2_PACKAGE_OPUS is not set
BR2_PACKAGE_ZLIB=y
BR2_PACKAGE_MBEDTLS=y
BR2_PACKAGE_JSON_C=y
BR2_PACKAGE_LIBYAML=y
BR2_PACKAGE_LIBOGG=y
BR2_PACKAGE_LIBCURL=y
BR2_PACKAGE_LIBCURL_CURL=y
BR2_PACKAGE_LIBCURL_MBEDTLS=y
BR2_PACKAGE_LIBWEBSOCKETS=y
BR2_PACKAGE_DROPBEAR=y
# BR2_PACKAGE_MINI_SNMPD is not set
BR2_PACKAGE_MOSQUITTO=y
# BR2_PACKAGE_MOSQUITTO_BROKER is not set
# BR2_PACKAGE_SSHPASS is not set
# BR2_PACKAGE_UACME is not set
# BR2_PACKAGE_WIREGUARD_LINUX_COMPAT is not set
# BR2_PACKAGE_WIREGUARD_TOOLS is not set

# Filesystem
# BR2_TARGET_ROOTFS_CPIO is not set
BR2_TARGET_ROOTFS_SQUASHFS=y
BR2_TARGET_ROOTFS_SQUASHFS4_XZ=y

# OpenIPC packages
BR2_PACKAGE_INGENIC_OSDRV_T31=y
BR2_PACKAGE_INGENIC_PATCHER=y
BR2_PACKAGE_IPCTOOL=y
BR2_PACKAGE_JSONFILTER=y
BR2_PACKAGE_LIBEVENT_OPENIPC=y
LIBEVENT_OPENIPC_REMOVE_PYSCRIPT=y
BR2_PACKAGE_MAJESTIC_FONTS=y
BR2_PACKAGE_MAJESTIC=y
BR2_PACKAGE_MICROBE_WEB=y
# BR2_PACKAGE_MOTORS is not set
# BR2_PACKAGE_NABTO is not set
# BR2_PACKAGE_QUIRC_OPENIPC is not set
# BR2_PACKAGE_UACME_OPENIPC is not set
# BR2_PACKAGE_VTUND_OPENIPC is not set
BR2_PACKAGE_YAML_CLI=y
# BR2_PACKAGE_ZEROTIER_ONE is not set
```

## configs/ingenic_t10_defconfig
```kconfig
# OpenIPC Buildroot for Ingenic T10

### Common settings

# Board options
BR2_SOC_INGENIC=y

# Architecture
BR2_mipsel=y
BR2_mips_xburst=y
# BR2_MIPS_SOFT_FLOAT is not set
# BR2_MIPS_FP32_MODE_XX is not set
BR2_MIPS_NAN_LEGACY=y
BR2_MIPS_OABI32=y

# Toolchain
BR2_CCACHE=y
BR2_CCACHE_DIR="$(HOME)/.ccache"
BR2_GCC_VERSION_13_X=y
BR2_PER_PACKAGE_DIRECTORIES=y
BR2_TOOLCHAIN_USES_MUSL=y
BR2_TOOLCHAIN_BUILDROOT_MUSL=y
BR2_TOOLCHAIN_BUILDROOT_VENDOR="openipc"
BR2_TOOLCHAIN_BUILDROOT_LIBC="musl"
# BR2_TOOLCHAIN_BUILDROOT_UCLIBC is not set
# BR2_TOOLCHAIN_BUILDROOT_GLIBC is not set
BR2_EXTRA_GCC_CONFIG_OPTIONS="--with-float=hard"
BR2_TOOLCHAIN_BUILDROOT_CXX=y
BR2_TOOLCHAIN_BUILDROOT_LOCALE=y
BR2_TOOLCHAIN_BUILDROOT_USE_SSP=y

# Kernel
BR2_LINUX_KERNEL=y
BR2_LINUX_KERNEL_CUSTOM_TARBALL=y
BR2_LINUX_KERNEL_CUSTOM_TARBALL_LOCATION="https://github.com/openipc/linux/archive/$(OPENIPC_KERNEL).tar.gz"
BR2_LINUX_KERNEL_USE_CUSTOM_CONFIG=y
BR2_LINUX_KERNEL_UIMAGE=y
BR2_LINUX_KERNEL_LZMA=y
BR2_KERNEL_HEADERS_VERSION=y

# System configuration
BR2_TARGET_GENERIC_HOSTNAME="openipc-$(SOC_MODEL)"
BR2_TARGET_GENERIC_ISSUE="Welcome to OpenIPC"
# BR2_TARGET_TZ_INFO is not set
BR2_ROOTFS_OVERLAY="$(BR2_EXTERNAL)/overlay"
BR2_ROOTFS_POST_BUILD_SCRIPT="$(BR2_EXTERNAL)/scripts/rootfs_script.sh"

BR2_PACKAGE_BUSYBOX_CONFIG="$(BR2_EXTERNAL)/package/busybox/busybox.config"
BR2_GLOBAL_PATCH_DIR="$(BR2_EXTERNAL)/package/all-patches"

# Filesystem
BR2_TARGET_ROOTFS_SQUASHFS=y
BR2_TARGET_ROOTFS_SQUASHFS4_XZ=y

BR2_OPENIPC_SYSTEM_PACKAGES=y

### Platform specific settings

# Board options
BR2_SOC_INGENIC_T10=y
BR2_SOC_INGENIC_T10L=y
BR2_SENSOR_MODEL="jxh42"

# Architecture
BR2_MIPS_FP32_MODE_32=y

# Kernel
BR2_LINUX_KERNEL_CUSTOM_CONFIG_FILE="$(BR2_EXTERNAL)/board/$(SOC_VENDOR)/xburst1/kernel/$(SOC_FAMILY).generic.config"
BR2_DEFAULT_KERNEL_VERSION="3.10.14"
BR2_PACKAGE_HOST_LINUX_HEADERS_CUSTOM_3_10=y

# Wireless
BR2_PACKAGE_LINUX_FIRMWARE_OPENIPC=y
BR2_PACKAGE_LINUX_FIRMWARE_OPENIPC_MEDIATEK_MT7601U=y
BR2_PACKAGE_WIRELESS_TOOLS=y
BR2_PACKAGE_WPA_SUPPLICANT=y
BR2_PACKAGE_WPA_SUPPLICANT_CLI=y
BR2_PACKAGE_WPA_SUPPLICANT_NL80211=y
BR2_PACKAGE_WPA_SUPPLICANT_WEXT=y
BR2_PACKAGE_WPA_SUPPLICANT_PASSPHRASE=y
```

## configs/ingenic_t31_lite_sort_defconfig
```kconfig
BR2_CCACHE_DIR="$(HOME)/.ccache"
BR2_CCACHE=y
BR2_DEFAULT_KERNEL_VERSION="3.10.14"
BR2_EXTRA_GCC_CONFIG_OPTIONS="--with-float=hard"
BR2_GCC_VERSION_13_X=y
BR2_GLOBAL_PATCH_DIR="$(BR2_EXTERNAL)/package/all-patches"
BR2_KERNEL_HEADERS_VERSION=y
BR2_LINUX_KERNEL_CUSTOM_CONFIG_FILE="$(BR2_EXTERNAL)/board/t31/kernel/t31.generic.config"
BR2_LINUX_KERNEL_CUSTOM_TARBALL_LOCATION="https://github.com/openipc/linux/archive/$(OPENIPC_KERNEL).tar.gz"
BR2_LINUX_KERNEL_CUSTOM_TARBALL=y
BR2_LINUX_KERNEL_LZMA=y
BR2_LINUX_KERNEL_UIMAGE=y
BR2_LINUX_KERNEL_USE_CUSTOM_CONFIG=y
BR2_LINUX_KERNEL=y
BR2_mipsel=y
BR2_MIPS_FP32_MODE_32=y
# BR2_MIPS_FP32_MODE_XX is not set
BR2_MIPS_NAN_LEGACY=y
BR2_MIPS_OABI32=y
# BR2_MIPS_SOFT_FLOAT is not set
BR2_mips_xburst=y
BR2_SOC_INGENIC_T31=y
BR2_SOC_INGENIC=y
# BR2_PACKAGE_ATBM60XX is not set
# BR2_PACKAGE_AUTONIGHT is not set
BR2_PACKAGE_BUSYBOX_CONFIG="$(BR2_EXTERNAL)/package/busybox/busybox.config"
# BR2_PACKAGE_CAPJPEG is not set
BR2_PACKAGE_DROPBEAR=y
# BR2_PACKAGE_GDB is not set
# BR2_PACKAGE_HOST_GDB is not set
BR2_PACKAGE_HOST_LINUX_HEADERS_CUSTOM_3_10=y
# BR2_PACKAGE_IFUPDOWN_SCRIPTS is not set
BR2_PACKAGE_INGENIC_LIBIMP_CONTROL=y
# BR2_PACKAGE_INGENIC_MOTORS_T31 is not set
BR2_PACKAGE_INGENIC_OPENSDK=y
BR2_PACKAGE_INGENIC_OSDRV_T31=y
BR2_PACKAGE_INGENIC_PWM=y
BR2_PACKAGE_IPCTOOL=y
BR2_PACKAGE_JSONFILTER=y
# BR2_PACKAGE_LIBCURL_COOKIES_SUPPORT is not set
BR2_PACKAGE_LIBCURL_CURL=y
BR2_PACKAGE_LIBCURL_EXTRA_PROTOCOLS_FEATURES=y
BR2_PACKAGE_LIBCURL_MBEDTLS=y
BR2_PACKAGE_LIBCURL_PROXY_SUPPORT=y
BR2_PACKAGE_LIBCURL_VERBOSE=y
BR2_PACKAGE_LIBCURL=y
# BR2_PACKAGE_LINUX_FIRMWARE_MEDIATEK_MT7601U is not set
BR2_PACKAGE_LINUX_FIRMWARE=y
BR2_PACKAGE_LOGCAT_OPENIPC=y
BR2_PACKAGE_MAJESTIC=y
# BR2_PACKAGE_MBEDTLS_COMPRESSION is not set
BR2_PACKAGE_MBEDTLS_DTLS_SRTP=y
# BR2_PACKAGE_MBEDTLS_PROGRAMS is not set
BR2_PACKAGE_MBEDTLS=y
BR2_PACKAGE_MICROBE_WEB=y
#BR2_PACKAGE_NGINX_HTTP=y
#BR2_PACKAGE_NGINX=y
BR2_PACKAGE_ONVIF_SIMPLE_SERVER=y
BR2_PACKAGE_QUIRC_OPENIPC=y
# BR2_PACKAGE_RTL8188EU is not set
BR2_PACKAGE_RTL8189FS=y
BR2_PACKAGE_UBOOT_TOOLS=y
BR2_PACKAGE_WIRELESS_TOOLS=y
BR2_PACKAGE_WPA_SUPPLICANT_CLI=y
BR2_PACKAGE_WPA_SUPPLICANT_NL80211=y
BR2_PACKAGE_WPA_SUPPLICANT_PASSPHRASE=y
BR2_PACKAGE_WPA_SUPPLICANT=y
BR2_PACKAGE_YAML_CLI=y
BR2_PER_PACKAGE_DIRECTORIES=y
BR2_ROOTFS_OVERLAY="$(BR2_EXTERNAL)/overlay"
BR2_ROOTFS_POST_BUILD_SCRIPT="$(BR2_EXTERNAL)/scripts/rootfs_script.sh"
BR2_TARGET_GENERIC_HOSTNAME="openipc-t31"
BR2_TARGET_GENERIC_ISSUE="Welcome to OpenIPC"
BR2_TARGET_ROOTFS_CPIO=y
BR2_TARGET_ROOTFS_SQUASHFS4_XZ=y
BR2_TARGET_ROOTFS_SQUASHFS=y
# BR2_TARGET_TZ_INFO is not set
BR2_TOOLCHAIN_BUILDROOT_CXX=y
# BR2_TOOLCHAIN_BUILDROOT_GLIBC is not set
BR2_TOOLCHAIN_BUILDROOT_LIBC="musl"
BR2_TOOLCHAIN_BUILDROOT_MUSL=y
# BR2_TOOLCHAIN_BUILDROOT_UCLIBC is not set
BR2_TOOLCHAIN_BUILDROOT_VENDOR="openipc"
BR2_TOOLCHAIN_USES_MUSL=y
```

## configs/modules/a1n_eth_defconfig
```kconfig
# NAME: A1N, SENSOR_DUMMY, ETH
# FRAG: soc-xburst2 toolchain-xburst2 ccache brand rootfs kernel system ssl target uboot
BR2_ETHERNET=y
BR2_SENSOR_DUMMY=y
BR2_SOC_INGENIC_A1N=y
```
