## configs/modules/t10_jxh42_mt7601_defconfig
```kconfig
# FRAG: soc toolchain ccache brand rootfs kernel system target local
BR2_SOC_INGENIC_T10L=y
BR2_SENSOR_MODEL="jxh42"
BR2_PACKAGE_WIFI=y
BR2_PACKAGE_WIFI_MT7601U=y
```

## configs/modules/t10_ov9712_ap6181_defconfig
```kconfig
# NAME: T10, OV9712, AP6181
# FRAG: soc-xburst1 toolchain ccache brand rootfs kernel system target uboot
BR2_PACKAGE_WIFI=y
BR2_PACKAGE_WIFI_SYN4343=y
BR2_SENSOR_OV9712=y
BR2_SOC_INGENIC_T10L=y
```

## configs/modules/t10_ov9732_rtl8188eus_defconfig
```kconfig
# NAME: T10, OV9732, RTL8188EUS
# FRAG: soc-xburst1 toolchain-xburst1 ccache brand rootfs kernel system target uboot ssl
BR2_PACKAGE_WIFI=y
BR2_PACKAGE_WIFI_RTL8188EUS=y
BR2_SENSOR_OV9732=y
BR2_SOC_INGENIC_T10A=y
```

## configs/modules/t10l_jxh42_mt7601_defconfig
```kconfig
# NAME: T10L, JXH42, MT7601
# FRAG: soc-xburst1 toolchain ccache brand rootfs kernel system target uboot
BR2_PACKAGE_WIFI=y
BR2_PACKAGE_WIFI_MT7601U=y
BR2_SENSOR_JXH42=y
BR2_SOC_INGENIC_T10L=y
```

## configs/modules/t20l_jxf22_rtl8189ftv_defconfig
```kconfig
# NAME: T20L, JXF22, RTL8189FTV
# FRAG: soc-xburst1 toolchain ccache brand rootfs kernel system target uboot
BR2_PACKAGE_WIFI=y
BR2_PACKAGE_WIFI_RTL8189FS=y
BR2_SENSOR_JXF22=y
BR2_SOC_INGENIC_T20L=y
```

## configs/modules/t20l_sc2232_eth_defconfig
```kconfig
# NAME: T20L, SC2232, ETH
# FRAG: soc-xburst1 toolchain ccache brand rootfs kernel system target uboot
BR2_ETHERNET=y
BR2_PACKAGE_THINGINO_KOPT_JZ_MAC_V12=y
BR2_SENSOR_SC2232=y
BR2_SOC_INGENIC_T20L=y
```

## configs/modules/t20l_sc2235_eth_rtl8188ftv_defconfig
```kconfig
# NAME: T20L, SC2235, ETH, RTL8188FTV
# FRAG: soc-xburst1 toolchain-xburst1 ccache brand rootfs kernel system target uboot
BR2_ETHERNET=y
BR2_PACKAGE_THINGINO_KOPT_JZ_MAC_V12=y
BR2_PACKAGE_WIFI=y
BR2_PACKAGE_WIFI_RTL8188FU=y
BR2_SENSOR_SC2235=y
BR2_SOC_INGENIC_T20L=y
```
