## configs/modules/t20n_gc1084_atbm6012bx_defconfig
```kconfig
# NAME: T20N, GC1084, ATBM6012BX
# FRAG: soc toolchain ccache brand rootfs kernel system target uboot
BR2_ETHERNET=y
BR2_PACKAGE_WIFI=y
BR2_PACKAGE_WIFI_ATBM6012BX=y
BR2_SENSOR_GC1084=y
BR2_SOC_INGENIC_T20N=y
```

## configs/modules/t20x_jxf22_rtl8189etv_defconfig
```kconfig
# NAME: T20X, JXF22, RTL8189ETV
# FRAG: soc-xburst1 toolchain-xburst1 ccache brand rootfs kernel system target uboot ssl
BR2_PACKAGE_WIFI=y
BR2_PACKAGE_WIFI_RTL8189ES=y
BR2_SENSOR_JXF22=y
BR2_SOC_INGENIC_T20X=y
```

## configs/modules/t20x_jxf23_rtl8189ftv_defconfig
```kconfig
# NAME: T20X, JXF23, RTL8189FTV
# FRAG: soc-xburst1 toolchain-xburst1 ccache brand rootfs kernel system target uboot
BR2_PACKAGE_WIFI=y
BR2_PACKAGE_WIFI_RTL8189FS=y
BR2_SENSOR_JXF23=y
BR2_SOC_INGENIC_T20X=y
```

## configs/modules/t21n_jxf23_rtl8188ftv_defconfig
```kconfig
# NAME: T21N, JXF23, RTL8188FTV
# FRAG: soc-xburst1 toolchain ccache brand rootfs kernel system target uboot
BR2_PACKAGE_WIFI=y
BR2_PACKAGE_WIFI_RTL8188FU=y
BR2_SENSOR_JXF23=y
BR2_SOC_INGENIC_T21N=y
```

## configs/modules/t21n_jxh62_mt7601u_defconfig
```kconfig
# NAME: T21N, JXH62, MT7601U
# FRAG: soc-xburst1 toolchain-xburst1 ccache brand rootfs kernel system target uboot ssl
BR2_PACKAGE_WIFI=y
BR2_PACKAGE_WIFI_MT7601U=y
BR2_SENSOR_JXH62=y
BR2_SOC_INGENIC_T21N=y
```

## configs/modules/t21n_os02b10_mt7601u_defconfig
```kconfig
# NAME: T21N, OS02B10, MT7601U
# FRAG: soc-xburst1 toolchain ccache brand rootfs kernel system target uboot
BR2_PACKAGE_WIFI=y
BR2_PACKAGE_WIFI_MT7601U=y
BR2_SENSOR_OS02B10=y
BR2_SOC_INGENIC_T21N=y
```

## configs/modules/t21n_ov2735b_mt7601u_defconfig
```kconfig
# NAME: T21N, OV2735B, MT7601U
# FRAG: soc-xburst1 toolchain-xburst1 ccache brand rootfs kernel system target uboot ssl
BR2_PACKAGE_WIFI=y
BR2_PACKAGE_WIFI_MT7601U=y
BR2_SENSOR_OV2735B=y
BR2_SOC_INGENIC_T21N=y
```

## configs/modules/t21n_ov2735b_rtl8188ftv_defconfig
```kconfig
# NAME: T21N, OV2735B, RTL8188FTV
# FRAG: soc-xburst1 toolchain ccache brand rootfs kernel system target uboot
BR2_PACKAGE_WIFI=y
BR2_PACKAGE_WIFI_RTL8188FU=y
BR2_SENSOR_OV2735B=y
BR2_SOC_INGENIC_T21N=y
```

## configs/modules/t21n_ps5260_mt7601sta_defconfig
```kconfig
# NAME: T21N, PS5260, MT7601U
# FRAG: soc-xburst1 toolchain-xburst1 ccache brand rootfs kernel system target uboot ssl
BR2_PACKAGE_WIFI=y
BR2_PACKAGE_WIFI_MT7601U=y
BR2_SENSOR_PS5260=y
BR2_SOC_INGENIC_T21N=y
```

## configs/modules/t21n_sc2300_rtl8188ftv_defconfig
```kconfig
# NAME: T21N, SC2300, RTL8188FTV
# FRAG: soc-xburst1 toolchain ccache brand rootfs kernel system target uboot
BR2_PACKAGE_WIFI=y
BR2_PACKAGE_WIFI_RTL8188FU=y
BR2_SENSOR_SC2300=y
BR2_SOC_INGENIC_T21N=y
```

## configs/modules/t23dl_jxh63p_txw901u_defconfig
```kconfig
# NAME: T23DL, JXH63P, TXW901U
# FRAG: soc-xburst1 toolchain-xburst1 ccache brand rootfs kernel system target uboot ssl
BR2_SOC_INGENIC_T23DL=y
BR2_SENSOR_JXH63P=y
BR2_PACKAGE_WIFI=y
BR2_PACKAGE_WIFI_TXW901U=y
```

## configs/modules/t23n_cv2003_atbm6132u_defconfig
```kconfig
# NAME: T23N, CV2003, ATBM6132U
# FRAG: soc toolchain ccache brand rootfs kernel system target uboot
BR2_SOC_INGENIC_T23N=y
BR2_SENSOR_SV2003=y
BR2_PACKAGE_WIFI=y
BR2_PACKAGE_WIFI_ATBM6132U=y
```

## configs/modules/t23n_gc1084_atbm6012b_defconfig
```kconfig
# NAME: T23N, GC1084, ATBM6012B
# FRAG: soc-xburst1 toolchain ccache brand rootfs kernel system target uboot
BR2_SENSOR_GC1084=y
BR2_PACKAGE_WIFI=y
BR2_PACKAGE_WIFI_ATBM6012B=y
BR2_SOC_INGENIC_T23N=y
```

## configs/modules/t23n_gc2083_ssv6355_defconfig
```kconfig
# NAME: T23N, GC2083, SSV6355
# FRAG: soc-xburst1 toolchain-xburst1 ccache brand rootfs kernel system target uboot
BR2_PACKAGE_WIFI=y
BR2_PACKAGE_WIFI_SSV6X5X=y
BR2_PACKAGE_WIFI_SSV6X5X_SV6355=y
BR2_SENSOR_GC2083=y
BR2_SOC_INGENIC_T23N=y
```

## configs/modules/t23n_sc1a4t_atbm6012bx_defconfig
```kconfig
# NAME: T23N, SC1A4T, ATBM6012BX
# FRAG: soc-xburst1 toolchain ccache brand rootfs kernel system target uboot
BR2_PACKAGE_WIFI=y
BR2_PACKAGE_WIFI_ATBM6012BX=y
BR2_SENSOR_SC1A4T=y
BR2_SOC_INGENIC_T23N=y
```

## configs/modules/t23n_sc1a4t_eth_atbm6012bx_defconfig
```kconfig
# NAME: T23N, SC1A4T, ETH, ATBM6012BX
# FRAG: soc-xburst1 toolchain-xburst1 ccache brand rootfs kernel system target uboot ssl
BR2_ETHERNET=y
BR2_PACKAGE_WIFI=y
BR2_PACKAGE_WIFI_ATBM6012BX=y
BR2_SENSOR_SC1A4T=y
BR2_SOC_INGENIC_T23N=y
```

## configs/modules/t23n_sc1a4t_ssv6355_defconfig
```kconfig
# NAME: T23N, SC1A4T, SSV6355
# FRAG: soc-xburst1 toolchain-xburst1 ccache brand rootfs kernel system target uboot
BR2_PACKAGE_WIFI=y
BR2_PACKAGE_WIFI_SSV6X5X=y
BR2_PACKAGE_WIFI_SSV6X5X_SV6355=y
BR2_SENSOR_SC1A4T=y
BR2_SOC_INGENIC_T23N=y
```

## configs/modules/t23n_sc2331_atbm6012bx_defconfig
```kconfig
# NAME: T23N, SC2331, ATBM6012BX
# FRAG: soc toolchain ccache brand rootfs kernel system target uboot
BR2_PACKAGE_WIFI=y
BR2_PACKAGE_WIFI_ATBM6012BX=y
BR2_SENSOR_SC2331=y
BR2_SOC_INGENIC_T23N=y
```

## configs/modules/t23n_sc2336_atbm6062_defconfig
```kconfig
# NAME: T23N, SC2336, ATBM6062U
# FRAG: soc-xburst1 toolchain ccache brand rootfs kernel system target uboot
BR2_PACKAGE_WIFI=y
BR2_PACKAGE_WIFI_ATBM6062U=y
BR2_SENSOR_SC2336=y
BR2_SOC_INGENIC_T23N=y
```

## configs/modules/t23n_sc2336_atbm6132u_defconfig
```kconfig
# NAME: T23N, SC2336, ATBM6132U
# FRAG: soc toolchain ccache brand rootfs kernel system target uboot
BR2_PACKAGE_WIFI=y
BR2_PACKAGE_WIFI_ATBM6132U=y
BR2_SENSOR_SC2336=y
BR2_SOC_INGENIC_T23N=y
```

## configs/modules/t23n_sc2336p_atbm6062_defconfig
```kconfig
# NAME: T23N, SC2336, ATBM6062U
# FRAG: soc-xburst1 toolchain-xburst1 ccache brand rootfs kernel system target uboot ssl
BR2_PACKAGE_WIFI=y
BR2_PACKAGE_WIFI_ATBM6062U=y
BR2_SENSOR_SC2336P=y
BR2_SOC_INGENIC_T23N=y
```

## configs/modules/t23n_sc2336p_eth_atbm6132u_defconfig
```kconfig
# NAME: T23N, SC2336P, ETH, ATBM6132U
# FRAG: soc-xburst1 toolchain-xburst1 ccache brand rootfs kernel system target uboot ssl
BR2_ETHERNET=y
BR2_PACKAGE_WIFI=y
BR2_PACKAGE_WIFI_ATBM6132U=y
BR2_SENSOR_SC2336P=y
BR2_SOC_INGENIC_T23N=y
```

## configs/modules/t23n_sc2336p_rtl8188ftv_defconfig
```kconfig
# NAME: T23N, SC2336P, RTL8188FTV
# FRAG: soc-xburst1 toolchain-xburst1 ccache brand rootfs kernel system target uboot
BR2_SOC_INGENIC_T23N=y
BR2_SENSOR_SC2336P=y
BR2_PACKAGE_WIFI=y
BR2_PACKAGE_WIFI_RTL8188FU=y
```

## configs/modules/t23n_sc2336p_wq9001_defconfig
```kconfig
# NAME: T23N, SC2336P, WQ9001
# FRAG: soc-xburst1 toolchain-xburst1 ccache brand rootfs kernel system target uboot
BR2_SOC_INGENIC_T23N=y
BR2_SENSOR_SC2336P=y
BR2_PACKAGE_WIFI=y
BR2_PACKAGE_WIFI_WQ9001=y
```

## configs/modules/t23n_sc3332p_ws73v100_defconfig
```kconfig
# NAME: T23N, SC333wP, WS73V100
# FRAG: soc-xburst1 toolchain-xburst1 ccache brand rootfs kernel system target uboot ssl
BR2_PACKAGE_WIFI=y
BR2_PACKAGE_WIFI_WS73V100=y
BR2_PACKAGE_WIFI_WS73V100_USB=y
BR2_SENSOR_SC3332P=y
BR2_SOC_INGENIC_T23N=y
```
