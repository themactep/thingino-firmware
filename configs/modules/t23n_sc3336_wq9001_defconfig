## configs/modules/t23n_sc3336_wq9001_defconfig
```kconfig
# NAME: T23N, SC3336, WQ9001
# FRAG: soc-xburst1 toolchain ccache brand rootfs kernel system target uboot
BR2_SOC_INGENIC_T23N=y
BR2_SENSOR_SC3336=y
BR2_PACKAGE_WIFI=y
BR2_PACKAGE_WIFI_WQ9001=y
```

## configs/modules/t30x_sc2235_rtl8189ftv_defconfig
```kconfig
# NAME: T30X, SC2235, RTL8189FTV
# FRAG: soc-xburst1 toolchain-xburst1 ccache brand rootfs kernel system target uboot ssl
BR2_PACKAGE_WIFI=y
BR2_PACKAGE_WIFI_RTL8189FS=y
BR2_SENSOR_SC2235=y
BR2_SOC_INGENIC_T30X=y
```

## configs/modules/t30x_sc4236_eth_defconfig
```kconfig
# NAME: T30X, SC4236, ETH
# FRAG: soc-xburst1 toolchain-xburst1 ccache brand rootfs kernel system target uboot
BR2_ETHERNET=y
BR2_PACKAGE_THINGINO_KOPT_JZ_MAC_V12=y
BR2_SENSOR_SC4236=y
BR2_SOC_INGENIC_T30X=y
```

## configs/modules/t31a_gc2053_defconfig
```kconfig
# NAME: T31A, GC2053
# FRAG: soc-xburst1 toolchain-xburst1 ccache brand rootfs kernel system target uboot ssl
BR2_SENSOR_GC2053=y
BR2_SOC_INGENIC_T31A=y
```

## configs/modules/t31al_gc2053_atbm6031_defconfig
```kconfig
# FRAG: soc toolchain ccache brand rootfs kernel system target uboot
BR2_SOC_INGENIC_T31AL=y
BR2_SENSOR_GC2053=y
BR2_PACKAGE_WIFI=y
BR2_PACKAGE_WIFI_ATBM6031=y
```

## configs/modules/t31l_gc2053_atbm6031_defconfig
```kconfig
# NAME: T31L, GC2053, ATBM6031
# FRAG: soc-xburst1 toolchain-xburst1 ccache brand rootfs kernel system target uboot
BR2_PACKAGE_WIFI=y
BR2_PACKAGE_WIFI_ATBM6031=y
BR2_SENSOR_GC2053=y
BR2_SOC_INGENIC_T31L=y
```

## configs/modules/t31l_gc2083_eth_defconfig
```kconfig
# FRAG: soc toolchain ccache brand rootfs kernel system target uboot
BR2_SOC_INGENIC_T31L=y
BR2_SENSOR_GC2083=y
```

## configs/modules/t31l_gc2083_ssv6155_defconfig
```kconfig
# NAME: T31L, GC2083, SSV6155
# FRAG: soc-xburst1 toolchain ccache brand rootfs kernel system target uboot
BR2_PACKAGE_WIFI=y
BR2_PACKAGE_WIFI_SSV6X5X=y
BR2_PACKAGE_WIFI_SSV6X5X_SV6155P=y
BR2_SENSOR_GC2083=y
BR2_SOC_INGENIC_T31L=y
```

## configs/modules/t31l_imx307_eth_defconfig
```kconfig
# NAME: T31L, IMX307, ETH
# FRAG: soc-xburst1 toolchain-xburst1 ccache brand rootfs kernel system target uboot
BR2_ETHERNET=y
BR2_PACKAGE_THINGINO_KOPT_JZ_MAC_V13=y
BR2_SENSOR_IMX307=y
BR2_SOC_INGENIC_T31L=y
```

## configs/modules/t31l_jxf37_rtl8188ftv_defconfig
```kconfig
# NAME: T31L, JXF37, RTL8188FTV
# FRAG: soc-xburst1 toolchain-xburst1 ccache brand rootfs kernel system target uboot
BR2_PACKAGE_WIFI=y
BR2_PACKAGE_WIFI_RTL8188FU=y
BR2_SENSOR_JXF37=y
BR2_SOC_INGENIC_T31L=y
```

## configs/modules/t31l_jxh62_rtl8188ftv_defconfig
```kconfig
# NAME: T31L, JXH62, RTL8188FTV
# FRAG: soc-xburst1 toolchain ccache brand rootfs kernel system target uboot
BR2_PACKAGE_WIFI=y
BR2_PACKAGE_WIFI_RTL8188FU=y
BR2_SENSOR_JXH62=y
BR2_SOC_INGENIC_T31L=y
```

## configs/modules/t31l_os02g10_atbm6031_defconfig
```kconfig
# NAME: T31L, OS02G10, ATBM6031
# FRAG: soc-xburst1 toolchain-xburst1 ccache brand rootfs kernel system target uboot
BR2_PACKAGE_WIFI=y
BR2_PACKAGE_WIFI_ATBM6031=y
BR2_SENSOR_OS02G10=y
BR2_SOC_INGENIC_T31L=y
```

## configs/modules/t31l_sc2336_atbm6012bx_defconfig
```kconfig
# NAME: T31L, SC2336, ATBM6012BX
# FRAG: soc-xburst1 toolchain ccache brand rootfs kernel system target uboot
BR2_PACKAGE_WIFI=y
BR2_PACKAGE_WIFI_ATBM6012BX=y
BR2_SENSOR_SC2336=y
BR2_SOC_INGENIC_T31L=y
```

## configs/modules/t31l_sc2336_atbm6031_defconfig
```kconfig
# FRAG: soc toolchain ccache brand rootfs kernel system target local
BR2_SOC_INGENIC_T31L=y
BR2_SENSOR_MODEL="sc2336"
BR2_PACKAGE_WIFI=y
BR2_PACKAGE_WIFI_ATBM6031=y
CONFIG_KERNEL_VERSION_4=y
KERNEL_VERSION_4=y
BR2_KERNEL_VERSION_4=y
```

## configs/modules/t31l_sc3336_atbm6012b_defconfig
```kconfig
# NAME: T31L, SC3336, ATBM6012B
# FRAG: soc-xburst1 toolchain-xburst1 ccache brand rootfs kernel system target uboot ssl
BR2_SOC_INGENIC_T31L=y
BR2_SENSOR_SC3336=y
BR2_PACKAGE_WIFI=y
BR2_PACKAGE_WIFI_ATBM6012B=y
```

## configs/modules/t31l_sc3336_atbm6012bx_defconfig
```kconfig
# NAME: T31L, SC3336, ATBM6012BX
# FRAG: soc-xburst1 toolchain-xburst1 ccache brand rootfs kernel system target uboot
BR2_SOC_INGENIC_T31L=y
BR2_SENSOR_SC3336=y
BR2_PACKAGE_WIFI=y
BR2_PACKAGE_WIFI_ATBM6012BX=y
```

## configs/modules/t31l_sc3336_rtl8188ftv_defconfig
```kconfig
# NAME: T31L, SC3336, RTL8188FTV
# FRAG: soc-xburst1 toolchain-xburst1 ccache brand rootfs kernel system target uboot ssl
BR2_PACKAGE_WIFI=y
BR2_PACKAGE_WIFI_RTL8188FU=y
BR2_SENSOR_SC3336=y
BR2_SOC_INGENIC_T31L=y
```

## configs/modules/t31l_sc3336_rtl8188fu_defconfig
```kconfig
# FRAG: soc toolchain ccache brand rootfs kernel system target local
BR2_SOC_INGENIC_T31L=y
BR2_SENSOR_MODEL="sc3336"
BR2_PACKAGE_WIFI=y
BR2_PACKAGE_WIFI_RTL8188FU=y
```

## configs/modules/t31l_sc3338_rtl8188ftv_defconfig
```kconfig
# NAME: T31L, SC3338, RTL8188FTV
# FRAG: soc-xburst1 toolchain-xburst1 ccache brand rootfs kernel system target uboot
BR2_PACKAGE_WIFI=y
BR2_PACKAGE_WIFI_RTL8188FU=y
BR2_SENSOR_SC3338=y
BR2_SOC_INGENIC_T31L=y
```

## configs/modules/t31lc_gc1084_hi3881_defconfig
```kconfig
# NAME: T31LC, GC1084, HI3881
# FRAG: soc-xburst1 toolchain ccache brand rootfs kernel system target uboot
BR2_PACKAGE_WIFI=y
BR2_PACKAGE_WIFI_HI3881=y
BR2_SENSOR_GC1084=y
BR2_SOC_INGENIC_T31LC=y
BR2_PACKAGE_THINGINO_UBOOT_FORMAT_CUSTOM_NAME="u-boot-with-spl.bin"
```

## configs/modules/t31lc_sc2336_atbm6012b_defconfig
```kconfig
# NAME: T31LC, SC2336, ATBM6012B
# FRAG: soc-xburst1 toolchain ccache brand rootfs kernel system target uboot
BR2_PACKAGE_WIFI=y
BR2_PACKAGE_WIFI_ATBM6012B=y
BR2_SENSOR_SC2336=y
BR2_SOC_INGENIC_T31LC=y
BR2_PACKAGE_THINGINO_UBOOT_FORMAT_CUSTOM_NAME="u-boot-with-spl.bin"
```

## configs/modules/t31n_gc1084_sv6355_defconfig
```kconfig
# FRAG: soc toolchain ccache brand rootfs kernel system target uboot
BR2_SOC_INGENIC_T31N=y
BR2_SENSOR_GC1084=y
BR2_PACKAGE_WIFI=y
BR2_PACKAGE_WIFI_SSV6X5X=y
```

## configs/modules/t31n_gc2053_eth_defconfig
```kconfig
# NAME: T31N, GC2053, ETH
# FRAG: soc-xburst1 toolchain-xburst1 ccache brand rootfs kernel system target uboot ssl
BR2_ETHERNET=y
BR2_PACKAGE_THINGINO_KOPT_JZ_MAC_V13=y
BR2_SENSOR_GC2053=y
BR2_SOC_INGENIC_T31N=y
```

## configs/modules/t31n_gc2053_ssv6155_defconfig
```kconfig
# NAME: T31N, GC2053, SSV6155
# FRAG: soc-xburst1 toolchain ccache brand rootfs kernel system target uboot
#Ethernet functionality TBD
BR2_ETHERNET=y
BR2_PACKAGE_THINGINO_KOPT_JZ_MAC_V13=y
BR2_PACKAGE_THINGINO_KOPT_JZ_MAC_CLK_25MHZ=y
BR2_PACKAGE_WIFI=y
BR2_PACKAGE_WIFI_SSV6X5X=y
BR2_PACKAGE_WIFI_SSV6X5X_SV6155P=y
BR2_SENSOR_GC2053=y
BR2_SOC_INGENIC_T31N=y
```

## configs/modules/t31n_gc2063_eth_defconfig
```kconfig
# FRAG: soc toolchain ccache brand rootfs kernel system target local
BR2_SOC_INGENIC_T31N=y
BR2_SENSOR_MODEL="gc2063"
```
