## configs/modules/t31x_sc5235_eth_rtl8731bu_defconfig
```kconfig
# NAME: T31X, SC5235, ETH, RTL8731BU
# FRAG: soc-xburst1 toolchain ccache brand rootfs kernel system target uboot
BR2_ETHERNET=y
BR2_SENSOR_SC5235=y
BR2_SOC_INGENIC_T31X=y
BR2_PACKAGE_WIFI=y
BR2_PACKAGE_WIFI_RTL8733BU=y
BR2_PACKAGE_THINGINO_KOPT_JZ_MAC_V13=y
```

## configs/modules/t31zx_imx327_eth_defconfig
```kconfig
# NAME: T31ZX, IMX327, ETH
# FRAG: soc-xburst1 toolchain ccache brand rootfs kernel system target uboot
BR2_ETHERNET=y
BR2_PACKAGE_THINGINO_KOPT_JZ_MAC_V13=y
BR2_SENSOR_IMX327=y
BR2_SOC_INGENIC_T31ZX=y
```

## configs/modules/t40n_imx307_eth_defconfig
```kconfig
# NAME: T40N, IMX307, ETH
# FRAG: soc-xburst2 toolchain-xburst2 ccache brand rootfs kernel system target uboot
BR2_ETHERNET=y
BR2_SENSOR_IMX307=y
BR2_SOC_INGENIC_T40N=y
```

## configs/modules/t40nn_gc5603_eth_defconfig
```kconfig
# NAME: T40NN, GC5603, ETH
# FRAG: soc-xburst2 toolchain-xburst2 ccache brand rootfs kernel system target uboot
BR2_ETHERNET=y
BR2_SENSOR_GC5603=y
BR2_THINGINO_RMEM_64=y
BR2_SOC_INGENIC_T40NN=y
```

## configs/modules/t41nq_gc4023_aic8800d_defconfig
```kconfig
# NAME: T41NQ, GC4023, AIC8800
# FRAG: soc-xburst2 toolchain-xburst2 ccache brand rootfs kernel system target uboot ssl
BR2_SENSOR_GC4023=y
BR2_SOC_INGENIC_T41NQ=y
BR2_PACKAGE_THINGINO_UBOOT_FLASH_CONTROLLER_JZ_SFC=n
BR2_PACKAGE_THINGINO_UBOOT_FLASH_CONTROLLER_SFC0_NOR=y
BR2_PACKAGE_WIFI=y
BR2_PACKAGE_WIFI_AIC8800=y
BR2_PACKAGE_WIFI_AIC8800_USB=y
```

## configs/t20l_sc2232_eth_defconfig
```kconfig
# FRAG: soc toolchain ccache brand rootfs kernel system target local
BR2_SOC_INGENIC_T20L=y
BR2_SENSOR_MODEL="sc2232"
```

## configs/t20x_jxf22_rtl8189etv_defconfig
```kconfig
# FRAG: toolchain ccache soc kernel rootfs system brand
BR2_SOC_INGENIC_T20X=y
BR2_SENSOR_MODEL="jxf22"
BR2_THINGINO_DEV_PACKAGES=y
BR2_PACKAGE_MOTORS=y
BR2_PACKAGE_WIFI=y
BR2_PACKAGE_WIFI_RTL8189ES=y
```

## configs/t21n_jxh62_mt7601u_defconfig
```kconfig
# FRAG: toolchain ccache soc kernel rootfs system brand
BR2_SOC_INGENIC_T21N=y
BR2_SENSOR_MODEL="jxh62"
BR2_PACKAGE_WIFI=y
BR2_PACKAGE_WIFI_MT7601U=y
```

## configs/t21n_ov2735b_8188fu_defconfig
```kconfig
# FRAG: soc toolchain ccache brand rootfs kernel system target
BR2_SOC_INGENIC_T21N=y
BR2_SENSOR_MODEL="ov2735b"
BR2_PACKAGE_WIFI=y
BR2_PACKAGE_WIFI_RTL8188FU=y
BR2_PACKAGE_MOTORS=y
```

## configs/t21n_ov2735b_mt7601u_defconfig
```kconfig
# FRAG: soc toolchain ccache brand rootfs kernel system target
BR2_SOC_INGENIC_T21N=y
BR2_SENSOR_MODEL="ov2735b"
BR2_PACKAGE_WIFI=y
BR2_PACKAGE_WIFI_MT7601U=y
```

## configs/t21z_sc2300_rtl8188ftv_defconfig
```kconfig
# FRAG: soc toolchain ccache brand rootfs kernel system target
BR2_SOC_INGENIC_T21Z=y
BR2_SENSOR_MODEL="sc2300"
BR2_PACKAGE_WIFI=y
BR2_PACKAGE_WIFI_RTL8188FU=y
```

## configs/t23n_sc2336_atbm6012b_defconfig
```kconfig
# FRAG: soc toolchain ccache brand rootfs kernel system target local
BR2_SOC_INGENIC_T23N=y
BR2_SENSOR_MODEL="sc2336"
BR2_PACKAGE_WIFI=y
BR2_PACKAGE_WIFI_ATBM6012B=y
BR2_PACKAGE_MOTORS=y
```

## configs/t31al_gc2053_atbm6031_defconfig
```kconfig
# FRAG: soc toolchain ccache brand rootfs kernel system target local
BR2_SOC_INGENIC_T31AL=y
BR2_SENSOR_MODEL="gc2053"
BR2_PACKAGE_WIFI=y
BR2_PACKAGE_WIFI_ATBM6031=y
```

## configs/t31l_gc2083_eth_defconfig
```kconfig
# FRAG: soc toolchain ccache brand rootfs kernel system target
BR2_SOC_INGENIC_T31L=y
BR2_SENSOR_MODEL="gc2083"
BR2_PACKAGE_MOTORS=y
```

## configs/t31l_sc2336_atbm6031_defconfig
```kconfig
# FRAG: soc toolchain ccache brand rootfs kernel system target
BR2_SOC_INGENIC_T31L=y
BR2_SENSOR_MODEL="sc2336"
BR2_PACKAGE_WIFI=y
BR2_PACKAGE_WIFI_ATBM6031=y
BR2_PACKAGE_MOSQUITTO=y
BR2_PACKAGE_MOTORS=y
```

## configs/t31lc_sc2336_atbm6012b_defconfig
```kconfig
# FRAG: soc toolchain ccache brand rootfs kernel system target
BR2_SOC_INGENIC_T31LC=y
BR2_SENSOR_MODEL="sc2336"
BR2_PACKAGE_WIFI=y
BR2_PACKAGE_WIFI_ATBM6012B=y
BR2_PACKAGE_MOSQUITTO=y
BR2_PACKAGE_MOTORS=y
```

## configs/t31x_gc2053_atbm6031_defconfig
```kconfig
# FRAG: soc toolchain ccache brand rootfs kernel system target local
BR2_SOC_INGENIC_T31X=y
BR2_SENSOR_MODEL="gc2053"
BR2_PACKAGE_WIFI=y
BR2_PACKAGE_WIFI_ATBM6031=y
BR2_PACKAGE_MOSQUITTO=y
BR2_PACKAGE_MOTORS=y
```

## configs/t31x_jxk04_eth_defconfig
```kconfig
# FRAG: toolchain ccache soc kernel rootfs system brand
BR2_SOC_INGENIC_T31X=y
BR2_SENSOR_MODEL="jxk04"
```

## configs/testing/exp_k4_cinnado_d1_t31l_sc2336_atbm6031_defconfig
```kconfig
# MODULE: t31l_sc2336_atbm6031_defconfig
FLASH_SIZE_8=y
U_BOOT_ENV_TXT="$(BR2_EXTERNAL)/environment/cinnado-d1-t31l.k4.uenv.txt"
BR2_PACKAGE_MOSQUITTO=y
BR2_PACKAGE_MOTORS=y
KERNEL_VERSION_4=y
#CONFIG_KERNEL_VERSION_4=y
#BR2_KERNEL_VERSION_4=y
```

## configs/testing/exp_t10_ov9712_ap6181_defconfig
```kconfig
# FRAG: soc toolchain ccache brand rootfs kernel system target local
BR2_SOC_INGENIC_T10L=y
BR2_SENSOR_MODEL="ov9712"
FLASH_SIZE_16=y
```

## configs/testing/t21n_os02g10_rtl8188ftv_defconfig
```kconfig
# FRAG: soc toolchain ccache brand rootfs kernel system target
BR2_SOC_INGENIC_T21N=y
BR2_SENSOR_OS02B10=y
BR2_PACKAGE_WIFI=y
BR2_PACKAGE_WIFI_RTL8188FU=y
FLASH_SIZE_16=y
```

## general/Config.in
```kconfig
menu "OpenIPC firmware"

choice
	prompt "SoC Vendor"
config BR2_OPENIPC_SOC_ALLWINNER
	bool "Allwinner"
config BR2_OPENIPC_SOC_AMBARELLA
	bool "Ambarella"
config BR2_OPENIPC_SOC_ANYKA
	bool "Anyka"
config BR2_OPENIPC_SOC_FULLHAN
	bool "Fullhan"
config BR2_OPENIPC_SOC_GOKE
	bool "Goke"
config BR2_OPENIPC_SOC_GRAINMEDIA
	bool "GrainMedia"
config BR2_OPENIPC_SOC_HISILICON
	bool "HiSilicon"
config BR2_OPENIPC_SOC_INGENIC
	bool "Ingenic"
config BR2_OPENIPC_SOC_NOVATEK
	bool "Novatek"
config BR2_OPENIPC_SOC_ROCKCHIP
	bool "Rockchip"
config BR2_OPENIPC_SOC_SIGMASTAR
	bool "Sigmastar & MStar"
config BR2_OPENIPC_SOC_TI
	bool "Texas Instruments"
config BR2_OPENIPC_SOC_XIONGMAI
	bool "Xiongmai"
endchoice

choice
	prompt "SoC Model"
config BR2_OPENIPC_SOC_ALLWINNER_V83X
	bool "V83x"
	depends on BR2_OPENIPC_SOC_ALLWINNER
config BR2_OPENIPC_SOC_AMBARELLA_S2L
	bool "S2L"
	depends on BR2_OPENIPC_SOC_AMBARELLA
config BR2_OPENIPC_SOC_AMBARELLA_S3L
	bool "S3L"
	depends on BR2_OPENIPC_SOC_AMBARELLA
config BR2_OPENIPC_SOC_ANYKA_AK3916EV300
	bool "AK3916EV300"
	depends on BR2_OPENIPC_SOC_ANYKA
config BR2_OPENIPC_SOC_ANYKA_AK3918EV300
	bool "AK3918EV300"
	depends on BR2_OPENIPC_SOC_ANYKA
config BR2_OPENIPC_SOC_FULLHAN_FH8833V100
	bool "FH8833V100"
	depends on BR2_OPENIPC_SOC_FULLHAN
config BR2_OPENIPC_SOC_FULLHAN_FH8852V100
	bool "FH8852V100"
	depends on BR2_OPENIPC_SOC_FULLHAN
config BR2_OPENIPC_SOC_FULLHAN_FH8852V200
	bool "FH8852V200"
	depends on BR2_OPENIPC_SOC_FULLHAN
config BR2_OPENIPC_SOC_FULLHAN_FH8852V210
	bool "FH8852V210"
	depends on BR2_OPENIPC_SOC_FULLHAN
config BR2_OPENIPC_SOC_FULLHAN_FH8856V100
	bool "FH8856V100"
	depends on BR2_OPENIPC_SOC_FULLHAN
config BR2_OPENIPC_SOC_FULLHAN_FH8856V200
	bool "FH8856V200"
	depends on BR2_OPENIPC_SOC_FULLHAN
config BR2_OPENIPC_SOC_FULLHAN_FH8856V210
	bool "FH8856V210"
	depends on BR2_OPENIPC_SOC_FULLHAN
config BR2_OPENIPC_SOC_FULLHAN_FH8858V200
	bool "FH8858V200"
	depends on BR2_OPENIPC_SOC_FULLHAN
config BR2_OPENIPC_SOC_FULLHAN_FH8858V210
	bool "FH8858V210"
	depends on BR2_OPENIPC_SOC_FULLHAN
config BR2_OPENIPC_SOC_GOKE_GK7102
	bool "GK7102"
	depends on BR2_OPENIPC_SOC_GOKE
config BR2_OPENIPC_SOC_GOKE_GK7102S
	bool "GK7102S"
	depends on BR2_OPENIPC_SOC_GOKE
config BR2_OPENIPC_SOC_GOKE_GK7202V300
	bool "GK7202V300"
	depends on BR2_OPENIPC_SOC_GOKE
config BR2_OPENIPC_SOC_GOKE_GK7205V200
	bool "GK7205V200"
	depends on BR2_OPENIPC_SOC_GOKE
config BR2_OPENIPC_SOC_GOKE_GK7205V210
	bool "GK7205V210"
	depends on BR2_OPENIPC_SOC_GOKE
config BR2_OPENIPC_SOC_GOKE_GK7205V300
	bool "GK7205V300"
	depends on BR2_OPENIPC_SOC_GOKE
config BR2_OPENIPC_SOC_GOKE_GK7605V100
	bool "GK7605V100"
	depends on BR2_OPENIPC_SOC_GOKE
config BR2_OPENIPC_SOC_GRAINMEDIA_GM8135
	bool "GM8135"
	depends on BR2_OPENIPC_SOC_GRAINMEDIA
config BR2_OPENIPC_SOC_GRAINMEDIA_GM8136
	bool "GM8136"
	depends on BR2_OPENIPC_SOC_GRAINMEDIA
config BR2_OPENIPC_SOC_HISILICON_HI3516AV100
	bool "HI3516AV100"
	depends on BR2_OPENIPC_SOC_HISILICON
config BR2_OPENIPC_SOC_HISILICON_HI3516AV200
	bool "HI3516AV200"
	depends on BR2_OPENIPC_SOC_HISILICON
config BR2_OPENIPC_SOC_HISILICON_HI3516AV300
	bool "HI3516AV300"
	depends on BR2_OPENIPC_SOC_HISILICON
config BR2_OPENIPC_SOC_HISILICON_HI3516CV100
	bool "HI3516CV100"
	depends on BR2_OPENIPC_SOC_HISILICON
config BR2_OPENIPC_SOC_HISILICON_HI3516CV200
	bool "HI3516CV200"
	depends on BR2_OPENIPC_SOC_HISILICON
config BR2_OPENIPC_SOC_HISILICON_HI3516CV300
	bool "HI3516CV300"
	depends on BR2_OPENIPC_SOC_HISILICON
config BR2_OPENIPC_SOC_HISILICON_HI3516CV500
	bool "HI3516CV500"
	depends on BR2_OPENIPC_SOC_HISILICON
config BR2_OPENIPC_SOC_HISILICON_HI3516DV100
	bool "HI3516DV100"
	depends on BR2_OPENIPC_SOC_HISILICON
config BR2_OPENIPC_SOC_HISILICON_HI3516DV200
	bool "HI3516DV200"
	depends on BR2_OPENIPC_SOC_HISILICON
config BR2_OPENIPC_SOC_HISILICON_HI3516DV300
	bool "HI3516DV300"
	depends on BR2_OPENIPC_SOC_HISILICON
config BR2_OPENIPC_SOC_HISILICON_HI3516EV100
	bool "HI3516EV100"
	depends on BR2_OPENIPC_SOC_HISILICON
config BR2_OPENIPC_SOC_HISILICON_HI3516EV200
	bool "HI3516EV200"
	depends on BR2_OPENIPC_SOC_HISILICON
config BR2_OPENIPC_SOC_HISILICON_HI3516EV300
	bool "HI3516EV300"
	depends on BR2_OPENIPC_SOC_HISILICON
config BR2_OPENIPC_SOC_HISILICON_HI3518CV100
	bool "HI3518CV100"
	depends on BR2_OPENIPC_SOC_HISILICON
config BR2_OPENIPC_SOC_HISILICON_HI3518EV100
	bool "HI3518EV100"
	depends on BR2_OPENIPC_SOC_HISILICON
config BR2_OPENIPC_SOC_HISILICON_HI3518EV200
	bool "HI3518EV200"
	depends on BR2_OPENIPC_SOC_HISILICON
config BR2_OPENIPC_SOC_HISILICON_HI3518EV201
	bool "HI3518EV201"
	depends on BR2_OPENIPC_SOC_HISILICON
config BR2_OPENIPC_SOC_HISILICON_HI3518EV300
	bool "HI3518EV300"
	depends on BR2_OPENIPC_SOC_HISILICON
config BR2_OPENIPC_SOC_HISILICON_HI3519V101
	bool "HI3519V101"
	depends on BR2_OPENIPC_SOC_HISILICON
config BR2_OPENIPC_SOC_HISILICON_HI3520DV200
	bool "HI3520DV200"
	depends on BR2_OPENIPC_SOC_HISILICON
config BR2_OPENIPC_SOC_HISILICON_HI3536CV100
	bool "HI3536CV100"
	depends on BR2_OPENIPC_SOC_HISILICON
config BR2_OPENIPC_SOC_HISILICON_HI3536DV100
	bool "HI3536DV100"
	depends on BR2_OPENIPC_SOC_HISILICON
config BR2_OPENIPC_SOC_INGENIC_T10
	bool "T10"
	depends on BR2_OPENIPC_SOC_INGENIC
config BR2_OPENIPC_SOC_INGENIC_T15
	bool "T15"
	depends on BR2_OPENIPC_SOC_INGENIC
config BR2_OPENIPC_SOC_INGENIC_T20
	bool "T20"
	depends on BR2_OPENIPC_SOC_INGENIC
config BR2_OPENIPC_SOC_INGENIC_T21
	bool "T21"
	depends on BR2_OPENIPC_SOC_INGENIC
config BR2_OPENIPC_SOC_INGENIC_T23
	bool "T23"
	depends on BR2_OPENIPC_SOC_INGENIC
config BR2_OPENIPC_SOC_INGENIC_T30
	bool "T30"
	depends on BR2_OPENIPC_SOC_INGENIC
config BR2_OPENIPC_SOC_INGENIC_T31
	bool "T31"
	depends on BR2_OPENIPC_SOC_INGENIC
config BR2_OPENIPC_SOC_INGENIC_T40
	bool "T40"
	depends on BR2_OPENIPC_SOC_INGENIC
config BR2_OPENIPC_SOC_INGENIC_T41
	bool "T41"
	depends on BR2_OPENIPC_SOC_INGENIC
config BR2_OPENIPC_SOC_NOVATEK_NT98562
	bool "NT98562"
	depends on BR2_OPENIPC_SOC_NOVATEK
config BR2_OPENIPC_SOC_NOVATEK_NT98566
	bool "NT98566"
	depends on BR2_OPENIPC_SOC_NOVATEK
config BR2_OPENIPC_SOC_ROCKCHIP_RV1109
	bool "RV1109"
	depends on BR2_OPENIPC_SOC_ROCKCHIP
config BR2_OPENIPC_SOC_ROCKCHIP_RV1126
	bool "RV1126"
	depends on BR2_OPENIPC_SOC_ROCKCHIP
config BR2_OPENIPC_SOC_SIGMASTAR_MSC313E
	bool "MSC313E"
	depends on BR2_OPENIPC_SOC_SIGMASTAR
config BR2_OPENIPC_SOC_SIGMASTAR_MSC316DC
	bool "MSC316DC"
	depends on BR2_OPENIPC_SOC_SIGMASTAR
config BR2_OPENIPC_SOC_SIGMASTAR_MSC316DM
	bool "MSC316DM"
	depends on BR2_OPENIPC_SOC_SIGMASTAR
config BR2_OPENIPC_SOC_SIGMASTAR_SSC30KD
	bool "SSC30KD"
	depends on BR2_OPENIPC_SOC_SIGMASTAR
config BR2_OPENIPC_SOC_SIGMASTAR_SSC30KQ
	bool "SSC30KQ"
	depends on BR2_OPENIPC_SOC_SIGMASTAR
config BR2_OPENIPC_SOC_SIGMASTAR_SSC325
	bool "SSC325"
	depends on BR2_OPENIPC_SOC_SIGMASTAR
config BR2_OPENIPC_SOC_SIGMASTAR_SSC325DE
	bool "SSC325DE"
	depends on BR2_OPENIPC_SOC_SIGMASTAR
config BR2_OPENIPC_SOC_SIGMASTAR_SSC333
	bool "SSC333"
	depends on BR2_OPENIPC_SOC_SIGMASTAR
config BR2_OPENIPC_SOC_SIGMASTAR_SSC335
	bool "SSC335"
	depends on BR2_OPENIPC_SOC_SIGMASTAR
config BR2_OPENIPC_SOC_SIGMASTAR_SSC335DE
	bool "SSC335DE"
	depends on BR2_OPENIPC_SOC_SIGMASTAR
config BR2_OPENIPC_SOC_SIGMASTAR_SSC337
	bool "SSC337"
	depends on BR2_OPENIPC_SOC_SIGMASTAR
config BR2_OPENIPC_SOC_SIGMASTAR_SSC337DE
	bool "SSC337DE"
	depends on BR2_OPENIPC_SOC_SIGMASTAR
config BR2_OPENIPC_SOC_SIGMASTAR_SSC338Q
	bool "SSC338Q"
	depends on BR2_OPENIPC_SOC_SIGMASTAR
config BR2_OPENIPC_SOC_TI_DM36X
	bool "DM36x"
	depends on BR2_OPENIPC_SOC_TI
config BR2_OPENIPC_SOC_XIONGMAI_XM510
	bool "XM510"
	depends on BR2_OPENIPC_SOC_XIONGMAI
config BR2_OPENIPC_SOC_XIONGMAI_XM530
	bool "XM530"
	depends on BR2_OPENIPC_SOC_XIONGMAI
config BR2_OPENIPC_SOC_XIONGMAI_XM550
	bool "XM550"
	depends on BR2_OPENIPC_SOC_XIONGMAI
endchoice

choice
	prompt "Flash memory size"
config BR2_OPENIPC_FLASH_SIZE_8M
	bool "8MB NOR Flash Chip"
config BR2_OPENIPC_FLASH_SIZE_16M
	bool "16MB NOR Flash Chip"
config BR2_OPENIPC_FLASH_SIZE_32M
	bool "32MB NOR Flash Chip"
endchoice

choice
	prompt "Build flavor"
config BR2_OPENIPC_FLAVOR_LITE
	bool "Lite"
	help
	  Light version, fits 8MB flash memory
config BR2_OPENIPC_FLAVOR_FPV
	bool "FPV"
	help
	  Version for drones
config BR2_OPENIPC_FLAVOR_ULTIMATE
	bool "Ultimate"
	depends on BR2_OPENIPC_FLASH_SIZE_16M || BR2_OPENIPC_FLASH_SIZE_32M
	help
	  Advanced version, requires 16MB or larger flash memory
#	select BR2_PACKAGE_FDK_AAC_OPENIPC
#	select BR2_PACKAGE_JSONFILTER
	select BR2_PACKAGE_LIBWEBSOCKETS_OPENIPC
	select BR2_PACKAGE_LOGCAT_OPENIPC
#	select BR2_PACKAGE_MINI_SNMPD
	select BR2_PACKAGE_MOSQUITTO
#	select BR2_PACKAGE_MOSQUITTO_BROKER
#	select BR2_PACKAGE_MOTORS
#	select BR2_PACKAGE_NABTO
#	select BR2_PACKAGE_ONVIF_SIMPLE_SERVER
#	select BR2_PACKAGE_QUIRC_OPENIPC
#	select BR2_PACKAGE_SSHPASS
#	select BR2_PACKAGE_UACME_OPENIPC
#	select BR2_PACKAGE_VTUND_OPENIPC
#	select BR2_PACKAGE_WIREGUARD_LINUX_COMPAT
#	select BR2_PACKAGE_WIREGUARD_TOOLS
#	select BR2_PACKAGE_ZEROTIER_ONE
comment "Ultimate requires 16MB or larger flash memory"
    depends on BR2_OPENIPC_FLASH_SIZE_8M
endchoice

#config BR2_OPENIPC_FLASH_SIZE
#	string "OpenIPC flash size"
#	default "8"

#config BR2_OPENIPC_SOC
#	string "SoC manufacturer"

#config BR2_OPENIPC_SOC_MODEL
#	string "SoC model"

#config BR2_OPENIPC_FLAVOR
#	bool

#config BR2_OPENIPC_SOC_FAMILY
#	string "SoC family"

config BR2_OPENIPC_SENSOR_MODEL
	string "Image sensor model"

source "$BR2_EXTERNAL_OPENIPC_PATH/package/Config.in"

endmenu
```

## general/package/librem-openipc/Config.in
```kconfig
config BR2_PACKAGE_LIBREM_OPENIPC
	bool "librem-openipc"
	select BR2_PACKAGE_LIBRE_OPENIPC
	default n
	help
	  librem is an audio and video processing media library.

	  https://github.com/baresip/rem
```

## general/package/majestic/Config.in
```kconfig
config BR2_PACKAGE_MAJESTIC
	bool "Majestic streamer"
	default n
	select BR2_PACKAGE_JSON_C
	select BR2_PACKAGE_LIBEVENT_OPENIPC
	select BR2_PACKAGE_LIBEVENT_OPENIPC_REMOVE_PYSCRIPT
	select BR2_PACKAGE_LIBWEBSOCKETS_OPENIPC
	select BR2_PACKAGE_LIBYAML
	select BR2_PACKAGE_MAJESTIC_FONTS
	select BR2_PACKAGE_MBEDTLS
	select BR2_PACKAGE_MBEDTLS_DTLS_SRTP
	select BR2_PACKAGE_MXML
	select BR2_PACKAGE_OPUS
	select BR2_PACKAGE_OPUS_FIXED_POINT
	select BR2_PACKAGE_ZLIB
	select BR2_PACKAGE_LIBOGG if !BR2_OPENIPC_FLAVOR_FPV
	select BR2_PACKAGE_LAME if BR2_OPENIPC_FLAVOR_ULTIMATE
	help
	  Tiny but powerful IPC streaming software
	  (non-commercial version for personal use only)

	  https://openipc.org
```
