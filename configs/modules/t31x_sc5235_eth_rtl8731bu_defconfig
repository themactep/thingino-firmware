## general/package/nginx-wolfssl/Config.in
```kconfig
config BR2_PACKAGE_NGINX_WOLFSSL
	bool "nginx-wolfssl"
	select BR2_PACKAGE_WOLFSSL
	select BR2_PACKAGE_NGINX
	# select BR2_PACKAGE_NGINX_FILE_AIO
	# select BR2_PACKAGE_NGINX_THREADS
	select BR2_PACKAGE_NGINX_HTTP
	# select BR2_PACKAGE_NGINX_HTTP_CACHE
	select BR2_PACKAGE_NGINX_HTTP_SSL_MODULE
	select BR2_PACKAGE_NGINX_HTTP_V2_MODULE
	# select BR2_PACKAGE_NGINX_HTTP_REALIP_MODULE
	# select BR2_PACKAGE_NGINX_HTTP_ADDITION_MODULE
	# select BR2_PACKAGE_NGINX_HTTP_XSLT_MODULE
	# select BR2_PACKAGE_NGINX_HTTP_IMAGE_FILTER_MODULE
	# select BR2_PACKAGE_NGINX_HTTP_GEOIP_MODULE
	# select BR2_PACKAGE_NGINX_HTTP_SUB_MODULE
	# select BR2_PACKAGE_NGINX_HTTP_DAV_MODULE
	# select BR2_PACKAGE_NGINX_HTTP_FLV_MODULE
	select BR2_PACKAGE_NGINX_HTTP_MP4_MODULE
	# select BR2_PACKAGE_NGINX_HTTP_GUNZIP_MODULE
	# select BR2_PACKAGE_NGINX_HTTP_GZIP_STATIC_MODULE
	select BR2_PACKAGE_NGINX_HTTP_AUTH_REQUEST_MODULE
	# select BR2_PACKAGE_NGINX_HTTP_RANDOM_INDEX_MODULE
	# select BR2_PACKAGE_NGINX_HTTP_SECURE_LINK_MODULE
	# select BR2_PACKAGE_NGINX_HTTP_DEGRADATION_MODULE
	# select BR2_PACKAGE_NGINX_HTTP_SLICE_MODULE
	# select BR2_PACKAGE_NGINX_HTTP_STUB_STATUS_MODULE
	select BR2_PACKAGE_NGINX_HTTP_CHARSET_MODULE
	select BR2_PACKAGE_NGINX_HTTP_GZIP_MODULE
	# select BR2_PACKAGE_NGINX_HTTP_SSI_MODULE
	# select BR2_PACKAGE_NGINX_HTTP_USERID_MODULE
	# select BR2_PACKAGE_NGINX_HTTP_ACCESS_MODULE
	select BR2_PACKAGE_NGINX_HTTP_AUTH_BASIC_MODULE
	# select BR2_PACKAGE_NGINX_HTTP_AUTOINDEX_MODULE
	# select BR2_PACKAGE_NGINX_HTTP_GEO_MODULE
	# select BR2_PACKAGE_NGINX_HTTP_MAP_MODULE
	select BR2_PACKAGE_NGINX_HTTP_SPLIT_CLIENTS_MODULE
	# select BR2_PACKAGE_NGINX_HTTP_REFERER_MODULE
	# select BR2_PACKAGE_NGINX_HTTP_REWRITE_MODULE
	select BR2_PACKAGE_NGINX_HTTP_PROXY_MODULE
	select BR2_PACKAGE_NGINX_HTTP_FASTCGI_MODULE
	select BR2_PACKAGE_NGINX_HTTP_UWSGI_MODULE
	select BR2_PACKAGE_NGINX_HTTP_SCGI_MODULE
	# select BR2_PACKAGE_NGINX_HTTP_MEMCACHED_MODULE
	# select BR2_PACKAGE_NGINX_HTTP_LIMIT_CONN_MODULE
	# select BR2_PACKAGE_NGINX_HTTP_LIMIT_REQ_MODULE
	# select BR2_PACKAGE_NGINX_HTTP_EMPTY_GIF_MODULE
	select BR2_PACKAGE_NGINX_HTTP_BROWSER_MODULE
	# select BR2_PACKAGE_NGINX_HTTP_UPSTREAM_IP_HASH_MODULE
	# select BR2_PACKAGE_NGINX_HTTP_UPSTREAM_LEAST_CONN_MODULE
	# select BR2_PACKAGE_NGINX_HTTP_UPSTREAM_KEEPALIVE_MODULE
	# select BR2_PACKAGE_NGINX_HTTP_UPSTREAM_RANDOM_MODULE
	# select BR2_PACKAGE_NGINX_HTTP_UPSTREAM_ZONE_MODULE
	# select BR2_PACKAGE_NGINX_MAIL
	# select BR2_PACKAGE_NGINX_STREAM
	# select BR2_PACKAGE_NGINX_DEBUG
	help
	  nginx web server with WolfSSL.

	  https://github.com/wolfSSL/wolfssl-nginx
```
