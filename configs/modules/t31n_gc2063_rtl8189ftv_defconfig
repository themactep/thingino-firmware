## configs/modules/t31n_gc2063_rtl8189ftv_defconfig
```kconfig
# NAME: T31N, GC2063, RTL8189FTV
# FRAG: soc-xburst1 toolchain-xburst1 ccache brand rootfs kernel system target uboot ssl
BR2_PACKAGE_WIFI=y
BR2_PACKAGE_WIFI_RTL8189FS=y
BR2_SENSOR_GC2063=y
BR2_SOC_INGENIC_T31N=y
```

## configs/modules/t31n_gc4653_eth_defconfig
```kconfig
# NAME: T31N, GC4653, ETH
# FRAG: soc-xburst1 toolchain-xburst1 ccache brand rootfs kernel system target uboot
BR2_ETHERNET=y
BR2_PACKAGE_THINGINO_KOPT_JZ_MAC_V13=y
BR2_SENSOR_GC4653=y
BR2_SOC_INGENIC_T31N=y
```

## configs/modules/t31n_jxf37_defconfig
```kconfig
# NAME: T31N, JXF37
# FRAG: soc-xburst1 toolchain ccache brand rootfs kernel system target uboot
BR2_SENSOR_JXF37=y
BR2_SOC_INGENIC_T31N=y
```

## configs/modules/t31n_jxq03_rtl8189ftv_defconfig
```kconfig
# NAME: T31N, JXQ03, RTL8189FTV
# FRAG: soc-xburst1 toolchain ccache brand rootfs kernel system target uboot
BR2_PACKAGE_WIFI=y
BR2_PACKAGE_WIFI_RTL8189FS=y
BR2_SENSOR_JXQ03=y
BR2_SOC_INGENIC_T31N=y
```

## configs/modules/t31n_jxq03p_rtl8189ftv_defconfig
```kconfig
# NAME: T31N, JXQ03P, RTL8189FTV
# FRAG: soc-xburst1 toolchain ccache brand rootfs kernel system target uboot
BR2_PACKAGE_WIFI=y
BR2_PACKAGE_WIFI_RTL8189FS=y
BR2_SENSOR_JXQ03P=y
BR2_SOC_INGENIC_T31N=y
```

## configs/modules/t31n_sc223a_rtl8188ftv_defconfig
```kconfig
# NAME: T31N, SC223A, RTL8188FTV
# FRAG: soc-xburst1 toolchain-xburst1 ccache brand rootfs kernel system target uboot ssl
BR2_PACKAGE_WIFI=y
BR2_PACKAGE_WIFI_RTL8188FU=y
BR2_SENSOR_SC223A=y
BR2_SOC_INGENIC_T31N=y
```

## configs/modules/t31n_sc2332_hi3881_defconfig
```kconfig
# NAME: T31N, SC2332, HI3881
# FRAG: soc-xburst1 toolchain-xburst1 ccache brand rootfs kernel system target uboot ssl
BR2_ETHERNET=y
BR2_PACKAGE_THINGINO_KOPT_JZ_MAC=y
BR2_PACKAGE_THINGINO_KOPT_JZ_MAC_V12=y
BR2_PACKAGE_WIFI=y
BR2_PACKAGE_WIFI_HI3881=y
BR2_SENSOR_SC2332=y
BR2_SOC_INGENIC_T31N=y
```

## configs/modules/t31n_sc2336_atbm6012b_defconfig
```kconfig
# NAME: T31N, SC2336, ATBM6012B
# FRAG: soc-xburst1 toolchain ccache brand rootfs kernel system target uboot
BR2_PACKAGE_WIFI=y
BR2_PACKAGE_WIFI_ATBM6012B=y
BR2_SENSOR_SC2336=y
BR2_SOC_INGENIC_T31N=y
```

## configs/modules/t31x_gc2053_rtl8189ftv_defconfig
```kconfig
# NAME: T31X, GC2053, RTL8189FTV
# FRAG: soc-xburst1 toolchain-xburst1 ccache brand rootfs kernel system target uboot
BR2_PACKAGE_WIFI=y
BR2_PACKAGE_WIFI_RTL8189FS=y
BR2_SENSOR_GC2053=y
BR2_SOC_INGENIC_T31X=y
```

## configs/modules/t31x_gc4023_rtl8188ftv_defconfig
```kconfig
# FRAG: soc toolchain ccache brand rootfs kernel system target uboot
BR2_SOC_INGENIC_T31X=y
BR2_SENSOR_GC4023=y
BR2_PACKAGE_WIFI=y
BR2_PACKAGE_WIFI_RTL8188FU=y
```

## configs/modules/t31x_gc4653_atbm6031_defconfig
```kconfig
# NAME: T31X, GC4653, ATBM6031
# FRAG: soc-xburst1 toolchain-xburst1 ccache brand rootfs kernel system target uboot ssl
BR2_PACKAGE_WIFI=y
BR2_PACKAGE_WIFI_ATBM6031=y
BR2_SENSOR_GC4653=y
BR2_SOC_INGENIC_T31X=y
```

## configs/modules/t31x_gc4653_eth_defconfig
```kconfig
# FRAG: soc toolchain ccache brand rootfs kernel system target local
BR2_SOC_INGENIC_T31X=y
BR2_SENSOR_MODEL="gc4653"
```

## configs/modules/t31x_jxf23_rtl8189ftv_defconfig
```kconfig
# NAME: T31X, JXF23, RTL8189FTV
# FRAG: soc toolchain ccache brand rootfs kernel system target uboot
BR2_PACKAGE_WIFI=y
BR2_PACKAGE_WIFI_RTL8189FS=y
BR2_SENSOR_JXF23=y
BR2_SOC_INGENIC_T31X=y
```

## configs/modules/t31x_jxf37_eth_defconfig
```kconfig
# NAME: T31X, JXF37, ETH
# FRAG: soc-xburst1 toolchain-xburst1 ccache brand rootfs kernel system target uboot
BR2_ETHERNET=y
BR2_PACKAGE_THINGINO_KOPT_JZ_MAC_V13=y
BR2_SENSOR_JXF37=y
BR2_SOC_INGENIC_T31X=y
```

## configs/modules/t31x_jxk04_eth_defconfig
```kconfig
# FRAG: soc toolchain ccache brand rootfs kernel system target uboot
BR2_SOC_INGENIC_T31X=y
BR2_SENSOR_JXK04=y
```

## configs/modules/t31x_jxk04_rtl8188ftv_defconfig
```kconfig
# NAME: T31X, JXK04, RTL8188FTV
# FRAG: soc-xburst1 toolchain ccache brand rootfs kernel system target uboot
BR2_PACKAGE_WIFI=y
BR2_PACKAGE_WIFI_RTL8188FU=y
BR2_SENSOR_JXK04=y
BR2_SOC_INGENIC_T31X=y
```

## configs/modules/t31x_jxq03_rtl8188ftv_defconfig
```kconfig
# NAME: T31X, JXQ03, RTL8188FTV
# FRAG: soc-xburst1 toolchain-xburst1 ccache brand rootfs kernel system target uboot
BR2_PACKAGE_WIFI=y
BR2_PACKAGE_WIFI_RTL8188FU=y
BR2_SENSOR_JXQ03=y
BR2_SOC_INGENIC_T31X=y
```

## configs/modules/t31x_jxq03_ssv6155_defconfig
```kconfig
# NAME: T31X, JXQ03, SSV6155
# FRAG: soc-xburst1 toolchain ccache brand rootfs kernel system target uboot
BR2_PACKAGE_WIFI=y
BR2_PACKAGE_WIFI_SSV6X5X=y
BR2_PACKAGE_WIFI_SSV6X5X_SV6155P=y
BR2_SENSOR_JXQ03=y
BR2_SOC_INGENIC_T31X=y
```

## configs/modules/t31x_os03b10_ssv6155_defconfig
```kconfig
# NAME: T31X, OS03B10, SSV6155
# FRAG: soc toolchain ccache brand rootfs kernel system target uboot
BR2_ETHERNET=y
BR2_PACKAGE_THINGINO_KOPT_JZ_MAC_V13=y
BR2_PACKAGE_WIFI=y
BR2_PACKAGE_WIFI_SSV6X5X=y
BR2_PACKAGE_WIFI_SSV6X5X_SV6155P=y
BR2_SENSOR_OS03B10=y
BR2_SOC_INGENIC_T31X=y
```

## configs/modules/t31x_sc301iot_atbm6031_defconfig
```kconfig
# NAME: T31X, SC301IOT, ATBM6031
# FRAG: soc-xburst1 toolchain ccache brand rootfs kernel system target uboot
BR2_PACKAGE_WIFI=y
BR2_PACKAGE_WIFI_ATBM6031=y
BR2_SENSOR_SC301IOT=y
BR2_SOC_INGENIC_T31X=y
```

## configs/modules/t31x_sc3336_syn4343_defconfig
```kconfig
# NAME: T31X, SC3336, SYN4343
# FRAG: soc-xburst1 toolchain-xburst1 ccache brand rootfs kernel system target uboot ssl
BR2_PACKAGE_WIFI=y
BR2_PACKAGE_WIFI_SYN4343=y
BR2_SENSOR_SC3336=y
BR2_SOC_INGENIC_T31X=y
```

## configs/modules/t31x_sc3338_atbm6031x_defconfig
```kconfig
# NAME: T31X, SC3338, ATBM6031X
# FRAG: soc-xburst1 toolchain-xburst1 ccache brand rootfs kernel system target uboot ssl
BR2_PACKAGE_WIFI=y
BR2_PACKAGE_WIFI_ATBM6031X=y
BR2_SENSOR_SC3338=y
BR2_SOC_INGENIC_T31X=y
```

## configs/modules/t31x_sc401ai_rtl8188ftv_defconfig
```kconfig
# NAME: T31X, SC401AI, RTL8188FTV
# FRAG: soc-xburst1 toolchain-xburst1 ccache brand rootfs kernel system target uboot ssl
BR2_PACKAGE_WIFI=y
BR2_PACKAGE_WIFI_RTL8188FU=y
BR2_SENSOR_SC401AI=y
BR2_SOC_INGENIC_T31X=y
```

## configs/modules/t31x_sc401ai_ssv6158_defconfig
```kconfig
# NAME: T31X, SC401AI, SSV6158
# FRAG: soc-xburst1 toolchain-xburst1 ccache brand rootfs kernel system target uboot
BR2_PACKAGE_WIFI=y
BR2_PACKAGE_WIFI_SSV6158=y
BR2_SENSOR_SC401AI=y
BR2_SOC_INGENIC_T31X=y
```

## configs/modules/t31x_sc4336p_ssv6158_defconfig
```kconfig
# NAME: T31X, SC4336P, SSV6158
# FRAG: soc-xburst1 toolchain ccache brand rootfs kernel system target uboot
BR2_PACKAGE_WIFI=y
BR2_PACKAGE_WIFI_SSV6158=y
BR2_SENSOR_SC4336P=y
BR2_SOC_INGENIC_T31X=y
```
