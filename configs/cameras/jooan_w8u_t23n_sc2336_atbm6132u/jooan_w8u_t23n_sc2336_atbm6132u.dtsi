// Jooan W8-U (T23N, SC2336P, ATBM6132U) per-board GPIO definitions.
// Injected into the kernel 4.4+ device tree; ignored on 3.10.

#include <dt-bindings/gpio/gpio.h>
#include <dt-bindings/pinctrl/ingenic-pinctrl.h>

/* Card detect; the family tree carries the reference pin. */
&msc0 {
	ingenic,cd-gpios = <&gpb 29 GPIO_ACTIVE_LOW INGENIC_GPIO_PULLUP>;
};
