## configs/cameras/okam_qc2_t23n_gc2083_aic8800u/okam_qc2_t23n_gc2083_aic8800u_defconfig
```kconfig
# NAME: OKAM QC2 (T23N, GC2083, AIC8800D40L USB)
# FRAG: soc-xburst1 toolchain-xburst1 ccache brand rootfs kernel system target uboot ssl
BR2_PACKAGE_THINGINO_KOPT_MMC0=y
BR2_PACKAGE_THINGINO_KOPT_MMC0_PB_4BIT=y
BR2_PACKAGE_WIFI=y
BR2_PACKAGE_WIFI_AIC8800=y
BR2_PACKAGE_WIFI_AIC8800_USB=y
BR2_PACKAGE_WIFI_AIC8800_USB_8800D80=y
BR2_SENSOR_1_NAME="gc2083"
BR2_SOC_INGENIC_T23N=y
BR2_THINGINO_AUDIO=y
BR2_THINGINO_AUDIO_GPIO=63
BR2_THINGINO_BUTTON=y
BR2_THINGINO_PWM_ENABLE=y
BR2_THINGINO_SDCARD=y
FLASH_SIZE_MB=8
```

## configs/cameras/overtech_ov59wb_t31n_sc223a_rtl8188ftv/overtech_ov59wb_t31n_sc223a_rtl8188ftv_defconfig
```kconfig
# NAME: Overtech OV59WB (T31N, SC223A, RTL8188FTV)
# FRAG: soc-xburst1 toolchain-xburst1 ccache brand rootfs kernel system target uboot ssl
BR2_PACKAGE_WIFI=y
BR2_PACKAGE_WIFI_RTL8188FU=y
BR2_SENSOR_SC223A=y
BR2_SOC_INGENIC_T31N=y
BR2_PACKAGE_THINGINO_KOPT_MMC0=y
BR2_PACKAGE_THINGINO_KOPT_MMC0_PB_4BIT=y
BR2_THINGINO_AUDIO=y
BR2_THINGINO_BUTTON=y
BR2_THINGINO_SDCARD=y
FLASH_SIZE_16=y
```
