## configs/cameras/hc_3301ymt1_t31n_sc2332_hi3881/hc_3301ymt1_t31n_sc2332_hi3881_defconfig
```kconfig
# NAME: HC-3301Y-MT1 (T31N, SC2332, HI3881)
# MODULE: t31n_sc2332_hi3881
BR2_PACKAGE_THINGINO_KOPT_MMC0=y
BR2_PACKAGE_THINGINO_KOPT_MMC0_PB_4BIT=y
BR2_PACKAGE_THINGINO_KOPT_MMC1=y
BR2_PACKAGE_THINGINO_KOPT_MMC1_PA_4BIT=y
BR2_PACKAGE_THINGINO_UBOOT_BOARDNAME="isvp_t31_motorcomm_sfcnor"
BR2_THINGINO_AUDIO=y
BR2_THINGINO_BUTTON=y
BR2_THINGINO_MOTORS=y
BR2_THINGINO_DEVICE_TYPE_IPCAM=y
BR2_THINGINO_DEVICE_TYPE_IPCAM_PAN_TILT=y
BR2_THINGINO_PWM_ENABLE=y
BR2_THINGINO_SDCARD=y
FLASH_SIZE_8=y
```

## configs/cameras/hl_jdpan01_t31l_gc2053_atbm6031/hl_jdpan01_t31l_gc2053_atbm6031_defconfig
```kconfig
# NAME: Hualai JD Pan01 (T31L, GC2053, ATBM6031)
# MODULE: t31l_gc2053_atbm6031
BR2_PACKAGE_THINGINO_KOPT_DWC2=y
BR2_PACKAGE_THINGINO_KOPT_DWC2_OTG=y
BR2_PACKAGE_THINGINO_KOPT_MMC0=y
BR2_PACKAGE_THINGINO_KOPT_MMC0_PB_4BIT=y
BR2_PACKAGE_THINGINO_KOPT_MMC1=y
BR2_PACKAGE_THINGINO_KOPT_MMC1_PB_4BIT=y
BR2_SENSOR_PARAMS="sensor_max_fps=30 data_interface=1"
BR2_THINGINO_AUDIO=y
BR2_THINGINO_BUTTON=y
BR2_THINGINO_MOTORS=y
BR2_THINGINO_DEVICE_TYPE_IPCAM=y
BR2_THINGINO_DEVICE_TYPE_IPCAM_PAN_TILT=y
BR2_THINGINO_PWM_ENABLE=y
BR2_THINGINO_SDCARD=y
FLASH_SIZE_16=y
```

## configs/cameras/howell_qj05t_t20l_sc2235_eth+rtl8188ftv/howell_qj05t_t20l_sc2235_eth+rtl8188ftv_defconfig
```kconfig
# NAME: Howell QJ05T (T20L, SC2235, ETH, RTL8188FTV)
# FRAG: soc-xburst1 toolchain-xburst1 ccache brand rootfs kernel system target uboot ssl
BR2_ETHERNET=y
BR2_PACKAGE_THINGINO_KOPT_ADC=y
BR2_PACKAGE_THINGINO_KOPT_JZ_MAC_V12=y
BR2_PACKAGE_THINGINO_KOPT_MMC0=y
BR2_PACKAGE_THINGINO_KOPT_MMC0_PB_4BIT=y
BR2_PACKAGE_WIFI=y
BR2_PACKAGE_WIFI_RTL8188FU=y
BR2_SENSOR_1_NAME="sc2235"
BR2_SOC_INGENIC_T20L=y
BR2_THINGINO_AUDIO=y
BR2_THINGINO_AUDIO_GPIO=77
BR2_THINGINO_BUTTON=y
BR2_THINGINO_ISPMEM_MB=8
BR2_THINGINO_RMEM_MB=17
BR2_THINGINO_SDCARD=y
FLASH_SIZE_MB=8
```

## configs/cameras/hugolog_e5p_t41lq_sc4336p_atbm6062/hugolog_e5p_t41lq_sc4336p_atbm6062_defconfig
```kconfig
# NAME: Hugolog E5P (T41LQ, SC4336P, ATBM6062)
# FRAG: soc-xburst2 ccache brand rootfs kernel system target uboot ssl
BR2_THINGINO_TOOLCHAIN_TYPE_EXTERNAL=y
BR2_THINGINO_TOOLCHAIN_GCC_15=y
BR2_THINGINO_TOOLCHAIN_LIBC_UCLIBC=y
BR2_SENSOR_1_NAME="sc4336p"
BR2_INGENIC_SOC_MODEL="t41lq"
BR2_PACKAGE_THINGINO_UBOOT_BOARDNAME="isvp_t41lq_sfc_nor_lp"
BR2_PACKAGE_THINGINO_UBOOT_FLASH_CONTROLLER_JZ_SFC=n
BR2_PACKAGE_THINGINO_UBOOT_FLASH_CONTROLLER_SFC0_NOR=y
BR2_AVPU_SCLKA=y
BR2_AVPU_CLK_550MHZ=y
BR2_ISP_CLK_VPLL=y
BR2_ISP_CLK_300MHZ=y
BR2_ISP_CLKS_VPLL=y
BR2_ISP_CLKS_550MHZ=y
BR2_THINGINO_AUDIO=y
BR2_THINGINO_BUTTON=y
BR2_THINGINO_SDCARD=y
BR2_PACKAGE_THINGINO_KOPT_MMC0=y
BR2_PACKAGE_THINGINO_KOPT_MMC0_PB_4BIT=y
FLASH_SIZE_MB=16
BR2_PACKAGE_WIFI=y
BR2_PACKAGE_WIFI_ATBM6062U=y
BR2_THINGINO_RMEM_MB=22
BR2_THINGINO_NMEM_MB=8
# BR2_PACKAGE_THINGINO_STREAMER_PRUDYNT is not set
BR2_PACKAGE_THINGINO_STREAMER_RAPTOR=y
```

## configs/cameras/iflytek_xfp301m_t31x_jxq03_ssv6155/iflytek_xfp301m_t31x_jxq03_ssv6155_defconfig
```kconfig
# NAME: iFlytek XFP301-M (T31X, JXQ03, SSV6155)
# FRAG: soc-xburst1 toolchain-xburst1 ccache brand rootfs kernel system target uboot ssl
BR2_PACKAGE_WIFI=y
BR2_PACKAGE_WIFI_SSV6X5X=y
BR2_PACKAGE_WIFI_SSV6X5X_SV6155P=y
BR2_SENSOR_JXQ03=y
BR2_SOC_INGENIC_T31X=y
BR2_PACKAGE_THINGINO_KOPT_MMC0=y
BR2_PACKAGE_THINGINO_KOPT_MMC0_PB_4BIT=y
BR2_THINGINO_AUDIO=y
BR2_THINGINO_BUTTON=y
BR2_THINGINO_MOTORS=y
BR2_THINGINO_RMEM_48=y
BR2_THINGINO_SDCARD=y
FLASH_SIZE_16=y
```

## configs/cameras/iget_c5pt_t41lq_gc4023_jl1101/iget_c5pt_t41lq_gc4023_jl1101_defconfig
```kconfig
# NAME: iGET C5PT (T41LQ, GC4023, ETH)
# FRAG: soc-xburst2 core ssl
BR2_ETHERNET=y
BR2_SENSOR_1_NAME="gc4023"
BR2_INGENIC_SOC_MODEL="t41lq"
BR2_PACKAGE_THINGINO_UBOOT_FLASH_CONTROLLER_SFC0_NOR=y
BR2_THINGINO_AUDIO_GPIO=63
BR2_THINGINO_AUDIO=y
BR2_THINGINO_BUTTON=y
BR2_THINGINO_RMEM_MB=28
BR2_THINGINO_NMEM_MB=0
FLASH_SIZE_MB=16
BR2_PACKAGE_THINGINO_UBOOT_SD_ENABLE=y
BR2_LINUX_KERNEL_EXT_THINGINO_KOPT=y
BR2_LINUX_KERNEL_EXT_THINGINO_KOPT_DTS=y
BR2_LINUX_KERNEL_EXT_THINGINO_KOPT_DTS_IGETC5PT=y
```

## configs/cameras/imou_ranger2_t31n_gc2053_ssv6155/imou_ranger2_t31n_gc2053_ssv6155_defconfig
```kconfig
# NAME: Imou Ranger 2 IPC-A22E-E (T31N, GC2053, SSV6155)
# FRAG: soc-xburst1 toolchain-xburst1 ccache brand rootfs kernel system target uboot ssl
#Ethernet functionality TBD
BR2_ETHERNET=y
BR2_PACKAGE_THINGINO_KOPT_JZ_MAC_V13=y
BR2_PACKAGE_THINGINO_KOPT_JZ_MAC_CLK_25MHZ=y
BR2_PACKAGE_WIFI=y
BR2_PACKAGE_WIFI_SSV6X5X=y
BR2_PACKAGE_WIFI_SSV6X5X_SV6155P=y
BR2_SENSOR_GC2053=y
BR2_SOC_INGENIC_T31N=y
BR2_AVPU_CLK_400MHZ=y
BR2_AVPU_VPLL=y
BR2_ISP_CLK_200MHZ=y
BR2_ISP_CH0_PRE_DEQUEUE_TIME=y
BR2_ISP_CH0_PRE_DEQUEUE_TIME_VALUE=14
BR2_ISP_CH0_PRE_DEQUEUE_INTERRUPT_PROCESS=y
BR2_ISP_CH0_PRE_DEQUEUE_INTERRUPT_PROCESS_VALUE=0
BR2_ISP_CH0_PRE_DEQUEUE_VALID_LINES=y
BR2_ISP_CH0_PRE_DEQUEUE_VALID_LINES_VALUE=540
BR2_PACKAGE_THINGINO_KOPT_MMC0=y
BR2_PACKAGE_THINGINO_KOPT_MMC0_PB_4BIT=y
BR2_PACKAGE_THINGINO_KOPT_UART=y
BR2_PACKAGE_THINGINO_KOPT_UART_UART0=y
BR2_PACKAGE_THINGINO_UBOOT_BOARDNAME="isvp_t31_sfcnor_uart0"
BR2_SENSOR_PARAMS="data_interface=1 shvflip=1"
BR2_THINGINO_AUDIO=y
BR2_THINGINO_BUTTON=y
BR2_THINGINO_MOTORS=y
BR2_THINGINO_PWM_ENABLE=y
BR2_THINGINO_SDCARD=y
FLASH_SIZE_16=y

# JL1101 reset PA14
```

## configs/cameras/jienuo_jn107ardwifi_t31l_gc2083_eth+rtl8131bu/jienuo_jn107ardwifi_t31l_gc2083_eth+rtl8131bu_defconfig
```kconfig
# NAME: Jienuo JN-107AR-D-WIFI (T31L, GC2083, ETH, RTL8731BU)
# FRAG: soc-xburst1 toolchain-xburst1 ccache brand rootfs kernel system target uboot ssl
BR2_ETHERNET=y
BR2_SENSOR_1_NAME=gc2083
BR2_SOC_INGENIC_T31L=y
BR2_PACKAGE_WIFI=y
BR2_PACKAGE_WIFI_RTL8733BU=y
BR2_PACKAGE_THINGINO_KOPT_JZ_MAC_V13=y
BR2_THINGINO_BUTTON=y
BR2_PACKAGE_THINGINO_DIAG=y
BR2_ISP_CLK_200MHZ=y
BR2_ISP_CH0_PRE_DEQUEUE_TIME=y
BR2_ISP_CH0_PRE_DEQUEUE_TIME_VALUE=14
BR2_ISP_CH0_PRE_DEQUEUE_INTERRUPT_PROCESS=y
BR2_ISP_CH0_PRE_DEQUEUE_INTERRUPT_PROCESS_VALUE=0
BR2_ISP_CH0_PRE_DEQUEUE_VALID_LINES=y
BR2_ISP_CH0_PRE_DEQUEUE_VALID_LINES_VALUE=540
BR2_SENSOR_PARAMS="data_interface=1 shvflip=1"
BR2_THINGINO_AUDIO=y
BR2_THINGINO_RMEM_MB=64
BR2_THINGINO_SDCARD=y
FLASH_SIZE_MB=16
```

## configs/cameras/jienuo_jn107arewifi_t31x_sc5235_eth+rtl8731bu/jienuo_jn107arewifi_t31x_sc5235_eth+rtl8731bu_defconfig
```kconfig
# NAME: Jienuo JN-107AR-E-WIFI (T31X, SC5235, ETH, RTL8731BU)
# FRAG: soc-xburst1 toolchain-xburst1 ccache brand rootfs kernel system target uboot ssl
BR2_ETHERNET=y
BR2_SENSOR_SC5235=y
BR2_SOC_INGENIC_T31X=y
BR2_PACKAGE_WIFI=y
BR2_PACKAGE_WIFI_RTL8733BU=y
BR2_PACKAGE_THINGINO_KOPT_JZ_MAC_V13=y
FLASH_SIZE_16=y
BR2_THINGINO_BUTTON=y
BR2_PACKAGE_THINGINO_DIAG=y
BR2_ISP_CLK_200MHZ=y
BR2_PACKAGE_WIFI=y
BR2_PACKAGE_WIFI_RTL8733BU=y
FLASH_SIZE_16=y
BR2_THINGINO_SDCARD=y
BR2_THINGINO_AUDIO=y
BR2_THINGINO_RMEM_64=y
BR2_PACKAGE_THINGINO_KOPT_ADC=y
BR2_PACKAGE_THINGINO_KOPT_MMC0=y
BR2_PACKAGE_THINGINO_KOPT_MMC0_PB_4BIT=y
```

## configs/cameras/jooan_a2r_t23n_sc1a4t_ssv6355/jooan_a2r_t23n_sc1a4t_ssv6355_defconfig
```kconfig
# NAME: Jooan A2R-U (T23N, SC1A4T, SSV6355)
# FRAG: soc-xburst1 toolchain-xburst1 ccache brand rootfs kernel system target uboot ssl
BR2_PACKAGE_WIFI=y
BR2_PACKAGE_WIFI_SSV6X5X=y
BR2_PACKAGE_WIFI_SSV6X5X_SV6355=y
BR2_SENSOR_SC1A4T=y
BR2_SOC_INGENIC_T23N=y
BR2_PACKAGE_THINGINO_KOPT_MMC0=y
BR2_PACKAGE_THINGINO_KOPT_MMC0_PB_4BIT=y
BR2_THINGINO_AUDIO=y
BR2_THINGINO_BUTTON=y
BR2_THINGINO_MOTORS=y
BR2_THINGINO_PWM_ENABLE=y
BR2_THINGINO_SDCARD=y
FLASH_SIZE_8=y
```

## configs/cameras/jooan_a6m_t23n_sc1a4t_atbm6012bx/jooan_a6m_t23n_sc1a4t_atbm6012bx_defconfig
```kconfig
# NAME: Jooan A6M (T23N, SC1A4T, ATBM6012BX)
# FRAG: soc-xburst1 toolchain-xburst1 ccache brand rootfs kernel system target uboot ssl
BR2_PACKAGE_WIFI=y
BR2_PACKAGE_WIFI_ATBM6012BX=y
BR2_SENSOR_SC1A4T=y
BR2_SOC_INGENIC_T23N=y
BR2_PACKAGE_THINGINO_KOPT_MMC0=y
BR2_PACKAGE_THINGINO_KOPT_MMC0_PB_4BIT=y
BR2_THINGINO_AUDIO=y
BR2_THINGINO_BUTTON=y
BR2_THINGINO_RMEM_16=y
BR2_THINGINO_SDCARD=y
FLASH_SIZE_8=y
```

## configs/cameras/jooan_c10r_t31n_jxf23_ssv6155/jooan_c10r_t31n_jxf23_ssv6155_defconfig
```kconfig
# NAME: Jooan C10R (T31N, JXF23, SSV6155)
# MODULE: t31n_jxf23_ssv6155
BR2_AVPU_VPLL=y
BR2_PACKAGE_THINGINO_KOPT_MMC0=y
BR2_PACKAGE_THINGINO_KOPT_MMC0_PB_4BIT=y
BR2_THINGINO_AUDIO=y
BR2_THINGINO_BUTTON=y
BR2_THINGINO_MOTORS=y
BR2_THINGINO_SDCARD=y
FLASH_SIZE_8=y
```

## configs/cameras/jooan_f2t_t30x_sc4236_eth/jooan_f2t_t30x_sc4236_eth_defconfig
```kconfig
# NAME: Jooan F2T (T30X, SC4246, ETH)
# FRAG: soc-xburst1 toolchain-xburst1 ccache brand rootfs kernel system target uboot ssl
BR2_ETHERNET=y
BR2_PACKAGE_THINGINO_KOPT_JZ_MAC_V12=y
BR2_SENSOR_SC4236=y
BR2_SOC_INGENIC_T30X=y
BR2_ISP_CLK_150MHZ=y
BR2_ISP_ISP_M1_BUFS=y
BR2_ISP_ISP_M1_BUFS_VALUE=4
BR2_ISP_ISP_M2_BUFS=y
BR2_ISP_ISP_M2_BUFS_VALUE=2
BR2_PACKAGE_THINGINO_KOPT_DWC2=y
BR2_PACKAGE_THINGINO_KOPT_DWC2_OTG=y
BR2_PACKAGE_THINGINO_KOPT_MMC0=y
BR2_PACKAGE_THINGINO_KOPT_MMC0_PB_4BIT=y
BR2_PACKAGE_THINGINO_KOPT_MMC1=y
BR2_PACKAGE_THINGINO_KOPT_MMC1_PC_4BIT=y
BR2_SENSOR_PARAMS="sensor_resolution=300"
BR2_THINGINO_AUDIO=y
BR2_THINGINO_BUTTON=y
BR2_THINGINO_RMEM_42=y
BR2_THINGINO_SDCARD=y
FLASH_SIZE_16=y
```

## configs/cameras/jooan_q3h_t30l_sc1235_rtl8189ftv/jooan_q3h_t30l_sc1235_rtl8189ftv_defconfig
```kconfig
# NAME: Jooan Q3H (T30L, SC1235, RTL8189FTV)
# MODULE: t30l_sc1235_rtl8189ftv
BR2_PACKAGE_THINGINO_KOPT_DWC2=y
BR2_PACKAGE_THINGINO_KOPT_DWC2_OTG=y
BR2_PACKAGE_THINGINO_KOPT_MMC0=y
BR2_PACKAGE_THINGINO_KOPT_MMC0_PB_4BIT=y
BR2_PACKAGE_THINGINO_KOPT_MMC1=y
BR2_PACKAGE_THINGINO_KOPT_MMC1_PC_4BIT=y
BR2_THINGINO_AUDIO=y
BR2_THINGINO_BUTTON=y
BR2_THINGINO_SDCARD=y
BR2_THINGINO_DEVICE_TYPE_IPCAM=y
BR2_THINGINO_DEVICE_TYPE_IPCAM_STANDARD=y
FLASH_SIZE_16=y
```

## configs/cameras/jooan_q3r_t23n_sc1a4t_eth+atbm6012bx/jooan_q3r_t23n_sc1a4t_eth+atbm6012bx_defconfig
```kconfig
# NAME: Jooan Q3R (T23N, SC1A4T, ETH, ATBM6012BX)
# FRAG: soc-xburst1 toolchain-xburst1 ccache brand rootfs kernel system target uboot ssl
BR2_ETHERNET=y
BR2_PACKAGE_WIFI=y
BR2_PACKAGE_WIFI_ATBM6012BX=y
BR2_SENSOR_1_NAME="sc1a4t"
BR2_SOC_INGENIC_T23N=y
BR2_PACKAGE_THINGINO_KOPT_MMC0=y
BR2_PACKAGE_THINGINO_KOPT_MMC0_PB_4BIT=y
BR2_THINGINO_AUDIO=y
BR2_THINGINO_BUTTON=y
BR2_THINGINO_MOTORS=y
BR2_THINGINO_SDCARD=y
FLASH_SIZE_MB=8

BR2_PACKAGE_THINGINO_UBOOT_PHY_RESET_AFTER_CONFIG=y
BR2_PACKAGE_THINGINO_UBOOT_GPIO_PHY_RESET=64
BR2_PACKAGE_THINGINO_UBOOT_GPIO_PHY_RESET_ENLEVEL=0
BR2_PACKAGE_THINGINO_UBOOT_PATCH="../configs/cameras/jooan_q3r_t23n_sc1a4t_eth+atbm6012bx/patches"
BR2_THINGINO_AUDIO_GPIO=63
BR2_THINGINO_AUDIO_GPIO_LOW=y
```

## configs/cameras/jooan_t2r_t23n_sc1a4t_atbm6012bx/jooan_t2r_t23n_sc1a4t_atbm6012bx_defconfig
```kconfig
# NAME: Jooan T2R (T23N, SC1A4T, ATBM6012BX)
# MODULE: t23n_sc1a4t_atbm6012bx
BR2_PACKAGE_THINGINO_KOPT_MMC0=y
BR2_PACKAGE_THINGINO_KOPT_MMC0_PB_4BIT=y
BR2_THINGINO_AUDIO=y
BR2_THINGINO_BUTTON=y
BR2_THINGINO_MOTORS=y
BR2_THINGINO_DEVICE_TYPE_IPCAM=y
BR2_THINGINO_DEVICE_TYPE_IPCAM_PAN_TILT=y
BR2_THINGINO_SDCARD=y
FLASH_SIZE_8=y
```

## configs/cameras/jooan_w3u_t23n_sc2336p_eth+atbm6132u/jooan_w3u_t23n_sc2336p_eth+atbm6132u_defconfig
```kconfig
# NAME: Jooan W3-U (T23N, SC2336P, ETH, ATBM6132U)
# FRAG: soc-xburst1 toolchain-xburst1 ccache brand rootfs kernel system target uboot ssl
BR2_ETHERNET=y
BR2_PACKAGE_WIFI=y
BR2_PACKAGE_WIFI_ATBM6132U=y
BR2_SENSOR_SC2336P=y
BR2_SOC_INGENIC_T23N=y
BR2_ISP_CLK_200MHZ=y
BR2_THINGINO_AUDIO=y
BR2_THINGINO_BUTTON=y
BR2_THINGINO_MOTORS=y
BR2_THINGINO_SDCARD=y
FLASH_SIZE_8=y
```

## configs/cameras/jooan_w8u_t23n_sc2336_atbm6132u/jooan_w8u_t23n_sc2336_atbm6132u_defconfig
```kconfig
# NAME: Jooan W8-U (T23N, SC2336P, ATBM6132U)
# FRAG: soc-xburst1 core ssl
BR2_INGENIC_SOC_MODEL="t23n"
BR2_ISP_CLK_200MHZ=y
BR2_ISP_DIRECT_MODE_0=y
BR2_ISP_MEMOPT_0=y
BR2_PACKAGE_THINGINO_KOPT_MMC0=y
BR2_PACKAGE_THINGINO_KOPT_MMC0_PB_4BIT=y
BR2_PACKAGE_THINGINO_RAPTOR_CONF_OSD_ISP_OSD_TRUE=y
BR2_PACKAGE_THINGINO_RAPTOR_CONF_RTSP_ENDPOINT_S1_MAIN="ch2"
BR2_PACKAGE_THINGINO_RAPTOR_CONF_RTSP_ENDPOINT_S1_SUB="ch3"
BR2_PACKAGE_THINGINO_RAPTOR_CONF_S1S0_FPS="15"
BR2_PACKAGE_THINGINO_RAPTOR_CONF_S1S1_FPS="15"
BR2_PACKAGE_THINGINO_RAPTOR_CONF_SENSOR0_I2C_ADDR="0x30"
BR2_PACKAGE_THINGINO_RAPTOR_CONF_SENSOR0_NAME="sc2336p"
BR2_PACKAGE_THINGINO_RAPTOR_CONF_SENSOR1_I2C_ADDR="0x32"
BR2_PACKAGE_THINGINO_RAPTOR_CONF_SENSOR1_NAME="sc2336ps1"
BR2_PACKAGE_THINGINO_RAPTOR_CONF_STREAM0_FPS="15"
BR2_PACKAGE_THINGINO_RAPTOR_CONF_STREAM1_FPS="15"
BR2_PACKAGE_WIFI=y
BR2_PACKAGE_WIFI_ATBM6132U=y
BR2_SENSOR_1_NAME="sc2336ps0"
BR2_SENSOR_2_NAME="sc2336ps1"
BR2_THINGINO_AUDIO=y
BR2_THINGINO_AUDIO_GPIO=63
BR2_THINGINO_AUDIO_GPIO_LOW=y
BR2_THINGINO_BUTTON=y
BR2_THINGINO_IMAGE_SENSOR_QTY=2
BR2_THINGINO_MOTORS=y
BR2_THINGINO_PWM_ENABLE=y
BR2_THINGINO_RMEM_MB=34
BR2_THINGINO_SDCARD=y
FLASH_SIZE_MB=8
```

## configs/cameras/litokam_c1_t31l_sc2336_atbm6012b/litokam_c1_t31l_sc2336_atbm6012b_defconfig
```kconfig
# NAME: Litokam C1 (T31L, SC2336, ATBM6012B)
# MODULE: t31l_sc2336_atbm6012b
BR2_AVPU_VPLL=y
BR2_ISP_CLK_220MHZ=y
BR2_ISP_PARAMS="isp_ch0_pre_dequeue_time=20 isp_ch0_pre_dequeue_interrupt_process=0 isp_ch0_pre_dequeue_valid_lines=540 isp_day_night_switch_drop_frame_num=6"
BR2_PACKAGE_THINGINO_KOPT_MMC0=y
BR2_PACKAGE_THINGINO_KOPT_MMC0_PB_4BIT=y
BR2_SENSOR_PARAMS="shvflip=1"
BR2_THINGINO_AUDIO=y
BR2_THINGINO_BUTTON=y
BR2_THINGINO_SDCARD=y
FLASH_SIZE_8=y
```

## configs/cameras/litokam_m1_t31l_sc3336_atbm6012b/litokam_m1_t31l_sc3336_atbm6012b_defconfig
```kconfig
# NAME: Litokam M1 (T31L, SC3336, ATBM6012B)
# MODULE: t31l_sc3336_atbm6012b
BR2_ISP_PARAMS="isp_ch0_pre_dequeue_time=10 isp_ch0_pre_dequeue_interrupt_process=0 isp_ch0_pre_dequeue_valid_lines=540 isp_day_night_switch_drop_frame_num=6"
BR2_SENSOR_PARAMS="shvflip=1"
BR2_ISP_CLK_220MHZ=y
BR2_AVPU_VPLL=y
BR2_THINGINO_AUDIO=y
BR2_THINGINO_MOTORS_TCU=y
BR2_THINGINO_MOTORS=y
BR2_THINGINO_RMEM_25=y
BR2_THINGINO_SDCARD=y
BR2_THINGINO_PWM_ENABLE=y
FLASH_SIZE_8=y
BR2_PACKAGE_THINGINO_KOPT_MMC0=y
BR2_PACKAGE_THINGINO_KOPT_MMC0_PB_4BIT=y
BR2_PACKAGE_THINGINO_KOPT_MMC1=y
BR2_PACKAGE_THINGINO_KOPT_MMC1_PB_4BIT=y
BR2_PACKAGE_THINGINO_KOPT_ADC=y
BR2_PACKAGE_THINGINO_KOPT_DWC2=y
BR2_PACKAGE_THINGINO_KOPT_DWC2_OTG=y
```

## configs/cameras/lsc_3215672_t23n_sc2331_atbm6012bx/lsc_3215672_t23n_sc2331_atbm6012bx_defconfig
```kconfig
# NAME: LSC 3215672 (T23N, SC2331, ATBM6012BX)
# MODULE: t23n_sc2331_atbm6012bx
BR2_THINGINO_RMEM_18=y
BR2_PACKAGE_THINGINO_KOPT_MMC0=y
BR2_PACKAGE_THINGINO_KOPT_MMC0_PB_4BIT=y
BR2_THINGINO_AUDIO=y
BR2_THINGINO_BUTTON=y
BR2_THINGINO_SDCARD=y
FLASH_SIZE_8=y
```

## configs/cameras/mobicam_2025_t23n_sc1346_atbm6132u/mobicam_2025_t23n_sc1346_atbm6132u_defconfig
```kconfig
# NAME: MOBI Cam 2025 (T23N, SC1346, ATBM6132U)
# FRAG: soc-xburst1 toolchain-xburst1 ccache brand rootfs kernel system target uboot ssl
BR2_PACKAGE_WIFI=y
BR2_PACKAGE_WIFI_ATBM6132U=y
BR2_SENSOR_SC1346=y
BR2_SOC_INGENIC_T23N=y
BR2_THINGINO_AUDIO=y
BR2_THINGINO_BUTTON=y
BR2_THINGINO_SDCARD=y
FLASH_SIZE_8=y
```

## configs/cameras/nexht_86336_t21z_jxf37_rtl8188ftv/nexht_86336_t21z_jxf37_rtl8188ftv_defconfig
```kconfig
# NAME: NexHT 86336 (T21Z, JXF37, RTL8188FTV)
# MODULE: t21z_jxf37_rtl8188ftv
BR2_PACKAGE_THINGINO_KOPT_MMC0=y
BR2_PACKAGE_THINGINO_KOPT_MMC0_PB_4BIT=y
BR2_SENSOR_PARAMS="sensor_gpio_func=0"
BR2_THINGINO_AUDIO=y
BR2_THINGINO_BUTTON=y
BR2_THINGINO_MOTORS=y
BR2_THINGINO_DEVICE_TYPE_IPCAM=y
BR2_THINGINO_DEVICE_TYPE_IPCAM_PAN_TILT=y
BR2_THINGINO_SDCARD=y
FLASH_SIZE_8=y
```
