## configs/cameras/wansview_106_t31n_jxf37/wansview_106_t31n_jxf37_defconfig
```kconfig
# NAME: Wansview 106 (T31N, JXF37)
# FRAG: soc-xburst1 ccache brand rootfs kernel system target uboot ssl
BR2_THINGINO_TOOLCHAIN_TYPE_EXTERNAL=y
BR2_THINGINO_TOOLCHAIN_GCC_15=y
BR2_THINGINO_TOOLCHAIN_LIBC_MUSL=y
BR2_AVPU_CLK_500MHZ=y
BR2_ISP_CLK_200MHZ=y
BR2_PACKAGE_MOTORS=y
BR2_PACKAGE_THINGINO_KOPT_DWC2=y
BR2_PACKAGE_THINGINO_KOPT_DWC2_OTG=y
BR2_PACKAGE_THINGINO_MOTORS_DW9714_ONLY=y
BR2_PACKAGE_USBNET=y
BR2_PACKAGE_USBNET_USB_DIRECT_NCM=y
BR2_SENSOR_1_NAME="jxf37"
BR2_SENSOR_PARAMS="data_interface=1"
BR2_INGENIC_SOC_MODEL="t31n"
BR2_THINGINO_AUDIO=y
BR2_THINGINO_MOTORS=y
FLASH_SIZE_MB=8
```

## configs/cameras/wansview_a1_t23zn_os02g10_atbm6461/wansview_a1_t23zn_os02g10_atbm6461_defconfig
```kconfig
# NAME: Wansview A1 (T23ZN, OS02G10, ATBM6461)
# FRAG: soc-xburst1 core ssl
#
# SoC:    Ingenic T23ZN, XBurst1 MIPS32 R1, 64MB RAM (46M+18M split)
# Sensor: OmniVision OS02G10, 1/2.9" 2MP, I2C 0x3c, reg_addr_size=0 (ZRT bank-switch)
# WiFi:   AltoBeam ATBM6461, SDIO, also manages hardware MCU watchdog
# Flash:  16MB NOR SPI
# UART:   ttyS1
#
# NOTES:
#  - OS02G10 T23 sensor driver not yet in ingenic-sdk; port from ZRT SDK
#    os/drivers/sensor-t23/zeratul/os02g10/ or from ingenic-sdk-matteius t31/os02g10.c
#  - ATBM6461 .ko is a binary blob (no upstream source); vermagic is patched at
#    build time by package/wifi-atbm6461 to match CONFIG_LOCALVERSION.
#  - MCU WiFi/battery commands are provided by package/atbm6461-tools. Do not
#    add per-camera mcu_test binaries under this profile overlay.
#  - MCU watchdog (~13s timeout) is disabled by z7682_disable_wdt via librtos.so
#    on /dev/atbm_ioctl; S02atbm-wdt init script runs at early boot before S36wireless
#  - Reset button is MCU-managed (key_enable/key_disable via rtos_cmd_send, not a GPIO);
#    BR2_THINGINO_BUTTON is not set — a custom z7682_daemon integration is needed
#  - GPIO: ircut=57 (single-pin, phwi0 double/single states), ir940=38 (phwi1),
#    phwi2=GPIO16 (role TBD: audio amp?), led_b=49, led_r=50
#    All assignments from AJCloud binary analysis; verify on hardware

BR2_INGENIC_SOC_MODEL="t23zn"
BR2_ISP_CLKA_600MHZ=y
BR2_ISP_CLKA_SCLKA=y
BR2_ISP_CLK_200MHZ=y
BR2_ISP_CLK_SCLKA=y
BR2_ISP_PRINT_LEVEL_0=y
BR2_LINUX_KERNEL_CONFIG_FRAGMENT_FILES="$(BR2_EXTERNAL_THINGINO_PATH)/configs/cameras/wansview_a1_t23zn_os02g10_atbm6461/wansview_a1_t23zn.kernel.config"
BR2_PACKAGE_THINGINO_KOPT_MMC0=y
BR2_PACKAGE_THINGINO_KOPT_MMC0_PB_4BIT=y
BR2_PACKAGE_THINGINO_WPA_SUPPLICANT_WEXT=y
BR2_PACKAGE_WIFI=y
BR2_PACKAGE_WIFI_ATBM6461=y
BR2_SENSOR_1_NAME="os02g10"
BR2_THINGINO_AUDIO=y
BR2_THINGINO_AUDIO_GPIO=63
BR2_THINGINO_DEV_BATTERY=y
BR2_THINGINO_RMEM_MB=18
BR2_THINGINO_SDCARD=y
FLASH_SIZE_MB=16
```

## configs/cameras/wansview_g6_t31l_sc2336_atbm6012b/wansview_g6_t31l_sc2336_atbm6012b_defconfig
```kconfig
# NAME: Wansview G6 (T31L, SC2336, ATBM6012B)
# FRAG: soc-xburst1 toolchain-xburst1 ccache brand rootfs kernel system target uboot ssl
BR2_PACKAGE_WIFI=y
BR2_PACKAGE_WIFI_ATBM6012B=y
BR2_SENSOR_SC2336=y
BR2_SOC_INGENIC_T31L=y
BR2_AVPU_CLK_600MHZ=y
BR2_ISP_CLK_125MHZ=y
BR2_PACKAGE_THINGINO_KOPT_MMC0=y
BR2_PACKAGE_THINGINO_KOPT_MMC0_PB_4BIT=y
BR2_THINGINO_AUDIO=y
BR2_THINGINO_BUTTON=y
BR2_THINGINO_MOTORS=y
BR2_THINGINO_PWM_ENABLE=y
BR2_THINGINO_RMEM_22=y
BR2_THINGINO_SDCARD=y
FLASH_SIZE_8=y
```

## configs/cameras/wansview_g6_t31l_sc2336_ssv6256p/wansview_g6_t31l_sc2336_ssv6256p_defconfig
```kconfig
# NAME: Wansview G6 (T31L, SC2336, SSV6256P)
# FRAG: soc-xburst1 toolchain-xburst1 ccache brand rootfs kernel system target uboot ssl
BR2_PACKAGE_WIFI=y
BR2_SENSOR_1_NAME="sc2336"
BR2_SOC_INGENIC_T31L=y
BR2_PACKAGE_WIFI_SSV6X5X=y
BR2_PACKAGE_WIFI_SSV6X5X_SV6256P=y
BR2_AVPU_CLK_600MHZ=y
BR2_ISP_CLK_125MHZ=y
BR2_PACKAGE_THINGINO_KOPT_MMC0=y
BR2_PACKAGE_THINGINO_KOPT_MMC0_PB_4BIT=y
BR2_THINGINO_AUDIO=y
BR2_THINGINO_BUTTON=y
BR2_THINGINO_MOTORS=y
BR2_THINGINO_PWM_ENABLE=y
BR2_THINGINO_RMEM_MB=22
BR2_THINGINO_SDCARD=y
FLASH_SIZE_MB=8
BR2_THINGINO_AUDIO_GPIO=7
#BR2_THINGINO_AUDIO_GPIO_LOW=y
```

## configs/cameras/wansview_q5_t21n_os02b10_rtl8188ftv/wansview_q5_t21n_os02b10_rtl8188ftv_defconfig
```kconfig
# NAME: Wansview Q5 (T21N, OS02B10, RTL8188FTV)
# FRAG: soc-xburst1 toolchain-xburst1 ccache brand rootfs kernel system target uboot ssl
BR2_PACKAGE_THINGINO_KOPT_MMC0=y
BR2_PACKAGE_THINGINO_KOPT_MMC0_PB_4BIT=y
BR2_PACKAGE_WIFI=y
BR2_PACKAGE_WIFI_RTL8188FU=y
BR2_SENSOR_1_NAME="os02b10"
BR2_SENSOR_PARAMS="sensor_gpio_func=0"
BR2_SOC_INGENIC_T21N=y
BR2_THINGINO_AUDIO=y
BR2_THINGINO_AUDIO_GPIO=63
BR2_THINGINO_AUDIO_GPIO_LOW=y
BR2_THINGINO_BUTTON=y
BR2_THINGINO_MOTORS=y
BR2_THINGINO_SDCARD=y
FLASH_SIZE_MB=8
```

## configs/cameras/wansview_q6_t21n_os02b10_mt7601u/wansview_q6_t21n_os02b10_mt7601u_defconfig
```kconfig
# NAME: Wansview Q6 (T21N, OS02B10, MT7601U)
# FRAG: soc-xburst1 toolchain-xburst1 ccache brand rootfs kernel system target uboot ssl
BR2_PACKAGE_WIFI=y
BR2_PACKAGE_WIFI_MT7601U=y
BR2_SENSOR_OS02B10=y
BR2_SOC_INGENIC_T21N=y
BR2_PACKAGE_THINGINO_KOPT_MMC0=y
BR2_PACKAGE_THINGINO_KOPT_MMC0_PB_4BIT=y
BR2_SENSOR_PARAMS="sensor_gpio_func=0"
BR2_THINGINO_AUDIO=y
BR2_THINGINO_BUTTON=y
BR2_THINGINO_MOTORS=y
BR2_THINGINO_SDCARD=y
FLASH_SIZE_8=y
```

## configs/cameras/wansview_w5_t21n_ps5260_eth+mt7601sta/wansview_w5_t21n_ps5260_eth+mt7601sta_defconfig
```kconfig
# NAME: Wansview W5 (T21N, PS5260, ETH, MT7601STA)
# FRAG: soc-xburst1 toolchain-xburst1 ccache brand rootfs kernel system target uboot ssl
BR2_PACKAGE_WIFI=y
BR2_PACKAGE_WIFI_MT7601U=y
BR2_SENSOR_PS5260=y
BR2_SOC_INGENIC_T21N=y
BR2_ETHERNET=y
BR2_ISP_CLK_125MHZ=y
BR2_PACKAGE_THINGINO_KOPT_ADC=y
BR2_PACKAGE_THINGINO_KOPT_JZ_MAC_INTERNAL_PHY=y
BR2_PACKAGE_THINGINO_KOPT_JZ_MAC_V13=y
BR2_PACKAGE_THINGINO_KOPT_MMC0=y
BR2_PACKAGE_THINGINO_KOPT_MMC0_PB_4BIT=y
BR2_THINGINO_AUDIO=y
BR2_THINGINO_BUTTON=y
BR2_THINGINO_RMEM_22=y
BR2_THINGINO_SDCARD=y
FLASH_SIZE_16=y
```

## configs/cameras/wansview_w6_t21n_os02g10_eth+rtl8188ftv/wansview_w6_t21n_os02g10_eth+rtl8188ftv_defconfig
```kconfig
# NAME: Wansview W6 (T21N, OS02G10, ETH, RTL8188FTV)
# FRAG: soc-xburst1 toolchain-xburst1 ccache brand rootfs kernel system target uboot ssl
BR2_PACKAGE_WIFI=y
BR2_PACKAGE_WIFI_RTL8188FU=y
BR2_SENSOR_OS02G10=y
BR2_SOC_INGENIC_T21N=y
BR2_ETHERNET=y
BR2_ISP_CLK_125MHZ=y
BR2_PACKAGE_THINGINO_KOPT_ADC=y
BR2_PACKAGE_THINGINO_KOPT_JZ_MAC_INTERNAL_PHY=y
BR2_PACKAGE_THINGINO_KOPT_JZ_MAC_V13=y
BR2_PACKAGE_THINGINO_KOPT_MMC0=y
BR2_PACKAGE_THINGINO_KOPT_MMC0_PB_4BIT=y
BR2_THINGINO_AUDIO=y
BR2_THINGINO_BUTTON=y
BR2_THINGINO_RMEM_22=y
BR2_THINGINO_SDCARD=y
FLASH_SIZE_16=y
```

## configs/cameras/wansview_w7_t31l_sc2336_atbm6012b/wansview_w7_t31l_sc2336_atbm6012b_defconfig
```kconfig
# NAME: Wansview W7 (T31L, SC2336, ATBM6012B)
# MODULE: t31l_sc2336_atbm6012b
BR2_AVPU_VPLL=y
BR2_PACKAGE_THINGINO_KOPT_MMC0=y
BR2_PACKAGE_THINGINO_KOPT_MMC0_PB_4BIT=y
BR2_ISP_CH0_PRE_DEQUEUE_TIME=y
BR2_ISP_CH0_PRE_DEQUEUE_TIME_VALUE=24
BR2_ISP_CH0_PRE_DEQUEUE_INTERRUPT_PROCESS=y
BR2_ISP_CH0_PRE_DEQUEUE_INTERRUPT_PROCESS_VALUE=0
BR2_SENSOR_PARAMS="shvflip=1"
BR2_THINGINO_AUDIO=y
BR2_THINGINO_BUTTON=y
BR2_THINGINO_MOTORS=y
BR2_THINGINO_RMEM_22=y
BR2_THINGINO_SDCARD=y
FLASH_SIZE_8=y
```

## configs/cameras/wuuk_y0310_t31x_sc401ai_ssv6158/wuuk_y0310_t31x_sc401ai_ssv6158_defconfig
```kconfig
# NAME: WUUK Y0310 (T31X, SC401AI, SSV6158)
# FRAG: soc-xburst1 toolchain-xburst1 ccache brand rootfs kernel system target uboot ssl
BR2_PACKAGE_WIFI=y
BR2_PACKAGE_WIFI_SSV6158=y
BR2_SENSOR_SC401AI=y
BR2_SOC_INGENIC_T31X=y
BR2_AVPU_CLK_400MHZ=y
BR2_AVPU_VPLL=y
BR2_ISP_CLK_200MHZ=y
BR2_PACKAGE_THINGINO_KOPT_DWC2=y
BR2_PACKAGE_THINGINO_KOPT_DWC2_OTG=y
BR2_PACKAGE_THINGINO_KOPT_MMC0=y
BR2_PACKAGE_THINGINO_KOPT_MMC0_PB_4BIT=y
BR2_PACKAGE_THINGINO_KOPT_MMC1=y
BR2_PACKAGE_THINGINO_KOPT_MMC1_PB_4BIT=y
BR2_THINGINO_AUDIO=y
BR2_THINGINO_BUTTON=y
BR2_THINGINO_RMEM_50=y
BR2_THINGINO_SDCARD=y
FLASH_SIZE_16=y
```

## configs/cameras/wyze_cam2_t20x_jxf22_rtl8189ftv/wyze_cam2_t20x_jxf22_rtl8189ftv_defconfig
```kconfig
# NAME: Wyze Cam v2 (T20X, JXF22, RTL8189FTV)
# FRAG: soc-xburst1 toolchain-xburst1 ccache brand rootfs kernel system target uboot ssl
BR2_PACKAGE_WIFI=y
BR2_PACKAGE_WIFI_RTL8189FS=y
BR2_SENSOR_JXF22=y
BR2_SOC_INGENIC_T20X=y
BR2_ISP_CLK_100MHZ=y
BR2_PACKAGE_THINGINO_KOPT_DWC2=y
BR2_PACKAGE_THINGINO_KOPT_DWC2_OTG=y
BR2_PACKAGE_THINGINO_KOPT_MMC0=y
BR2_PACKAGE_THINGINO_KOPT_MMC0_PB_4BIT=y
BR2_PACKAGE_THINGINO_KOPT_MMC1=y
BR2_PACKAGE_THINGINO_KOPT_MMC1_PC_4BIT=y
BR2_PACKAGE_WYZE_ACCESSORY=y
BR2_PACKAGE_WYZE_ACCESSORY_CAR=y
BR2_THINGINO_AUDIO=y
BR2_THINGINO_BUTTON=y
BR2_THINGINO_PWM_ENABLE=y
BR2_THINGINO_ISPMEM_11=y
BR2_THINGINO_RMEM_22=y
BR2_THINGINO_SDCARD=y
FLASH_SIZE_16=y
```

## configs/cameras/wyze_cam3_t31x_gc2053_rtl8189ftv/wyze_cam3_t31x_gc2053_rtl8189ftv_defconfig
```kconfig
# NAME: Wyze Cam v3 (T31X, GC2053, RTL8189FTV)
# MODULE: t31x_gc2053_rtl8189ftv
BR2_AVPU_CLK_600MHZ=y
BR2_ISP_CLK_200MHZ=y
BR2_PACKAGE_THINGINO_KOPT_DWC2=y
BR2_PACKAGE_THINGINO_KOPT_DWC2_OTG=y
BR2_PACKAGE_THINGINO_KOPT_MMC0=y
BR2_PACKAGE_THINGINO_KOPT_MMC0_PB_4BIT=y
BR2_PACKAGE_THINGINO_KOPT_MMC1=y
BR2_PACKAGE_THINGINO_KOPT_MMC1_PB_4BIT=y
BR2_PACKAGE_WYZE_ACCESSORY=y
BR2_PACKAGE_WYZE_ACCESSORY_CAR=y
BR2_PACKAGE_WYZE_ACCESSORY_SPOTLIGHT=y
BR2_SENSOR_PARAMS="sensor_max_fps=30 data_interface=1"
BR2_THINGINO_AUDIO=y
BR2_THINGINO_BUTTON=y
BR2_THINGINO_PWM_ENABLE=y
BR2_THINGINO_SDCARD=y
BR2_THINGINO_DEVICE_TYPE_IPCAM=y
BR2_THINGINO_DEVICE_TYPE_IPCAM_STANDARD=y
FLASH_SIZE_16=y
```

## configs/cameras/wyze_camfl1_t31al_atbm6031/wyze_camfl1_t31al_atbm6031_defconfig
```kconfig
# NAME: Wyze Cam Floodlight v1 (T31AL, GC2053, ATBM6031)
# MODULE: t31al_gc2053_atbm6031
BR2_AVPU_CLK_600MHZ=y
BR2_ISP_CLK_200MHZ=y
BR2_PACKAGE_THINGINO_KOPT_DWC2=y
BR2_PACKAGE_THINGINO_KOPT_DWC2_OTG=y
BR2_PACKAGE_THINGINO_KOPT_MMC0=y
BR2_PACKAGE_THINGINO_KOPT_MMC0_PB_4BIT=y
BR2_PACKAGE_THINGINO_KOPT_MMC1=y
BR2_PACKAGE_THINGINO_KOPT_MMC1_PB_4BIT=y
BR2_PACKAGE_WYZE_ACCESSORY=y
BR2_PACKAGE_WYZE_ACCESSORY_FLOODLIGHT=y
BR2_SENSOR_PARAMS="sensor_max_fps=30 data_interface=1"
BR2_THINGINO_AUDIO=y
BR2_THINGINO_BUTTON=y
BR2_THINGINO_PWM_ENABLE=y
BR2_THINGINO_SDCARD=y
FLASH_SIZE_16=y
```

## configs/cameras/wyze_campan1_t20x_jxf22_rtl8189etv/wyze_campan1_t20x_jxf22_rtl8189etv_defconfig
```kconfig
# NAME: Wyze Cam Pan v1 (T20X, JXF22, RTL8189ETV)
# MODULE: t20x_jxf22_rtl8189etv
BR2_ISP_CLK_100MHZ=y
BR2_PACKAGE_THINGINO_KOPT_DWC2=y
BR2_PACKAGE_THINGINO_KOPT_DWC2_OTG=y
BR2_PACKAGE_THINGINO_KOPT_MMC0=y
BR2_PACKAGE_THINGINO_KOPT_MMC0_PB_4BIT=y
BR2_PACKAGE_THINGINO_KOPT_MMC1=y
BR2_PACKAGE_THINGINO_KOPT_MMC1_PC_4BIT=y
BR2_PACKAGE_WYZE_ACCESSORY=y
BR2_PACKAGE_WYZE_ACCESSORY_CAR=y
BR2_PACKAGE_WYZE_ACCESSORY_SPOTLIGHT=y
BR2_THINGINO_AUDIO=y
BR2_THINGINO_BUTTON=y
BR2_THINGINO_MOTORS=y
BR2_THINGINO_ISPMEM_11=y
BR2_THINGINO_RMEM_22=y
BR2_THINGINO_SDCARD=y
FLASH_SIZE_16=y
```

## configs/cameras/wyze_vdb1_t30x_sc4236_rtl8189ftv/wyze_vdb1_t30x_sc4236_rtl8189ftv_defconfig
```kconfig
# NAME: Wyze Video Doorbell v1 (T30X, SC4236, RTL8189FTV)
# FRAG: soc-xburst1 toolchain-xburst1 ccache brand rootfs kernel system target uboot ssl
BR2_PACKAGE_WIFI=y
BR2_PACKAGE_WIFI_RTL8189FS=y
BR2_SENSOR_SC4236=y
BR2_SOC_INGENIC_T30X=y
BR2_ISP_CLK_150MHZ=y
BR2_ISP_ISP_M1_BUFS=y
BR2_ISP_ISP_M1_BUFS_VALUE=4
BR2_ISP_ISP_M2_BUFS=y
BR2_ISP_ISP_M2_BUFS_VALUE=2
BR2_PACKAGE_THINGINO_KOPT_DWC2=y
BR2_PACKAGE_THINGINO_KOPT_DWC2_OTG=y
BR2_PACKAGE_THINGINO_KOPT_MMC1=y
BR2_PACKAGE_THINGINO_KOPT_MMC1_PC_4BIT=y
BR2_PACKAGE_THINGINO_KOPT_UART=y
BR2_PACKAGE_THINGINO_KOPT_UART_UART0=y
BR2_PACKAGE_WYZE_ACCESSORY=y
BR2_PACKAGE_WYZE_ACCESSORY_DOORBELL_CTRL=y
BR2_SENSOR_PARAMS="sensor_resolution=300"
BR2_THINGINO_AUDIO=y
BR2_THINGINO_BUTTON=y
BR2_THINGINO_DEV_DOORBELL=y
BR2_THINGINO_GPIO_LIST="60O"
BR2_THINGINO_PWM_ENABLE=y
BR2_THINGINO_RMEM_42=y
FLASH_SIZE_16=y
```

## configs/cameras/wyze_vdb1_t31x_sc4236_rtl8189ftv/wyze_vdb1_t31x_sc4236_rtl8189ftv_defconfig
```kconfig
# NAME: Wyze Video Doorbell v1 (T31X, SC4236, RTL8189FTV)
# MODULE: t31x_sc4236_rtl8189ftv
BR2_AVPU_CLK_600MHZ=y
BR2_ISP_CLK_200MHZ=y
BR2_PACKAGE_THINGINO_KOPT_DWC2=y
BR2_PACKAGE_THINGINO_KOPT_DWC2_OTG=y
BR2_PACKAGE_THINGINO_KOPT_MMC1=y
BR2_PACKAGE_THINGINO_KOPT_MMC1_PB_4BIT=y
BR2_PACKAGE_THINGINO_KOPT_MMC=y
BR2_PACKAGE_THINGINO_KOPT_UART=y
BR2_PACKAGE_THINGINO_KOPT_UART_UART0=y
BR2_PACKAGE_WYZE_ACCESSORY=y
BR2_PACKAGE_WYZE_ACCESSORY_DOORBELL_CTRL=y
BR2_THINGINO_AUDIO=y
BR2_THINGINO_BUTTON=y
BR2_THINGINO_DEVICE_TYPE_DOORBELL=y
BR2_THINGINO_GPIO_LIST="61O"
BR2_THINGINO_PWM_ENABLE=y
BR2_THINGINO_RMEM_42=y
FLASH_SIZE_16=y
```

## configs/cameras/xiaomi_hlcam04_t31n_sc3335_atbm6031/xiaomi_hlcam04_t31n_sc3335_atbm6031_defconfig
```kconfig
# NAME: Xiaomi HL-CAM04 (T31N, SC3335, ATBM6031)
# MODULE: t31n_sc3335_atbm6031
BR2_AVPU_CLK_500MHZ=y
BR2_ISP_CH0_PRE_DEQUEUE_TIME=y
BR2_ISP_CH0_PRE_DEQUEUE_TIME_VALUE=14
BR2_ISP_CH0_PRE_DEQUEUE_INTERRUPT_PROCESS=y
BR2_ISP_CH0_PRE_DEQUEUE_INTERRUPT_PROCESS_VALUE=0
BR2_ISP_CH0_PRE_DEQUEUE_VALID_LINES=y
BR2_ISP_CH0_PRE_DEQUEUE_VALID_LINES_VALUE=540
BR2_PACKAGE_THINGINO_KOPT_DWC2=y
BR2_PACKAGE_THINGINO_KOPT_DWC2_OTG=y
BR2_PACKAGE_THINGINO_KOPT_MMC0=y
BR2_PACKAGE_THINGINO_KOPT_MMC0_PB_4BIT=y
BR2_PACKAGE_THINGINO_KOPT_MMC1=y
BR2_PACKAGE_THINGINO_KOPT_MMC1_PB_4BIT=y
BR2_SENSOR_PARAMS="data_interface=1 shvflip=1"
BR2_THINGINO_AUDIO=y
BR2_THINGINO_AUDIO_PARAMS="alc_mode=0 mic_gain=0"
BR2_THINGINO_BUTTON=y
BR2_THINGINO_RMEM_24=y
BR2_THINGINO_SDCARD=y
FLASH_SIZE_16=y
```

## configs/cameras/xiaomi_mjsxj03hl_t31n_jxq03_rtl8189ftv/xiaomi_mjsxj03hl_t31n_jxq03_rtl8189ftv_defconfig
```kconfig
# NAME: Xiaomi MJSXJ03HL (T31N, JXQ03, RTL8189FTV)
# MODULE: t31n_jxq03_rtl8189ftv
BR2_AVPU_VPLL=y
BR2_PACKAGE_THINGINO_KOPT_DWC2=y
BR2_PACKAGE_THINGINO_KOPT_DWC2_OTG=y
BR2_PACKAGE_THINGINO_KOPT_MMC0=y
BR2_PACKAGE_THINGINO_KOPT_MMC0_PB_4BIT=y
BR2_PACKAGE_THINGINO_KOPT_MMC1=y
BR2_PACKAGE_THINGINO_KOPT_MMC1_PB_4BIT=y
BR2_PACKAGE_THINGINO_UBOOT_BOARDNAME="isvp_t31_xiaomi_sfcnor"
BR2_PACKAGE_THINGINO_UBOOT_FORMAT_CUSTOM_NAME="u-boot-with-spl.bin"
BR2_THINGINO_AUDIO=y
BR2_THINGINO_BUTTON=y
BR2_THINGINO_RMEM_32=y
BR2_THINGINO_SDCARD=y
FLASH_SIZE_16=y
```

## configs/cameras/xiaomi_sxj02zm_t20l_ps5250_rtl8189ftv/xiaomi_sxj02zm_t20l_ps5250_rtl8189ftv_defconfig
```kconfig
# NAME: Xiaomi SXJ02ZM (T20L, PS5250, RTL8189FTV)
# MODULE: t20l_ps5250_rtl8189ftv
BR2_PACKAGE_THINGINO_KOPT_DWC2=y
BR2_PACKAGE_THINGINO_KOPT_DWC2_OTG=y
BR2_PACKAGE_THINGINO_KOPT_MMC0=y
BR2_PACKAGE_THINGINO_KOPT_MMC0_PB_4BIT=y
BR2_PACKAGE_THINGINO_KOPT_MMC1=y
BR2_PACKAGE_THINGINO_KOPT_MMC1_PC_4BIT=y
BR2_THINGINO_AUDIO=y
BR2_THINGINO_BUTTON=y
BR2_THINGINO_ISPMEM_8=y
BR2_THINGINO_RMEM_24=y
BR2_THINGINO_SDCARD=y
FLASH_SIZE_16=y
```

## configs/cameras/xiaomi_xiaofang_t20l_jxf22_rtl8189ftv/xiaomi_xiaofang_t20l_jxf22_rtl8189ftv_defconfig
```kconfig
# NAME: Xiaomi Xiaofang iSC5 (T20L, JXF22, RTL8189FTV)
# FRAG: soc-xburst1 toolchain-xburst1 ccache brand rootfs kernel system target uboot ssl
BR2_PACKAGE_WIFI=y
BR2_PACKAGE_WIFI_RTL8189FS=y
BR2_SENSOR_JXF22=y
BR2_SOC_INGENIC_T20L=y
BR2_PACKAGE_THINGINO_KOPT_DWC2=y
BR2_PACKAGE_THINGINO_KOPT_DWC2_OTG=y
BR2_PACKAGE_THINGINO_KOPT_MMC0=y
BR2_PACKAGE_THINGINO_KOPT_MMC0_PB_4BIT=y
BR2_PACKAGE_THINGINO_KOPT_MMC1=y
BR2_PACKAGE_THINGINO_KOPT_MMC1_PC_4BIT=y
BR2_THINGINO_AUDIO=y
BR2_THINGINO_BUTTON=y
BR2_THINGINO_ISPMEM_5=y
BR2_THINGINO_RMEM_15=y
BR2_THINGINO_SDCARD=y
FLASH_SIZE_16=y
```
