## configs/cameras/xvim_ipcam100_t21n_jxf37_eth+rtl8188ftv/xvim_ipcam100_t21n_jxf37_eth+rtl8188ftv_defconfig
```kconfig
# NAME: XVIM IPCAM-100 (T21N, JXF37, ETH, RTL8188FTV)
# FRAG: soc-xburst1 toolchain-xburst1 ccache brand rootfs kernel system target uboot ssl
BR2_PACKAGE_WIFI=y
BR2_PACKAGE_WIFI_RTL8188FU=y
BR2_SENSOR_JXF37=y
BR2_SOC_INGENIC_T21N=y
BR2_ETHERNET=y
BR2_ISP_CLK_120MHZ=y
BR2_PACKAGE_THINGINO_KOPT=y
BR2_PACKAGE_THINGINO_KOPT_ADC=y
BR2_PACKAGE_THINGINO_KOPT_JZ_MAC_INTERNAL_PHY=y
BR2_PACKAGE_THINGINO_KOPT_JZ_MAC_V13=y
BR2_PACKAGE_THINGINO_KOPT_MMC0=y
BR2_PACKAGE_THINGINO_KOPT_MMC0_PB_4BIT=y
BR2_PACKAGE_THINGINO_KOPT_MMC=y
BR2_SENSOR_PARAMS="sensor_max_fps=25 sensor_gpio_func=0"
BR2_THINGINO_AUDIO=y
BR2_THINGINO_BUTTON=y
BR2_THINGINO_MOTORS=y
BR2_THINGINO_MOTORS_TCU=y
BR2_THINGINO_SDCARD=y
FLASH_SIZE_8=y
```

## configs/cameras/zte_k540_t31x_sc4336_eth/zte_k540_t31x_sc4336_eth_defconfig
```kconfig
# NAME: ZTE K540 (T31X, SC4336, ETH)
# MODULE: t31x_sc4336_eth
BR2_ETHERNET=y
BR2_ISP_CLK_200MHZ=y
BR2_PACKAGE_THINGINO_KOPT_DWC2=y
BR2_PACKAGE_THINGINO_KOPT_DWC2_OTG=y
BR2_PACKAGE_THINGINO_KOPT_JZ_MAC=y
BR2_PACKAGE_THINGINO_KOPT_JZ_MAC_V13=y
BR2_PACKAGE_THINGINO_KOPT_MMC0=y
BR2_PACKAGE_THINGINO_KOPT_MMC0_PB_4BIT=y
BR2_PACKAGE_WIFI=y
BR2_PACKAGE_WIFI_ATBM6032=y
BR2_THINGINO_AUDIO=y
BR2_THINGINO_BUTTON=y
BR2_THINGINO_MOTORS=y
BR2_THINGINO_RMEM_48=y
BR2_THINGINO_SDCARD=y
FLASH_SIZE_16=y
```

## configs/cinnado_d1_t31l_sc2336_defconfig
```kconfig
BR2_mipsel=y
BR2_mips_xburst=y
# BR2_MIPS_SOFT_FLOAT is not set
BR2_MIPS_FP32_MODE_32=y
BR2_TOOLCHAIN_BUILDROOT_VENDOR="thingino"
BR2_TOOLCHAIN_BUILDROOT_MUSL=y
BR2_KERNEL_HEADERS_VERSION=y
BR2_DEFAULT_KERNEL_VERSION="3.10.14"
BR2_PACKAGE_HOST_LINUX_HEADERS_CUSTOM_3_10=y
BR2_GCC_VERSION_13_X=y
BR2_EXTRA_GCC_CONFIG_OPTIONS="--with-float=hard"
BR2_TOOLCHAIN_BUILDROOT_CXX=y
BR2_CCACHE=y
BR2_CCACHE_DIR="$(HOME)/.ccache"
BR2_GLOBAL_PATCH_DIR="$(BR2_EXTERNAL)/package/all-patches"
BR2_REPRODUCIBLE=y
BR2_PER_PACKAGE_DIRECTORIES=y
BR2_ROOTFS_MERGED_USR=y
BR2_SYSTEM_DEFAULT_PATH="/bin:/sbin:/usr/bin:/usr/sbin"
BR2_ROOTFS_OVERLAY="$(BR2_EXTERNAL)/overlay"
BR2_ROOTFS_POST_BUILD_SCRIPT="$(BR2_EXTERNAL)/scripts/rootfs_script.sh"
BR2_LINUX_KERNEL=y
BR2_LINUX_KERNEL_CUSTOM_TARBALL=y
BR2_LINUX_KERNEL_CUSTOM_TARBALL_LOCATION="$(THINGINO_KERNEL)"
BR2_LINUX_KERNEL_USE_CUSTOM_CONFIG=y
BR2_LINUX_KERNEL_CUSTOM_CONFIG_FILE="$(BR2_EXTERNAL)/board/$(SOC_VENDOR)/xburst1/kernel/$(SOC_FAMILY).generic.config"
BR2_LINUX_KERNEL_LZMA=y
BR2_PACKAGE_BUSYBOX_CONFIG="$(BR2_EXTERNAL)/package/busybox/busybox.config"
BR2_PACKAGE_WIRELESS_TOOLS=y
BR2_PACKAGE_WPA_SUPPLICANT=y
BR2_PACKAGE_WPA_SUPPLICANT_PASSPHRASE=y
BR2_TARGET_ROOTFS_SQUASHFS=y
BR2_TARGET_ROOTFS_SQUASHFS4_XZ=y
BR2_TARGET_ROOTFS_SQUASHFS_EXTREME_COMP=y
BR2_SENSOR_MODEL="sc2336"
BR2_SOC_INGENIC_T31=y
BR2_THINGINO_SYSTEM_PACKAGES=y
BR2_PACKAGE_ATBM60XX=y
BR2_PACKAGE_ATBM60XX_MODEL_603X=y
BR2_PACKAGE_ATBM60XX_INTERFACE_SDIO=y
BR2_PACKAGE_MOTORS=y
```

## configs/configs/cameras-exp/t31l_sc2336_atbm6031_kernel44/t31l_sc2336_atbm6031_kernel44_defconfig
```kconfig
# NAME: (T31L, SC2336, ATBM6031) with Kernel 4.4
# FRAG: soc toolchain ccache brand rootfs kernel system target local
#BR2_PACKAGE_HOST_LINUX_HEADERS_CUSTOM_3_10 is not set
BR2_LINUX_KERNEL_CUSTOM_CONFIG_FILE="$(BR2_EXTERNAL)/board/ingenic/xburst1/kernel/$(KERNEL_VERSION)/t31l.cinnado_d1.config"
BR2_PACKAGE_E2FSPROGS=y
BR2_PACKAGE_HOST_LINUX_HEADERS_CUSTOM_4_4=y
BR2_PACKAGE_WIFI=y
BR2_PACKAGE_WIFI_ATBM6031=y
BR2_SENSOR_SC2336=y
BR2_SOC_INGENIC_T31L=y
BR2_THINGINO_MOTORS=y
BR2_THINGINO_MOTORS_TCU=y
BR2_TOOLCHAIN_EXTERNAL_HEADERS_4_4=y
BR2_TOOLCHAIN_EXTERNAL_URL="https://github.com/matteius/ingenic-t31-zrt-kernel-4.4.94/releases/download/4.4.latest/mipsel-thingino-linux-musl_sdk-buildroot.tar.gz"
BR2_TOOLCHAIN_USES_MUSL=y
KERNEL_VERSION_4=y
```

## configs/configs/cameras/dekco_dc5l_t23n_sc3332p_ws73v100/dekco_dc5l_t23n_sc3332p_ws73v100_defconfig
```kconfig
# NAME: Dekco DC5L (T23N, SC3332p, WS73V100)
# MODULE: t23n_sc3332p_ws73v100
BR2_AVPU_MPLL=y
BR2_ISP_CH0_PRE_DEQUEUE_TIME=y
BR2_ISP_CH0_PRE_DEQUEUE_TIME_VALUE=24
BR2_ISP_CH0_PRE_DEQUEUE_INTERRUPT_PROCESS=y
BR2_ISP_CH0_PRE_DEQUEUE_INTERRUPT_PROCESS_VALUE=0
BR2_PACKAGE_THINGINO_KOPT_MMC0=y
BR2_PACKAGE_THINGINO_KOPT_MMC0_PB_4BIT=y
BR2_SENSOR_PARAMS="shvflip=1"
BR2_THINGINO_AUDIO=y
BR2_THINGINO_MOTORS=y
BR2_THINGINO_RMEM_32=y
BR2_THINGINO_SDCARD=y
FLASH_SIZE_16=y
```
