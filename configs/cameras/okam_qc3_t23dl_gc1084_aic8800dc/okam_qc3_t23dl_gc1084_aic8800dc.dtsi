// O-KAM QC3 (T23DL, GC1084, AIC8800DC USB) per-board GPIO definitions.
// Reset key PB26 (OEM vp_gpio: input with edge irq, polled by the key thread).
// On kernel 3.10 only the gpio-keys pins are read (scripts/button_pins.sh).
#include <dt-bindings/gpio/gpio.h>
#include <dt-bindings/input/input.h>
#include <dt-bindings/pinctrl/ingenic-pinctrl.h>

/ {
	gpio-keys {
		compatible = "gpio-keys";
		label = "gpio-keys";

		reset {
			label = "reset";
			linux,code = <KEY_ENTER>;
			gpios = <&gpb 26 GPIO_ACTIVE_LOW INGENIC_GPIO_PULLUP>;
		};
	};
};
