## configs/cameras/wanjiaan_hdc51_t31l_sc2332_rtl8188ftv/wanjiaan_hdc51_t31l_sc2332_rtl8188ftv_defconfig
```kconfig
# NAME: Wanjiaan HDC51 (T31L, SC2332, RTL8188FTV)
# FRAG: soc-xburst1 toolchain-xburst1 ccache brand rootfs kernel system target uboot ssl
BR2_PACKAGE_WIFI=y
BR2_PACKAGE_WIFI_RTL8188FU=y
BR2_SENSOR_SC2332=y
BR2_SOC_INGENIC_T31L=y
BR2_PACKAGE_THINGINO_KOPT_MMC0=y
BR2_PACKAGE_THINGINO_KOPT_MMC0_PB_4BIT=y
BR2_SENSOR_PARAMS="data_interface=1 sensor_max_fps=30"
BR2_THINGINO_AUDIO=y
BR2_THINGINO_BUTTON=y
BR2_THINGINO_SDCARD=y
FLASH_SIZE_16=y
```

## configs/cameras/wanjiaan_hdc51_t31l_sc2332_rtl8188ftv_mmc/wanjiaan_hdc51_t31l_sc2332_rtl8188ftv_mmc_defconfig
```kconfig
# NAME: Wanjiaan HDC51 MMC Boot (T31L, SC2332, RTL8188FTV)
# FRAG: soc-xburst1 core ssl
BR2_PACKAGE_THINGINO_KOPT_MMC0=y
BR2_PACKAGE_THINGINO_KOPT_MMC0_PB_4BIT=y
BR2_PACKAGE_THINGINO_KOPT_MMC0_BOOT=y
BR2_PACKAGE_WIFI=y
BR2_PACKAGE_WIFI_RTL8188FU=y
BR2_SENSOR_1_NAME="sc2332"
BR2_SENSOR_1_PARAMS="data_interface=1 sensor_max_fps=30"
BR2_INGENIC_SOC_MODEL="t31l"
BR2_THINGINO_AUDIO=y
BR2_THINGINO_AUDIO_GPIO=63
BR2_THINGINO_BUTTON=y
BR2_THINGINO_SDCARD=y
BR2_THINGINO_LED_B_GPIO=53
BR2_THINGINO_LED_B_ACTIVE_LOW=y
BR2_THINGINO_LED_R_GPIO=52
BR2_THINGINO_LED_R_ACTIVE_LOW=y
FLASH_SIZE_MB=16
BR2_TARGET_UBOOT_BOARDNAME="isvp_t31_msc0_ddr128M"
BR2_PACKAGE_THINGINO_UBOOT_ROOT="/dev/mmcblk0p2"
BR2_PACKAGE_THINGINO_UBOOT_ROOTFSTYPE="ext4"
BR2_TARGET_ROOTFS_EXT2=y
BR2_TARGET_ROOTFS_EXT2_4=y
BR2_TARGET_ROOTFS_EXT2_SIZE="1G"
BR2_TARGET_ROOTFS_EXT2_MKFS_OPTIONS="-O ^metadata_csum,^64bit"
```
