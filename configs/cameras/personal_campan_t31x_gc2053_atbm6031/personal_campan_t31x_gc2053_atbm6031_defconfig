## configs/cameras/personal_campan_t31x_gc2053_atbm6031/personal_campan_t31x_gc2053_atbm6031_defconfig
```kconfig
# NAME: Personal Cam Pan (T31X, GC2053, ATBM6031)
# MODULE: t31x_gc2053_atbm6031
BR2_AVPU_CLK_600MHZ=y
BR2_ISP_CLK_200MHZ=y
BR2_PACKAGE_THINGINO_KOPT_DWC2=y
BR2_PACKAGE_THINGINO_KOPT_DWC2_OTG=y
BR2_PACKAGE_THINGINO_KOPT_MMC0=y
BR2_PACKAGE_THINGINO_KOPT_MMC0_PB_4BIT=y
BR2_PACKAGE_THINGINO_KOPT_MMC1=y
BR2_PACKAGE_THINGINO_KOPT_MMC1_PB_4BIT=y
BR2_SENSOR_PARAMS="sensor_max_fps=30 data_interface=1"
BR2_THINGINO_AUDIO=y
BR2_THINGINO_BUTTON=y
BR2_THINGINO_MOTORS=y
BR2_THINGINO_DEVICE_TYPE_IPCAM=y
BR2_THINGINO_DEVICE_TYPE_IPCAM_PAN_TILT=y
BR2_THINGINO_SDCARD=y
FLASH_SIZE_16=y
```

## configs/cameras/primecables_08360_t21z_sc2300_rtl8188ftv/primecables_08360_t21z_sc2300_rtl8188ftv_defconfig
```kconfig
# NAME: PrimeCables 08360 (T21Z, SC2300, RTL8188FTV)
# FRAG: soc-xburst1 toolchain-xburst1 ccache brand rootfs kernel system target uboot ssl
BR2_PACKAGE_WIFI=y
BR2_PACKAGE_WIFI_RTL8188FU=y
BR2_SENSOR_SC2300=y
BR2_SOC_INGENIC_T21Z=y
BR2_PACKAGE_THINGINO_KOPT_MMC0=y
BR2_PACKAGE_THINGINO_KOPT_MMC0_PB_4BIT=y
BR2_THINGINO_AUDIO=y
BR2_THINGINO_BUTTON=y
BR2_THINGINO_SDCARD=y
FLASH_SIZE_8=y
```

## configs/cameras/sim_simp400t_t31x_gc4653_eth+ssv6155p/sim_simp400t_t31x_gc4653_eth+ssv6155p_defconfig
```kconfig
# NAME: SIM SIMP400T (T31X, GC4653, ETH, SSV6155P)
# FRAG: soc-xburst1 core ssl
BR2_THINGINO_TOOLCHAIN_TYPE_EXTERNAL=y
BR2_THINGINO_TOOLCHAIN_GCC_15=y
BR2_THINGINO_TOOLCHAIN_LIBC_UCLIBC=y
BR2_ETHERNET=y
BR2_ISP_CLK_200MHZ=y
BR2_PACKAGE_THINGINO_KOPT_JZ_MAC=y
BR2_PACKAGE_THINGINO_KOPT_JZ_MAC_V13=y
BR2_PACKAGE_THINGINO_KOPT_MMC0=y
BR2_PACKAGE_THINGINO_KOPT_MMC0_PB_4BIT=y
BR2_PACKAGE_WIFI=y
BR2_PACKAGE_WIFI_SSV6X5X=y
BR2_PACKAGE_WIFI_SSV6X5X_SV6155P=y
BR2_SENSOR_1_NAME="gc4653"
BR2_INGENIC_SOC_MODEL="t31x"
BR2_THINGINO_AUDIO=y
BR2_THINGINO_AUDIO_GPIO=63
BR2_THINGINO_BUTTON=y
BR2_THINGINO_MOTORS=y
BR2_THINGINO_RMEM_MB=48
BR2_THINGINO_SDCARD=y
FLASH_SIZE_MB=16
```

## configs/cameras/sonoff_pt2_t23n_sc2336p_atbm6012bx/sonoff_pt2_t23n_sc2336p_atbm6012bx_defconfig
```kconfig
# NAME: Sonoff CAM-PT2 (T23N, SC2336P, ATBM6012BX)
# FRAG: soc-xburst1 core ssl
# 4-bit MMC sometimes hangs in U-Boot. Works fine on Linux.
# shvflip seems to have no effect on sc2336 and sc2336p.
#BR2_SENSOR_1_PARAMS="shvflip=0"
# PWM control is not working, no white/IR LED brightness adjustment.
#BR2_THINGINO_PWM_ENABLE=y
BR2_INGENIC_SOC_MODEL="t23n"
BR2_PACKAGE_THINGINO_KOPT_I2C=y
BR2_PACKAGE_THINGINO_KOPT_I2C_BUS1=y
BR2_PACKAGE_THINGINO_KOPT_MMC0=y
BR2_PACKAGE_WIFI=y
BR2_PACKAGE_WIFI_ATBM6012BX=y
BR2_SENSOR_1_NAME="sc2336p"
BR2_TARGET_UBOOT_BOARDNAME="isvp_t23n_sfcnor_mmc1bit"
BR2_THINGINO_AUDIO=y
BR2_THINGINO_AUDIO_GPIO=7
BR2_THINGINO_AUDIO_GPIO_LOW=n
BR2_THINGINO_BUTTON=y
BR2_THINGINO_LED_B_GPIO=57
BR2_THINGINO_MOTORS=y
BR2_THINGINO_SDCARD=y
FLASH_SIZE_MB=16
```

## configs/cameras/sonoff_s2_t23n_sc2336_atbm6012bx/sonoff_s2_t23n_sc2336_atbm6012bx_defconfig
```kconfig
# NAME: Sonoff CAM Slim Gen2 (T23N, SC2336, ATBM6012BX)
# MODULE: t23n_sc2336_atbm6012bx
BR2_PACKAGE_THINGINO_KOPT_I2C=y
BR2_PACKAGE_THINGINO_KOPT_I2C_BUS1=y
BR2_PACKAGE_THINGINO_KOPT_MMC0=y
BR2_PACKAGE_THINGINO_KOPT_MMC0_1BIT=y
BR2_PACKAGE_THINGINO_UBOOT_BOARDNAME="isvp_t23n_sfcnor_mmc1bit"
BR2_THINGINO_AUDIO=y
BR2_THINGINO_BUTTON=y
BR2_THINGINO_SDCARD=y
BR2_THINGINO_DEVICE_TYPE_IPCAM=y
BR2_THINGINO_DEVICE_TYPE_IPCAM_STANDARD=y
FLASH_SIZE_16=y
```

## configs/cameras/teacup_t31x/teacup_t31x_defconfig
```kconfig
# NAME: Teacup DevBoard (T31ZX, IMX327, ETH)
# FRAG: soc-xburst1 toolchain-xburst1 ccache brand rootfs kernel system target uboot ssl
BR2_ETHERNET=y
BR2_PACKAGE_THINGINO_KOPT_JZ_MAC_V13=y
BR2_SENSOR_IMX327=y
BR2_SOC_INGENIC_T31ZX=y
BR2_AVPU_VPLL=y
BR2_ISP_CLK_225MHZ=y
BR2_PACKAGE_THINGINO_KOPT_ADC=y
BR2_PACKAGE_THINGINO_KOPT_DWC2=y
BR2_PACKAGE_THINGINO_KOPT_DWC2_OTG=y
BR2_PACKAGE_THINGINO_KOPT_MMC0=y
BR2_PACKAGE_THINGINO_KOPT_MMC0_PB_4BIT=y
BR2_THINGINO_AUDIO=y
BR2_THINGINO_BUTTON=y
BR2_THINGINO_PWM_ENABLE=y
BR2_THINGINO_SDCARD=y
FLASH_SIZE_16=y
```

## configs/cameras/tplink_tapo_c100_t31l_sc2336_rtl8188ftv/tplink_tapo_c100_t31l_sc2336_rtl8188ftv_defconfig
```kconfig
# NAME: TP-Link Tapo C100 (T31L, SC2336, RTL8188FTV)
# MODULE: t31l_sc2336_rtl8188ftv
BR2_PACKAGE_THINGINO_KOPT_MMC0=y
BR2_PACKAGE_THINGINO_KOPT_MMC0_PB_4BIT=y
BR2_THINGINO_AUDIO=y
BR2_THINGINO_BUTTON=y
BR2_THINGINO_PWM_ENABLE=y
BR2_THINGINO_SDCARD=y
```

## configs/cameras/tplink_tapo_c110_t23n_sc3336_wq9001/tplink_tapo_c110_t23n_sc3336_wq9001_defconfig
```kconfig
# NAME: TP-Link Tapo C110 v3 (T23N, SC3336, WQ9001)
# FRAG: soc-xburst1 toolchain-xburst1 ccache brand rootfs kernel system target uboot ssl
BR2_PACKAGE_THINGINO_KOPT=y
BR2_PACKAGE_THINGINO_KOPT_MMC0=y
BR2_PACKAGE_THINGINO_KOPT_MMC0_PB_4BIT=y
BR2_PACKAGE_THINGINO_KOPT_MMC=y
BR2_PACKAGE_WIFI=y
BR2_PACKAGE_WIFI_WQ9001=y
BR2_SENSOR_1_NAME="sc3336"
BR2_SENSOR_PARAMS="data_interface=1 shvflip=1"
BR2_SOC_INGENIC_T23N=y
BR2_THINGINO_AUDIO=y
BR2_THINGINO_AUDIO_GPIO=63
BR2_THINGINO_BUTTON=y
BR2_THINGINO_PWM_ENABLE=y
BR2_THINGINO_RMEM_MB=26
BR2_THINGINO_SDCARD=y
FLASH_SIZE_MB=8
```

## configs/cameras/tplink_tapo_c200c_t23n_sc2336p_wq9001/tplink_tapo_c200c_t23n_sc2336p_wq9001_defconfig
```kconfig
# NAME: TP-Link Tapo C200C EU/5.0 (T23N, SC2336P, WQ9001)
# FRAG: soc-xburst1 toolchain-xburst1 ccache brand rootfs kernel system target uboot ssl
BR2_PACKAGE_SPI_TMI8152=y
BR2_PACKAGE_THINGINO_KOPT=y
BR2_PACKAGE_THINGINO_KOPT_MMC=y
BR2_PACKAGE_THINGINO_KOPT_MMC0=y
BR2_PACKAGE_THINGINO_KOPT_MMC0_1BIT=y
BR2_PACKAGE_THINGINO_MOTORS=y
BR2_PACKAGE_WIFI=y
BR2_PACKAGE_WIFI_WQ9001=y
BR2_SENSOR_SC2336P=y
BR2_SENSOR_PARAMS="data_interface=1 shvflip=1"
BR2_SOC_INGENIC_T23N=y
BR2_THINGINO_AUDIO=y
BR2_THINGINO_BUTTON=y
BR2_THINGINO_SDCARD=y
FLASH_SIZE_8=y
```

## configs/cameras/tplink_tapo_c500_t31l_sc2336_rtl8188ftv/tplink_tapo_c500_t31l_sc2336_rtl8188ftv_defconfig
```kconfig
# NAME: TP-Link Tapo C500 US/1.0 (T31L, SC2336P, RTL8188FTV)
# FRAG: soc-xburst1 toolchain-xburst1 ccache brand rootfs kernel system target uboot ssl
BR2_PACKAGE_THINGINO_KOPT_MMC0=y
BR2_PACKAGE_WIFI=y
BR2_PACKAGE_WIFI_RTL8188FU=y
BR2_SENSOR_1_NAME="sc2336"
BR2_SENSOR_PARAMS="data_interface=1 shvflip=1"
BR2_SOC_INGENIC_T31L=y
BR2_THINGINO_AUDIO=y
BR2_THINGINO_BUTTON=y
BR2_THINGINO_MOTORS=y
BR2_THINGINO_PWM_ENABLE=y
BR2_THINGINO_RMEM_MB=22
BR2_THINGINO_SDCARD=y
FLASH_SIZE_MB=8
BR2_THINGINO_AUDIO_GPIO=63
#BR2_THINGINO_AUDIO_GPIO_LOW=y
```

## configs/cameras/tplink_tapo_tc70_t31l_sc2336_rtl8188ftv/tplink_tapo_tc70_t31l_sc2336_rtl8188ftv_defconfig
```kconfig
# NAME: TP-Link Tapo TC70 (T31L, SC2336, RTL8188FTV)
# FRAG: soc-xburst1 toolchain-xburst1 ccache brand rootfs kernel system target uboot ssl
BR2_PACKAGE_WIFI=y
BR2_PACKAGE_WIFI_RTL8188FU=y
BR2_SENSOR_SC2336=y
BR2_SOC_INGENIC_T31L=y
BR2_PACKAGE_THINGINO_KOPT_MMC0=y
BR2_PACKAGE_THINGINO_KOPT_MMC0_PB_4BIT=y
BR2_THINGINO_AUDIO=y
BR2_THINGINO_BUTTON=y
BR2_THINGINO_MOTORS=y
BR2_THINGINO_PWM_ENABLE=y
BR2_THINGINO_RMEM_22=y
BR2_THINGINO_SDCARD=y
FLASH_SIZE_8=y
```

## configs/cameras/tptek_wor504jch_t31x_gc4653_eth+rtl8731/tptek_wor504jch_t31x_gc4653_eth+rtl8731_defconfig
```kconfig
# NAME: TPTEK WOR504JCH (T31X, GC4653, ETH, RTL8731)
# FRAG: soc-xburst1 toolchain-xburst1 ccache brand rootfs kernel system target uboot ssl
BR2_ETHERNET=y
BR2_PACKAGE_THINGINO_KOPT_JZ_MAC_V13=y
BR2_PACKAGE_WIFI=y
BR2_PACKAGE_WIFI_RTL8733BU=y
BR2_SENSOR_GC4653=y
BR2_SOC_INGENIC_T31X=y
BR2_AVPU_CLK_486MHZ=y
BR2_AVPU_VPLL=y
BR2_ISP_CLK_250MHZ=y
BR2_ISP_DAY_NIGHT_SWITCH_DROP_FRAME_NUM=y
BR2_ISP_DAY_NIGHT_SWITCH_DROP_FRAME_NUM_VALUE=1
BR2_PACKAGE_THINGINO_KOPT_ADC=y
BR2_PACKAGE_THINGINO_KOPT_MMC0=y
BR2_PACKAGE_THINGINO_KOPT_MMC0_PB_4BIT=y
BR2_THINGINO_AUDIO=y
BR2_THINGINO_MOTORS=y
BR2_THINGINO_RMEM_64=y
BR2_THINGINO_SDCARD=y
FLASH_SIZE_16=y
```

## configs/cameras/unknown_t41nq_gc5603_eth+rtl8733bu/unknown_t41nq_gc5603_eth+rtl8733bu_defconfig
```kconfig
# NAME: T41NQ
# FRAG: soc-xburst2 core ssl
BR2_ETHERNET=y
BR2_PACKAGE_THINGINO_UBOOT_FLASH_CONTROLLER_JZ_SFC=n
BR2_PACKAGE_THINGINO_UBOOT_FLASH_CONTROLLER_SFC0_NOR=y
BR2_SENSOR_1_NAME="gc5603"
BR2_INGENIC_SOC_MODEL="t41nq"
BR2_THINGINO_AUDIO=y
BR2_THINGINO_NMEM_MB=8
BR2_THINGINO_RMEM_MB=46
FLASH_SIZE_MB=16
BR2_AVPU_CLK_550MHZ=y
BR2_AVPU_SCLKA=y
BR2_LINUX_KERNEL_EXT_THINGINO_KOPT=y
BR2_LINUX_KERNEL_EXT_THINGINO_KOPT_DTS=y
BR2_LINUX_KERNEL_EXT_THINGINO_KOPT_DTS_UNKNOWNT41NQ=y
BR2_PACKAGE_WIFI=y
BR2_PACKAGE_WIFI_RTL8733BU=y
BR2_PACKAGE_NINO=y
BR2_PACKAGE_THINGINO_ONVIF=y
BR2_PACKAGE_LIBAUDIOPROCESS_NEO=y
BR2_PACKAGE_THINGINO_BUTTON=y
BR2_PACKAGE_WIRELESS_TOOLS=y
BR2_PACKAGE_THINGINO_RAPTOR_MP3=y
BR2_PACKAGE_THINGINO_DEVSCRIPTS=y
BR2_PACKAGE_THINGINO_DIAG=y
BR2_PACKAGE_THINGINO_KOPT_DWC2=y
BR2_PACKAGE_THINGINO_KOPT_DWC2_OTG=y
BR2_PACKAGE_THINGINO_RAPTOR_CONF_SENSOR_NAME="gc5603"
BR2_PACKAGE_THINGINO_RAPTOR_CONF_SENSOR_I2C_ADDR="0x31"
BR2_PACKAGE_THINGINO_RAPTOR_CONF_SENSOR_RST_GPIO="18"
BR2_PACKAGE_THINGINO_RAPTOR_CONF_SENSOR_PWDN_GPIO="-1"
BR2_PACKAGE_THINGINO_RAPTOR_CONF_SENSOR_MCLK="1"
BR2_PACKAGE_THINGINO_RAPTOR_CONF_SENSOR_VIDEO_INTERFACE="0"
BR2_PACKAGE_THINGINO_RAPTOR_CONF_SENSOR_FPS="30"
BR2_PACKAGE_THINGINO_RAPTOR_CONF_STREAM0_FPS="30"
BR2_PACKAGE_THINGINO_RAPTOR_CONF_STREAM0_WIDTH="2880"
BR2_PACKAGE_THINGINO_RAPTOR_CONF_STREAM0_HEIGHT="1620"
BR2_PACKAGE_THINGINO_RAPTOR_CONF_STREAM0_BITRATE="3000000"
BR2_PACKAGE_THINGINO_RAPTOR_CONF_STREAM0_OSD_ENABLED="false"
BR2_PACKAGE_THINGINO_RAPTOR_CONF_STREAM1_FPS="30"
BR2_PACKAGE_THINGINO_RAPTOR_CONF_STREAM1_WIDTH="1280"
BR2_PACKAGE_THINGINO_RAPTOR_CONF_STREAM1_HEIGHT="720"
BR2_PACKAGE_THINGINO_RAPTOR_CONF_STREAM1_BITRATE="768000"
BR2_PACKAGE_THINGINO_RAPTOR_CONF_STREAM1_OSD_ENABLED="false"
BR2_PACKAGE_THINGINO_RAPTOR_CONF_AUDIO_CODEC="aac"
BR2_PACKAGE_THINGINO_RAPTOR_CONF_AUDIO_GAIN="32"
BR2_PACKAGE_THINGINO_RAPTOR_CONF_AUDIO_VOLUME="92"
BR2_PACKAGE_THINGINO_RAPTOR_CONF_AUDIO_AO_ENABLED="true"
BR2_PACKAGE_THINGINO_RAPTOR_CONF_IRCUT_DAY_THRESHOLD="390000"
BR2_PACKAGE_THINGINO_RAPTOR_CONF_IRCUT_NIGHT_THRESHOLD="490000"
BR2_PACKAGE_THINGINO_RAPTOR_CONF_IRCUT_TRIGGER="gain"
BR2_PACKAGE_THINGINO_RAPTOR_CONF_IRCUT_MODE="day"
BR2_PACKAGE_THINGINO_RAPTOR_CONF_LOG_LEVEL="info"
```

## configs/cameras/vanhua_ak54_t31n/vanhua_ak54_t31n_defconfig
```kconfig
# NAME: Vanhua AK54 (T31N, GC2053, ETH)
# MODULE: t31n_gc2053_eth
BR2_THINGINO_AUDIO=y
FLASH_SIZE_8=y
```

## configs/cameras/vanhua_ak54_t31n_gc2053_eth/vanhua_ak54_t31n_gc2053_eth_defconfig
```kconfig
# NAME: Vanhua AK54 (T31N, GC2053, ETH)
# FRAG: soc-xburst1 ccache brand rootfs kernel system target uboot ssl
BR2_THINGINO_TOOLCHAIN_TYPE_EXTERNAL=y
BR2_THINGINO_TOOLCHAIN_GCC_15=y
BR2_THINGINO_TOOLCHAIN_LIBC_UCLIBC=y
BR2_ETHERNET=y
BR2_PACKAGE_THINGINO_KOPT_JZ_MAC_V13=y
BR2_SENSOR_1_NAME="gc2053"
BR2_INGENIC_SOC_MODEL="t31n"
BR2_THINGINO_AUDIO=y
FLASH_SIZE_MB=8
```

## configs/cameras/vanhua_djz_t31n_gc2083_eth/vanhua_djz_t31n_gc2083_eth_defconfig
```kconfig
# NAME: Vanhua DJZ (T31N, GC2083, ETH)
# MODULE: t31n_gc2083_eth
BR2_AVPU_CLK_486MHZ=y
BR2_AVPU_VPLL=y
BR2_ISP_CLK_250MHZ=y
BR2_ISP_PARAMS="isp_day_night_switch_drop_frame_num=1"
BR2_PACKAGE_THINGINO_KOPT_ADC=y
BR2_THINGINO_AUDIO=y
BR2_THINGINO_RMEM_22=y
BR2_THINGINO_DEVICE_TYPE_IPCAM=y
BR2_THINGINO_DEVICE_TYPE_IPCAM_STANDARD=y
FLASH_SIZE_16=y
```

## configs/cameras/vanhua_h33_t31l_gc2083_eth/vanhua_h33_t31l_gc2083_eth_defconfig
```kconfig
# NAME: Vanhua H33 (T31L, GC2083, ETH)
# FRAG: soc-xburst1 toolchain-xburst1 ccache brand rootfs kernel system target uboot ssl
BR2_ETHERNET=y
BR2_PACKAGE_THINGINO_KOPT_JZ_MAC_V13=y
BR2_SENSOR_GC2083=y
BR2_SOC_INGENIC_T31L=y
BR2_AVPU_CLK_486MHZ=y
BR2_AVPU_VPLL=y
BR2_ISP_CLK_200MHZ=y
BR2_ISP_DAY_NIGHT_SWITCH_DROP_FRAME=y
BR2_ISP_DAY_NIGHT_SWITCH_DROP_FRAME_NUM_VALUE=1
BR2_ISP_CH0_PRE_DEQUEUE_TIME=y
BR2_ISP_CH0_PRE_DEQUEUE_TIME_VALUE=22
BR2_ISP_CH0_PRE_DEQUEUE_INTERRUPT_PROCESS=y
BR2_ISP_CH0_PRE_DEQUEUE_INTERRUPT_PROCESS_VALUE=0
BR2_ISP_CH0_PRE_DEQUEUE_VALID_LINES=y
BR2_ISP_CH0_PRE_DEQUEUE_VALID_LINES_VALUE=540
BR2_PACKAGE_THINGINO_KOPT_ADC=y
BR2_PACKAGE_THINGINO_KOPT_DWC2=y
BR2_PACKAGE_THINGINO_KOPT_DWC2_OTG=y
BR2_PACKAGE_THINGINO_KOPT_MMC0=y
BR2_PACKAGE_THINGINO_KOPT_MMC0_PB_4BIT=y
BR2_PACKAGE_THINGINO_KOPT_MMC=y
BR2_SENSOR_PARAMS="shvflip=1"
BR2_THINGINO_AUDIO=y
BR2_THINGINO_BUTTON=y
FLASH_SIZE_8=y
```

## configs/cameras/vanhua_h53e_t31x_gc4023_eth_rtl8188ftv/vanhua_h53e_t31x_gc4023_eth_rtl8188ftv_defconfig
```kconfig
# NAME: Vanhua H53E (T31X, GC4023, ETH, RTL8188FTV)
# FRAG: soc-xburst1 core ssl
BR2_AVPU_CLK_400MHZ=y
BR2_AVPU_VPLL=y
BR2_ETHERNET=y
BR2_ISP_CLK_200MHZ=y
BR2_PACKAGE_THINGINO_KOPT_DWC2=y
BR2_PACKAGE_THINGINO_KOPT_DWC2_OTG=y
BR2_PACKAGE_THINGINO_KOPT_JZ_MAC_V13=y
BR2_PACKAGE_THINGINO_KOPT_MMC0=y
BR2_PACKAGE_THINGINO_KOPT_MMC0_PB_4BIT=y
BR2_PACKAGE_THINGINO_KOPT_MMC1=y
BR2_PACKAGE_THINGINO_KOPT_MMC1_PB_4BIT=y
BR2_PACKAGE_WIFI=y
BR2_PACKAGE_WIFI_RTL8188FU=y
BR2_SENSOR_1_NAME="gc4023"
BR2_INGENIC_SOC_MODEL="t31x"
BR2_THINGINO_AUDIO=y
BR2_THINGINO_AUDIO_GPIO=10
BR2_THINGINO_BUTTON=y
BR2_THINGINO_MOTORS=y
BR2_THINGINO_RMEM_MB=50
BR2_THINGINO_SDCARD=y
FLASH_SIZE_MB=16
```

## configs/cameras/vanhua_l34_t31l_gc2083_eth/vanhua_l34_t31l_gc2083_eth_defconfig
```kconfig
# NAME: Vanhua L34 (T31L, GC2083, ETH)
# FRAG: soc-xburst1 toolchain-xburst1 ccache brand rootfs kernel system target uboot ssl
BR2_ETHERNET=y
BR2_PACKAGE_THINGINO_KOPT_JZ_MAC_V13=y
BR2_SENSOR_GC2083=y
BR2_SOC_INGENIC_T31L=y
BR2_THINGINO_AUDIO=y
FLASH_SIZE_8=y
```

## configs/cameras/vanhua_z55_t31x_gc4653_eth/vanhua_z55_t31x_gc4653_eth_defconfig
```kconfig
# NAME: Vanhua Z55 (T31X, GC4653, ETH)
# FRAG: soc-xburst1 toolchain-xburst1 ccache brand rootfs kernel system target uboot ssl
BR2_ETHERNET=y
BR2_PACKAGE_THINGINO_KOPT_JZ_MAC_V13=y
BR2_SENSOR_GC4653=y
BR2_SOC_INGENIC_T31X=y
BR2_AVPU_CLK_486MHZ=y
BR2_AVPU_VPLL=y
BR2_ISP_CLK_250MHZ=y
BR2_ISP_DAY_NIGHT_SWITCH_DROP_FRAME=y
BR2_ISP_DAY_NIGHT_SWITCH_DROP_FRAME_NUM_VALUE=1
BR2_PACKAGE_THINGINO_KOPT_ADC=y
BR2_THINGINO_AUDIO=y
BR2_THINGINO_RMEM_64=y
FLASH_SIZE_16=y
```

## configs/cameras/victure_pc420_t21n_jxf23_eth+rtl8188ftv/victure_pc420_t21n_jxf23_eth+rtl8188ftv_defconfig
```kconfig
# NAME: Victure PC420 (T21N, JXF23, ETH, RTL8188FTV)
# FRAG: soc-xburst1 toolchain-xburst1 ccache brand rootfs kernel system target uboot ssl
BR2_PACKAGE_WIFI=y
BR2_PACKAGE_WIFI_RTL8188FU=y
BR2_SENSOR_JXF23=y
BR2_SOC_INGENIC_T21N=y
BR2_ETHERNET=y
BR2_ISP_CLK_100MHZ=y
BR2_PACKAGE_THINGINO_KOPT_JZ_MAC_INTERNAL_PHY=y
BR2_PACKAGE_THINGINO_KOPT_JZ_MAC_V13=y
BR2_PACKAGE_THINGINO_KOPT_MMC0=y
BR2_PACKAGE_THINGINO_KOPT_MMC0_PB_4BIT=y
BR2_SENSOR_PARAMS="sensor_max_fps=25 sensor_gpio_func=0"
BR2_THINGINO_AUDIO=y
BR2_THINGINO_BUTTON=y
BR2_THINGINO_SDCARD=y
FLASH_SIZE_8=y
```

## configs/cameras/wanjiaan_g7_t31x/wanjiaan_g7_t31x_defconfig
```kconfig
# NAME: Wanjiaan G7 (T31X, JXF37, Ethernet)
# MODULE: t31x_jxf37_eth
BR2_ETHERNET=y
BR2_PACKAGE_THINGINO_KOPT_DWC2=y
BR2_PACKAGE_THINGINO_KOPT_DWC2_OTG=y
BR2_PACKAGE_THINGINO_KOPT_JZ_MAC=y
BR2_PACKAGE_THINGINO_KOPT_JZ_MAC_V13=y
BR2_PACKAGE_THINGINO_KOPT_MMC0=y
BR2_PACKAGE_THINGINO_KOPT_MMC0_PB_4BIT=y
BR2_THINGINO_AUDIO=y
BR2_THINGINO_BUTTON=y
BR2_THINGINO_RMEM_48=y
BR2_THINGINO_SDCARD=y
FLASH_SIZE_16=y
```

## configs/cameras/wanjiaan_hdc51_t31l_jxf37_rtl8188ftv/wanjiaan_hdc51_t31l_jxf37_rtl8188ftv_defconfig
```kconfig
# NAME: Wanjiaan HDC51 (T31L, JXF37, RTL8188FTV)
# MODULE: t31l_jxf37_rtl8188ftv
BR2_PACKAGE_THINGINO_KOPT_MMC0=y
BR2_PACKAGE_THINGINO_KOPT_MMC0_PB_4BIT=y
BR2_SENSOR_PARAMS="data_interface=1"
BR2_THINGINO_AUDIO=y
BR2_THINGINO_BUTTON=y
BR2_THINGINO_SDCARD=y
BR2_THINGINO_DEVICE_TYPE_IPCAM=y
BR2_THINGINO_DEVICE_TYPE_IPCAM_STANDARD=y
FLASH_SIZE_16=y
```
