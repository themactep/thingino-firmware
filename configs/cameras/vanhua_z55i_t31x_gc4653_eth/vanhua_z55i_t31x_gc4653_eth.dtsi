// Vanhua Z55I (T31X, GC4653, ETH) per-board GPIO definitions.
// Injected into the kernel 4.4+ device tree; ignored on 3.10.

#include <dt-bindings/gpio/gpio.h>
#include <dt-bindings/pinctrl/ingenic-pinctrl.h>

/ {
	gpio-leds {
		compatible = "gpio-leds";

		led_r {
			label = "led_r";
			gpios = <&gpa 8 GPIO_ACTIVE_HIGH INGENIC_GPIO_NOBIAS>;
			default-state = "off";
		};
	};
};
