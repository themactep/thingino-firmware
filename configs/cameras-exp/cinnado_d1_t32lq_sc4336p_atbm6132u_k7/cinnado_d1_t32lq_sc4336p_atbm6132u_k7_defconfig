## configs/cameras-exp/cinnado_d1_t32lq_sc4336p_atbm6132u_k7/cinnado_d1_t32lq_sc4336p_atbm6132u_k7_defconfig
```kconfig
# NAME: Cinnado D1 (T32LQ, SC4336P, ATBM6132U) with mainline Kernel 7.4
# FRAG: soc-xburst1 core
BR2_INGENIC_SOC_MODEL="t32lq"
BR2_ISP_CLKA_400MHZ=y
BR2_ISP_CLKA_VPLL=y
BR2_ISP_CLKS_400MHZ=y
BR2_ISP_CLKS_VPLL=y
BR2_ISP_CLKV_400MHZ=y
BR2_ISP_CLKV_VPLL=y
BR2_ISP_CLK_225MHZ=y
BR2_ISP_CLK_MPLL=y
BR2_ISP_PARAMS="isp_memopt=5"
BR2_PACKAGE_THINGINO_UBOOT_FLASH_CONTROLLER_JZ_SFC=n
BR2_PACKAGE_THINGINO_UBOOT_FLASH_CONTROLLER_SFC0_NOR=y
BR2_SENSOR_1_NAME="sc4336p"
BR2_THINGINO_AUDIO=y
BR2_THINGINO_BUTTON=y
BR2_THINGINO_DEV_EXPERIMENTAL=y
BR2_THINGINO_DEV_PACKAGES=y
BR2_THINGINO_LED_B_ACTIVE_LOW=y
BR2_THINGINO_LED_B_GPIO=39
BR2_THINGINO_LED_R_ACTIVE_LOW=y
BR2_THINGINO_LED_R_GPIO=38
BR2_THINGINO_MOTORS=y
BR2_THINGINO_RMEM_MB=22
BR2_THINGINO_SDCARD=y
FLASH_SIZE_MB=16
KERNEL_VERSION_7=y
```

## configs/cameras-exp/dml16_z533_t41nq_gc5603_eth+rtl8733bu/dml16_z533_t41nq_gc5603_eth+rtl8733bu_defconfig
```kconfig
# NAME: DML16-Z533 (T41NQ, GC5603, ETH, RTL8733BU)
# FRAG: soc-xburst2 core
BR2_ETHERNET=y
BR2_INGENIC_SOC_MODEL="t41nq"
BR2_LINUX_KERNEL_EXT_THINGINO_KOPT=y
BR2_PACKAGE_THINGINO_KOPT_INPUT=y
BR2_PACKAGE_THINGINO_KOPT_MMC0=y
BR2_PACKAGE_THINGINO_KOPT_MMC0_PB_4BIT=y
BR2_PACKAGE_THINGINO_KOPT_SFC_ERASE_64K=y
BR2_PACKAGE_THINGINO_UBOOT_FLASH_CONTROLLER_JZ_SFC=n
BR2_PACKAGE_THINGINO_UBOOT_FLASH_CONTROLLER_SFC0_NOR=y
BR2_PACKAGE_WIFI=y
BR2_PACKAGE_WIFI_RTL8733BU=y
BR2_PACKAGE_WIFI_RTL8733BU_KEEP_POWER=y
BR2_PACKAGE_WIRELESS_TOOLS=y
BR2_SENSOR_1_NAME="gc5603"
BR2_SENSOR_1_PARAMS="shvflip=3"
BR2_TARGET_UBOOT_BOARD_DEFCONFIG="isvp_t41nq_sfcnor_dml16"
BR2_THINGINO_AUDIO=y
BR2_THINGINO_BUTTON=y
BR2_THINGINO_NMEM_MB=8
BR2_THINGINO_RMEM_MB=46
BR2_THINGINO_SDCARD=y
FLASH_SIZE_MB=16
```

## configs/cameras-exp/jooan_w8u_t23n_sc2336_atbm6132u_k7/jooan_w8u_t23n_sc2336_atbm6132u_k7_defconfig
```kconfig
# NAME: Jooan W8-U (T23N, SC2336P, ATBM6132U) with mainline Kernel 7.4
# FRAG: soc-xburst1 core
BR2_INGENIC_SOC_MODEL="t23n"
BR2_ISP_CLK_200MHZ=y
BR2_ISP_DIRECT_MODE_2=y
BR2_ISP_IVDC_MEM_LINE=y
BR2_ISP_IVDC_MEM_LINE_VALUE=540
BR2_ISP_MEMOPT_1=y
BR2_PACKAGE_THINGINO_KOPT_MMC0=y
BR2_PACKAGE_THINGINO_KOPT_MMC0_PB_4BIT=y
BR2_SENSOR_1_IQ_NAME="sc2336ps1"
BR2_SENSOR_1_NAME="sc2336ps0"
BR2_SENSOR_2_NAME="sc2336ps1"
BR2_THINGINO_AUDIO=y
BR2_THINGINO_BUTTON=y
BR2_THINGINO_DEV_EXPERIMENTAL=y
BR2_THINGINO_DEV_PACKAGES=y
BR2_THINGINO_IMAGE_SENSOR_QTY=2
BR2_THINGINO_MOTORS=y
BR2_THINGINO_PWM_ENABLE=y
BR2_THINGINO_RMEM_MB=22
BR2_THINGINO_SDCARD=y
FLASH_SIZE_MB=8
KERNEL_VERSION_7=y
```

## configs/cameras-exp/qemu_t33l_k7/qemu_t33l_k7_defconfig
```kconfig
# NAME: QEMU T33L (Ethernet) with mainline Kernel 7.4
# FRAG: soc-xburst1 core
BR2_ETHERNET=y
BR2_INGENIC_SOC_MODEL="t33l"
BR2_ISP_CLK_200MHZ=y
BR2_ISP_PARAMS="isp_memopt=5"
BR2_PACKAGE_HOST_QEMU_INGENIC=y
BR2_PACKAGE_THINGINO_UBOOT_FLASH_CONTROLLER_JZ_SFC=n
BR2_PACKAGE_THINGINO_UBOOT_FLASH_CONTROLLER_SFC0_NOR=y
BR2_SENSOR_1_NAME="gc5613"
BR2_THINGINO_AUDIO=y
BR2_THINGINO_DEV_EXPERIMENTAL=y
BR2_THINGINO_DEV_PACKAGES=y
BR2_THINGINO_RMEM_MB=23
FLASH_SIZE_MB=16
KERNEL_VERSION_7=y
```

## configs/cameras-exp/usb529pro_860_nt98529_imx678_rtl8821cs/usb529pro_860_nt98529_imx678_rtl8821cs_defconfig
```kconfig
# NAME: USB529Pro 860 dual dashcam, flash install (NT98529, IMX678, RTL8821CS)
# FRAG: soc-na51055 core-novatek
BR2_ETHERNET=y
BR2_NOVATEK_SOC_MODEL="nt98529"
BR2_PACKAGE_NOVATEK_HDAL=y
BR2_PACKAGE_NOVATEK_UBOOT=y
BR2_PACKAGE_NOVATEK_UBOOT_BOOT_NAND=y
# BR2_PACKAGE_THINGINO_RAPTOR_AAC is not set
# BR2_PACKAGE_THINGINO_RAPTOR_OPUS is not set
# BR2_PACKAGE_THINGINO_RAPTOR_MP3 is not set
BR2_PACKAGE_THINGINO_KOPT_I2C_DEV=y
BR2_PACKAGE_THINGINO_KOPT_NVT_AUDIO=y
BR2_PACKAGE_THINGINO_RAPTOR_RSD=y
BR2_PACKAGE_THINGINO_RAPTOR_RTD=y
BR2_PACKAGE_THINGINO_RAPTOR_RVD=y
BR2_PACKAGE_THINGINO_STREAMER_RAPTOR=y
BR2_PACKAGE_WIFI=y
BR2_PACKAGE_WIFI_RTL8821CS=y
BR2_SENSOR_1_NAME="imx678"
BR2_SOC_VENDOR_NOVATEK=y
BR2_THINGINO_BUTTON=y
BR2_THINGINO_GPIO_LIST="116O"
BR2_THINGINO_TOOLCHAIN_GCC_16=y
BR2_THINGINO_TOOLCHAIN_LIBC_UCLIBC=y
BR2_THINGINO_TOOLCHAIN_TYPE_BUILDROOT=y
```

## configs/cameras-exp/usb529pro_860_nt98529_imx678_rtl8821cs_mmc/usb529pro_860_nt98529_imx678_rtl8821cs_mmc_defconfig
```kconfig
# NAME: USB529Pro 860 dual dashcam, SD card boot (NT98529, IMX678, RTL8821CS)
# FRAG: soc-na51055 core-novatek
BR2_ETHERNET=y
BR2_NOVATEK_SOC_MODEL="nt98529"
BR2_PACKAGE_NOVATEK_HDAL=y
BR2_PACKAGE_NOVATEK_UBOOT=y
BR2_PACKAGE_NOVATEK_UBOOT_BOOT_SD=y
# BR2_PACKAGE_THINGINO_RAPTOR_AAC is not set
# BR2_PACKAGE_THINGINO_RAPTOR_OPUS is not set
# BR2_PACKAGE_THINGINO_RAPTOR_MP3 is not set
BR2_PACKAGE_THINGINO_KOPT_I2C_DEV=y
BR2_PACKAGE_THINGINO_KOPT_NVT_AUDIO=y
BR2_PACKAGE_THINGINO_KOPT_NVT_THERMAL=y
BR2_PACKAGE_THINGINO_RAPTOR_RSD=y
BR2_PACKAGE_THINGINO_RAPTOR_RVD=y
BR2_PACKAGE_THINGINO_STREAMER_RAPTOR=y
BR2_PACKAGE_WIFI=y
BR2_PACKAGE_WIFI_RTL8821CS=y
BR2_SENSOR_1_NAME="imx678"
BR2_SOC_VENDOR_NOVATEK=y
BR2_TARGET_ROOTFS_EXT2=y
BR2_TARGET_ROOTFS_EXT2_4=y
BR2_TARGET_ROOTFS_EXT2_MKFS_OPTIONS="-O ^metadata_csum,^64bit"
BR2_TARGET_ROOTFS_EXT2_SIZE="64M"
BR2_THINGINO_BUTTON=y
BR2_THINGINO_DEV_DASHCAM=y
BR2_THINGINO_GPIO_LIST="116O"
BR2_THINGINO_TOOLCHAIN_GCC_16=y
BR2_THINGINO_TOOLCHAIN_LIBC_UCLIBC=y
BR2_THINGINO_TOOLCHAIN_TYPE_BUILDROOT=y
```

## configs/cameras-exp/wyze_cam2_t20x_jxf23_rtl8189ftv_k7/wyze_cam2_t20x_jxf23_rtl8189ftv_k7_defconfig
```kconfig
# NAME: Wyze Cam v2 (T20X, JXF23, RTL8189FTV) with mainline Kernel 7.4
# FRAG: soc-xburst1 core
BR2_INGENIC_SOC_MODEL="t20x"
BR2_ISP_CLK_100MHZ=y
BR2_PACKAGE_WIFI=y
BR2_PACKAGE_WIFI_RTL8189FS=y
BR2_PACKAGE_WYZE_ACCESSORY=y
BR2_PACKAGE_WYZE_ACCESSORY_CAR=y
BR2_SENSOR_1_NAME="jxf23"
BR2_THINGINO_AUDIO=y
BR2_THINGINO_BUTTON=y
BR2_THINGINO_DEV_EXPERIMENTAL=y
BR2_THINGINO_DEV_PACKAGES=y
BR2_THINGINO_DFU=y
BR2_THINGINO_ISPMEM_MB=11
BR2_THINGINO_LED_B_ACTIVE_LOW=y
BR2_THINGINO_LED_B_GPIO=39
BR2_THINGINO_LED_Y_ACTIVE_LOW=y
BR2_THINGINO_LED_Y_GPIO=38
BR2_THINGINO_PWM_ENABLE=y
BR2_THINGINO_RMEM_MB=22
BR2_THINGINO_SDCARD=y
FLASH_SIZE_MB=16
KERNEL_VERSION_7=y
```

## configs/cameras-testing/qemu_t23n/qemu_t23n_defconfig
```kconfig
# NAME: QEMU T23N (virtual WiFi)
# FRAG: soc-xburst1 core
BR2_INGENIC_SOC_MODEL="t23n"
BR2_SENSOR_1_NAME="sc2336"
BR2_THINGINO_AUDIO=y
BR2_THINGINO_RMEM_MB=20
BR2_PACKAGE_HOST_QEMU_INGENIC=y
BR2_PACKAGE_THINGINO_KOPT_UART=y
BR2_PACKAGE_THINGINO_KOPT_UART_UART0=y
BR2_PACKAGE_THINGINO_KOPT_SLIP=y
BR2_PACKAGE_WIFI=y
BR2_PACKAGE_WIFI_HWSIM=y
FLASH_SIZE_MB=16
BR2_PACKAGE_THINGINO_KOPT_RTC=y
BR2_PACKAGE_THINGINO_KOPT_RTC_I2C=y
BR2_PACKAGE_THINGINO_KOPT_SPI=y
BR2_PACKAGE_THINGINO_KOPT_ADC=y
BR2_PACKAGE_THINGINO_KOPT_I2C=y
BR2_PACKAGE_THINGINO_KOPT_I2C_BUS1=y
```

## configs/cameras-testing/qemu_t33l/qemu_t33l_defconfig
```kconfig
# NAME: QEMU T33L (virtual WiFi)
# FRAG: soc-xburst1 core
BR2_INGENIC_SOC_MODEL="t33l"
BR2_PACKAGE_HOST_QEMU_INGENIC=y
BR2_PACKAGE_THINGINO_UBOOT_FLASH_CONTROLLER_JZ_SFC=n
BR2_PACKAGE_THINGINO_UBOOT_FLASH_CONTROLLER_SFC0_NOR=y
BR2_PACKAGE_THINGINO_KOPT_UART=y
BR2_PACKAGE_THINGINO_KOPT_UART_UART0=y
BR2_PACKAGE_THINGINO_KOPT_SLIP=y
BR2_PACKAGE_WIFI=y
BR2_PACKAGE_WIFI_HWSIM=y
BR2_SENSOR_1_NAME="cv2005"
BR2_THINGINO_AUDIO=y
BR2_THINGINO_RMEM_MB=24
FLASH_SIZE_MB=16
KERNEL_VERSION_4=y
```

## configs/cameras/jooan_c9ts_t23n_sc2336p_skw6316/jooan_c9ts_t23n_sc2336p_skw6316_defconfig
```kconfig
# NAME: Jooan C9TS-U (T23N, SC2336P, SKW6316)
# FRAG: soc-xburst1 core ssl
BR2_ISP_CLKA_SCLKA=y
BR2_ISP_CLK_300MHZ=y
BR2_ISP_CLK_SCLKA=y
BR2_ISP_DIRECT_MODE_0=y
BR2_ISP_MEMOPT_0=y
BR2_PACKAGE_THINGINO_KOPT_MMC0=y
BR2_PACKAGE_THINGINO_KOPT_MMC0_PB_4BIT=y
BR2_PACKAGE_THINGINO_STREAMER_PRUDYNT=y
BR2_PACKAGE_WIFI=y
BR2_PACKAGE_WIFI_SKW6316=y
BR2_SENSOR_1_NAME="sc2336p"
BR2_SENSOR_1_PARAMS="shvflip=0"
BR2_SENSOR_1_IQ_FILE="configs/cameras/jooan_c9ts_t23n_sc2336p_skw6316/sc2336p-t23.bin"
BR2_INGENIC_SOC_MODEL="t23n"
BR2_THINGINO_AUDIO=y
BR2_THINGINO_AUDIO_GPIO=63
BR2_THINGINO_AUDIO_GPIO_LOW=y
BR2_THINGINO_BUTTON=y
BR2_THINGINO_MOTORS=y
BR2_THINGINO_SDCARD=y
BR2_PACKAGE_THINGINO_VPN_NONE=y
# BR2_PACKAGE_TELEGRAMBOT is not set
FLASH_SIZE_MB=8
```

## package/faac/Config.in
```kconfig
config BR2_PACKAGE_FAAC
	bool "Freeware Advanced Audio Coder"
	help
	  FAAC is an open-source MPEG-2 and MPEG-4 AAC audio format encoder.

	  This package builds the encoder library (libfaac). The decoder
	  (libfaad3) is optional, below; the muxer and resampler in the same
	  source tree are disabled.

	  https://github.com/FreewareAdvancedAudio/faac

config BR2_PACKAGE_FAAC_DECODER
	bool "Install the FAAD3 decoder (libfaad3)"
	depends on BR2_PACKAGE_FAAC
	help
	  Build and install libfaad3, the AAC-LC/HE-AAC decoder that
	  ships with FAAC 3.0 (faad3.h). Not the same library as the
	  faad2 package: it has its own header and SONAME.

config BR2_PACKAGE_FAAC_INSTALL_BIN
	bool "Install faac CLI"
	default n
	depends on BR2_PACKAGE_FAAC
	help
	  Install the `faac` command-line encoder binary on both the
	  target rootfs and the staging sysroot. Disable this option to
	  keep only the libraries.
```

## package/novatek-hdal/Config.in
```kconfig
config BR2_PACKAGE_NOVATEK_HDAL
	bool "Novatek HDAL"
	depends on BR2_SOC_VENDOR_NOVATEK
	help
	  Novatek's prebuilt media stack: HDAL kernel modules, libhdal and
	  the vendor ISP libraries, the sensor driver and its config, loaded
	  at boot through /etc/modules.d.

if BR2_PACKAGE_NOVATEK_HDAL

config BR2_PACKAGE_NOVATEK_HDAL_BLOBS
	string "Vendor blob directory"
	help
	  Local directory holding the vendor files: hdal/ and vos/ (modules),
	  lib/ (libraries), sensor/ (sen_<sensor>.cfg). Set it in
	  user/<camera>/local.fragment.

endif
```

## package/novatek-sensors/Config.in
```kconfig
config BR2_PACKAGE_NOVATEK_SENSORS
	bool "Novatek sensor drivers"
	depends on BR2_SOC_VENDOR_NOVATEK
	depends on BR2_LINUX_KERNEL
	help
	  Image sensor driver for the camera's BR2_SENSOR_1_NAME, built
	  from source against this kernel and the vendor HDAL modules.

	  https://github.com/gtxaspec/novatek-sensors
```

## package/novatek-uboot/Config.in
```kconfig
config BR2_PACKAGE_NOVATEK_UBOOT
	bool "Novatek U-Boot"
	depends on BR2_SOC_VENDOR_NOVATEK
	select BR2_PACKAGE_HOST_DTC
	help
	  U-Boot from Novatek-OSS, built with thingino's boot environment.
	  The vendor loader stays on flash and starts it: from the card's
	  FW<model>T.BIN for an SD install, from the uboot partition for a
	  flash install.

if BR2_PACKAGE_NOVATEK_UBOOT

choice
	prompt "Boot media"
	default BR2_PACKAGE_NOVATEK_UBOOT_BOOT_SD

config BR2_PACKAGE_NOVATEK_UBOOT_BOOT_SD
	bool "SD card"
	select BR2_TARGET_ROOTFS_EXT2
	select BR2_PACKAGE_HOST_GENIMAGE
	select BR2_PACKAGE_HOST_DOSFSTOOLS
	select BR2_PACKAGE_HOST_MTOOLS
	select BR2_PACKAGE_E2FSPROGS
	select BR2_PACKAGE_E2FSPROGS_RESIZE2FS
	help
	  Kernel and device tree on the card's FAT partition, root on its
	  second partition (ext4). Onboard flash is never written.

config BR2_PACKAGE_NOVATEK_UBOOT_BOOT_NAND
	bool "SPI NAND"
	select BR2_PACKAGE_HOST_MTD
	help
	  Device tree in the fdt partition, kernel and squashfs root in UBI
	  volumes. The loader partition is never written: a card boot always
	  recovers.

endchoice

endif
```

## package/thingino-ethernet/Config.in
```kconfig
config BR2_PACKAGE_THINGINO_ETHERNET
	bool "thingino-ethernet"
	select BR2_PACKAGE_THINGINO_KOPT
	help
	  Enables support of Ethernet networking.
```
