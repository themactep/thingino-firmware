## package/thingino-sysupgrade/Config.in
```kconfig
config BR2_PACKAGE_THINGINO_SYSUPGRADE
	bool "thingino-sysupgrade"
	depends on BR2_SOC_VENDOR_INGENIC
	help
	  Enables FOTA (firmware-over-the-air) support package

	  It writes Ingenic flash layouts, so it is not offered for other
	  SoC vendors.
```

## package/wifi-atbm6031/Config.in
```kconfig
config BR2_PACKAGE_WIFI_ATBM6031
	select BR2_LINUX_KERNEL
	select BR2_PACKAGE_THINGINO_KOPT_MMC
	bool "AltoBeam ATBM6031"

config BR2_PACKAGE_WIFI_ATBM6031_SW_RATE_CTRL
	bool "Use mac80211 software rate control"
	depends on BR2_PACKAGE_WIFI_ATBM6031
	help
	  Run rate adaptation in the driver (minstrel_ht) instead of the
	  ATBM firmware. Some atbm6031 firmware revisions stay at MCS1 even
	  on a strong link; software rate control can recover the higher
	  rates at the cost of CPU time. This disables the firmware's
	  no-TX-confirm fast path so the driver receives the per-frame
	  status that minstrel needs.
```

## package/wifi-bcm43362/Config.in
```kconfig
config BR2_PACKAGE_WIFI_BCM43362
	bool "Broadcom 43362 (AP6181), kernel brcmfmac"
	select BR2_LINUX_KERNEL
	select BR2_PACKAGE_LINUX_FIRMWARE
	help
	  SDIO Wi-Fi BCM43362 (Ampak AP6181) with the mainline kernel's
	  brcmfmac driver (mainline kernels only). Installs the Cypress
	  firmware and a 26 MHz BCM43362 nvram from linux-firmware.
```

## package/wifi-rtl8733bu/Config.in
```kconfig
config BR2_PACKAGE_WIFI_RTL8733BU
	bool "Realtek RTL8733BU"
	select BR2_LINUX_KERNEL
	select BR2_PACKAGE_THINGINO_KOPT_DWC2
	select BR2_PACKAGE_THINGINO_KOPT_DWC2_WIFI_ONLY
	help
	  RTL8733BY wireless driver

config BR2_PACKAGE_WIFI_RTL8733BU_KEEP_POWER
	bool "Keep the MAC powered after probe"
	depends on BR2_PACKAGE_WIFI_RTL8733BU
	help
	  The driver powers the MAC off after the firmware download when the
	  interface has not been opened yet. On some boards (DML16-Z533) the
	  chip keeps its USB attachment but stops answering vendor requests,
	  so the later netdev_open() fails with -EPROTO until a power cycle.
	  Select this to compile that power-off out.
```
