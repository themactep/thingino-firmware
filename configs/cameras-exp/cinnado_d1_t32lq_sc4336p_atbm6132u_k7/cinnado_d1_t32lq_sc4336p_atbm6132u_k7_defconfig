## package/thingino-kopt/Config.in
```kconfig
menu "Kernel Options"

config BR2_PACKAGE_THINGINO_KOPT
	bool "thingino-kopt"
	help
	  Per device kernel customization support.
	  Items selected here will override the default kernel configuration.

config BR2_PACKAGE_THINGINO_KOPT_ADC
	bool "ADC"
	depends on BR2_PACKAGE_THINGINO_KOPT
	help
	  Enable ADC (Analog to Digital) support

config BR2_PACKAGE_THINGINO_KOPT_CIFS
	bool "CIFS"
	depends on BR2_PACKAGE_THINGINO_KOPT
	select BR2_PACKAGE_CIFS_UTILS
	help
	  Enable CIFS (SMB) networking support

config BR2_PACKAGE_THINGINO_KOPT_NFS
	bool "NFS"
	depends on BR2_PACKAGE_THINGINO_KOPT
	help
	  Enable the kernel NFS client (and root-over-NFS) for network
	  mounts and development.

config BR2_PACKAGE_THINGINO_KOPT_LEDS
	bool "GPIO LEDs"
	depends on BR2_PACKAGE_THINGINO_KOPT
	default y
	help
	  Enable the kernel LED subsystem and gpio-leds platform driver.

if BR2_PACKAGE_THINGINO_KOPT_LEDS

menu "GPIO LED Configuration"

config BR2_THINGINO_LED_B_GPIO
	int "Blue LED GPIO"
	default -1
	help
	  GPIO number for the blue status LED. Set to -1 to disable.

config BR2_THINGINO_LED_B_ACTIVE_LOW
	bool "Blue LED active low"
	help
	  Invert the blue LED output logic.

config BR2_THINGINO_LED_G_GPIO
	int "Green LED GPIO"
	default -1
	help
	  GPIO number for the green status LED. Set to -1 to disable.

config BR2_THINGINO_LED_G_ACTIVE_LOW
	bool "Green LED active low"
	help
	  Invert the green LED output logic.

config BR2_THINGINO_LED_R_GPIO
	int "Red LED GPIO"
	default -1
	help
	  GPIO number for the red status LED. Set to -1 to disable.

config BR2_THINGINO_LED_R_ACTIVE_LOW
	bool "Red LED active low"
	help
	  Invert the red LED output logic.

config BR2_THINGINO_LED_W_GPIO
	int "White LED GPIO"
	default -1
	help
	  GPIO number for the white status LED. Set to -1 to disable.

config BR2_THINGINO_LED_W_ACTIVE_LOW
	bool "White LED active low"
	help
	  Invert the white LED output logic.

config BR2_THINGINO_LED_Y_GPIO
	int "Yellow LED GPIO"
	default -1
	help
	  GPIO number for the yellow status LED. Set to -1 to disable.

config BR2_THINGINO_LED_Y_ACTIVE_LOW
	bool "Yellow LED active low"
	help
	  Invert the yellow LED output logic.

config BR2_THINGINO_LED_V_GPIO
	int "Violet LED GPIO"
	default -1
	help
	  GPIO number for the violet status LED. Set to -1 to disable.

config BR2_THINGINO_LED_V_ACTIVE_LOW
	bool "Violet LED active low"
	help
	  Invert the violet LED output logic.

endmenu

endif

config BR2_PACKAGE_THINGINO_KOPT_DEVELOP
	bool "Kernel Development Options"
	depends on BR2_PACKAGE_THINGINO_KOPT
	help
	  Enables Kernel Options for Development/Debugging (Valgrind, GDB, ltrace, etc)

config BR2_PACKAGE_THINGINO_KOPT_GADGET_SERIAL
	bool "USB Gadget Serial"
	depends on BR2_PACKAGE_THINGINO_KOPT
	help
	  Enable USB Gadget serial support

config BR2_PACKAGE_THINGINO_KOPT_GADGET_WEBCAM
	bool "USB Gadget Webcam (UVC)"
	depends on BR2_PACKAGE_THINGINO_KOPT
	help
	  Enable USB UVC webcam gadget (g_webcam module).

config BR2_PACKAGE_THINGINO_KOPT_JZ_MAC
	bool "Ethernet Support"
	depends on BR2_PACKAGE_THINGINO_KOPT
	help
	  Enable native wired Ethernet support on the SoC.

if BR2_PACKAGE_THINGINO_KOPT_JZ_MAC

choice
	prompt "MAC Version"
	default BR2_PACKAGE_THINGINO_KOPT_JZ_MAC_V12

config BR2_PACKAGE_THINGINO_KOPT_JZ_MAC_V12
	bool "JZ_MAC V12"
	help
	  Enable the Ingenic ethernet V12 driver

config BR2_PACKAGE_THINGINO_KOPT_JZ_MAC_V13
	bool "JZ_MAC V13"
	help
	  Enable the Ingenic ethernet V13 driver
endchoice

choice
	prompt "MAC Clock Rate"
	depends on BR2_PACKAGE_THINGINO_KOPT_JZ_MAC_V13
	default BR2_PACKAGE_THINGINO_KOPT_JZ_MAC_CLK_50MHZ

config BR2_PACKAGE_THINGINO_KOPT_JZ_MAC_CLK_25MHZ
	bool "25 MHz"
	help
	  Select 25 MHz clock for internal PHY

config BR2_PACKAGE_THINGINO_KOPT_JZ_MAC_CLK_50MHZ
	bool "50 MHz"
	help
	  Select 50 MHz clock for external PHY
endchoice

config BR2_PACKAGE_THINGINO_KOPT_JZ_MAC_CLK_VALUE
	int
	default 25000000 if BR2_PACKAGE_THINGINO_KOPT_JZ_MAC_CLK_25MHZ
	default 50000000

endif

config BR2_PACKAGE_THINGINO_KOPT_JZ_MAC_INTERNAL_PHY
	bool "JZ_MAC Internal PHY"
	depends on BR2_PACKAGE_THINGINO_KOPT_JZ_MAC
	depends on BR2_PACKAGE_THINGINO_KOPT_JZ_MAC_V13 && BR2_SOC_FAMILY = "t21"
	help
	  Enable support for the Internal MAC PHY on the T21 SoC

config BR2_PACKAGE_THINGINO_KOPT_MMC
	bool "MMC Support"
	depends on BR2_PACKAGE_THINGINO_KOPT
	select BR2_PACKAGE_THINGINO_MMC
	help
	  Enable MMC support for SD/MMC and SDIO devices

config BR2_PACKAGE_THINGINO_KOPT_MMC0
	bool "Enable MMC0"
	depends on BR2_PACKAGE_THINGINO_KOPT_MMC
	help
	  Enables the MMC0 on the SoC, typically used for SD/MMC cards.

config BR2_PACKAGE_THINGINO_KOPT_MMC0_1BIT
	bool "MMC0 1-Bit"
	depends on BR2_PACKAGE_THINGINO_KOPT_MMC0 && (BR2_SOC_FAMILY = "t23" || BR2_SOC_FAMILY = "t31")
	help
	  Force 1 bit mode for MMC0 on T23 based SoCs

config BR2_PACKAGE_THINGINO_KOPT_MMC0_BOOT
	bool "Boot from MMC"
	depends on BR2_PACKAGE_THINGINO_KOPT_MMC0
	help
	  Enables booting the rootfs from an MMC card

if BR2_PACKAGE_THINGINO_KOPT_MMC0

choice
	prompt "MMC0 PB Mode"
	default BR2_PACKAGE_THINGINO_KOPT_MMC0_PB_4BIT

config BR2_PACKAGE_THINGINO_KOPT_MMC0_PB_4BIT
	bool "MMC0 PB 4-Bit"
	help
	  Enables 4-bit support for MMC0 on GPIO PB.

config BR2_PACKAGE_THINGINO_KOPT_MMC0_PB_8BIT
	bool "MMC0 PB 8-Bit"
	help
	  Enables 8-bit support for MMC0 on GPIO PB.

endchoice

endif

config BR2_PACKAGE_THINGINO_KOPT_MMC1
	bool "Enable MMC1"
	depends on BR2_PACKAGE_THINGINO_KOPT_MMC
	help
	  Enables the MMC1 on the SoC, typically used for SDIO WiFi modules.

if BR2_PACKAGE_THINGINO_KOPT_MMC1

choice
	prompt "MMC1 Mode Selection"
	default BR2_PACKAGE_THINGINO_KOPT_MMC1_PA_4BIT

config BR2_PACKAGE_THINGINO_KOPT_MMC1_PA_4BIT
	bool "MMC1 PA 4-Bit"
	help
	  Enables 4-bit support for MMC1 on GPIO PA.

config BR2_PACKAGE_THINGINO_KOPT_MMC1_PB_4BIT
	bool "MMC1 PB 4-Bit"
	help
	  Enables 4-bit support for MMC1 on GPIO PB.

config BR2_PACKAGE_THINGINO_KOPT_MMC1_PB_8BIT
	bool "MMC1 PB 8-Bit"
	help
	  Enables 8-bit support for MMC1 on GPIO PB.

config BR2_PACKAGE_THINGINO_KOPT_MMC1_PC_4BIT
	bool "MMC1 PC 4-Bit"
	depends on BR2_SOC_FAMILY = "t10" || BR2_SOC_FAMILY = "t20" || BR2_SOC_FAMILY = "t21" || BR2_SOC_FAMILY = "t32"
	help
	  Enables 4-bit support for MMC1 on GPIO PC.

config BR2_PACKAGE_THINGINO_KOPT_MMC1_PD_4BIT
	bool "MMC1 PD 4-Bit"
	depends on BR2_SOC_FAMILY = "t10" || BR2_SOC_FAMILY = "t20"
	help
	  Enables 4-bit support for MMC1 on GPIO PD.

endchoice

endif

config BR2_PACKAGE_THINGINO_KOPT_NETFILTER
	bool "Netfilter"
	depends on BR2_PACKAGE_THINGINO_KOPT
	help
	  Build necessary kernel modules and dependencies to enable netfilter/iptables support.

config BR2_PACKAGE_THINGINO_KOPT_IPV6
	bool "IPv6"
	depends on BR2_PACKAGE_THINGINO_KOPT
	select BR2_PACKAGE_THINGINO_ODHCP6C
	help
	  Enable IPv6 networking support.

config BR2_PACKAGE_THINGINO_KOPT_PWM
	bool "PWM"
	depends on BR2_PACKAGE_THINGINO_KOPT
	help
	  Enable PWM (Pulse Width Modulation) support

config BR2_PACKAGE_THINGINO_KOPT_RTC
	bool "RTC"
	depends on BR2_PACKAGE_THINGINO_KOPT
	help
	  Enables RTC (Real Time Clock) support

config BR2_PACKAGE_THINGINO_KOPT_SPI1_PB2
	bool "SPI1 PB2"
	depends on BR2_PACKAGE_THINGINO_KOPT
	help
	  Enable SPI1 on PB_2

config BR2_PACKAGE_THINGINO_KOPT_UART
	bool "UART Support"
	depends on BR2_PACKAGE_THINGINO_KOPT
	help
	  Enables additional UART ports

config BR2_PACKAGE_THINGINO_KOPT_UART_UART0
	bool "UART0"
	depends on BR2_PACKAGE_THINGINO_KOPT_UART
	help
	  Enables UART0 on the SoC

config BR2_PACKAGE_THINGINO_KOPT_UART_UART2
	bool "UART2"
	depends on BR2_PACKAGE_THINGINO_KOPT_UART
	help
	  Enables UART2 on the SoC

config BR2_PACKAGE_THINGINO_KOPT_SLIP
	bool "SLIP over a serial port"
	depends on BR2_PACKAGE_THINGINO_KOPT_UART
	help
	  IP over a UART (kernel SLIP line discipline plus busybox slattach).
	  Lets a host reach the camera over a serial line with no wired MAC,
	  which is how the QEMU test profiles get host access while booting
	  exactly like a WiFi-only camera.

config BR2_PACKAGE_THINGINO_KOPT_DWC2
	bool "USB Support"
	depends on BR2_PACKAGE_THINGINO_KOPT
	help
	  Enable the DWC2 USB driver

if BR2_PACKAGE_THINGINO_KOPT_DWC2

choice
	prompt "DWC2 USB Mode Selection"
	default BR2_PACKAGE_THINGINO_KOPT_DWC2_WIFI_ONLY

config BR2_PACKAGE_THINGINO_KOPT_DWC2_OTG
	bool "USB host + networking (plug devices into the camera)"
	select BR2_PACKAGE_USBNET
	select BR2_PACKAGE_USBNET_CDC_ETHER
	select BR2_PACKAGE_USBNET_CDC_NCM
	select BR2_PACKAGE_USBNET_ASIX
	help
	  Host mode: attach a USB device to the camera (e.g. via an OTG
	  adapter) - USB-Ethernet, storage, etc. Enables the usbnet drivers.
	  No gadget/dual-role stack. The common "USB data port" case.

config BR2_PACKAGE_THINGINO_KOPT_DWC2_DUAL_ROLE
	bool "USB dual-role / device (webcam, usb-direct)"
	select BR2_PACKAGE_USBNET
	select BR2_PACKAGE_USBNET_CDC_ETHER
	select BR2_PACKAGE_USBNET_CDC_NCM
	select BR2_PACKAGE_USBNET_ASIX
	help
	  Dual-role + USB gadget stack, for cameras that themselves act as a
	  USB device - UVC webcam or usb-direct network (NCM). Only needed
	  when the camera plugs INTO a host.

config BR2_PACKAGE_THINGINO_KOPT_DWC2_WIFI_ONLY
	bool "USB Wi-Fi Module Only"
	help
	  Enable the DWC2 USB driver with WiFi-only support.
	  Recommended for devices that use WiFi chipsets internally connected via USB.

endchoice

endif

config BR2_PACKAGE_THINGINO_KOPT_I2C
	bool "I2C Support"
	depends on BR2_PACKAGE_THINGINO_KOPT
	help
	  Enables additional I2C ports

config BR2_PACKAGE_THINGINO_KOPT_I2C_BUS1
	bool "I2C1"
	depends on BR2_PACKAGE_THINGINO_KOPT_I2C
	help
	  Enables I2C1 on the SoC

if BR2_PACKAGE_THINGINO_KOPT_I2C_BUS1

choice
	prompt "I2C1 Pin Selection"
	default BR2_PACKAGE_THINGINO_KOPT_I2C_BUS1_PA16_PA17 if BR2_SOC_FAMILY = "t23"
	default BR2_PACKAGE_THINGINO_KOPT_I2C_BUS1_PB25_PB26

config BR2_PACKAGE_THINGINO_KOPT_I2C_BUS1_PB25_PB26
	bool "I2C1 on PB25/PB26"
	help
	  Routes I2C1 to GPIO PB25 and PB26.

config BR2_PACKAGE_THINGINO_KOPT_I2C_BUS1_PA16_PA17
	bool "I2C1 on PA16/PA17"
	depends on BR2_SOC_FAMILY = "t23"
	help
	  Routes I2C1 to GPIO PA16 and PA17. T23 only.

	  PA16/PA17 are shared with MMC1 on port A and with the DVP
	  sensor bus, so this cannot be combined with either.

endchoice

endif

config BR2_PACKAGE_THINGINO_KOPT_I2C_BUS2
	bool "I2C2"
	depends on BR2_PACKAGE_THINGINO_KOPT_I2C
	help
	  Enables I2C2 on the SoC

if BR2_PACKAGE_THINGINO_KOPT_I2C_BUS2 && BR2_SOC_FAMILY = "t23"

choice
	prompt "I2C2 Pin Selection"
	default BR2_PACKAGE_THINGINO_KOPT_I2C_BUS2_PB20_PB21

config BR2_PACKAGE_THINGINO_KOPT_I2C_BUS2_PB20_PB21
	bool "I2C2 on PB20/PB21"
	help
	  Routes I2C2 to GPIO PB20 and PB21.

config BR2_PACKAGE_THINGINO_KOPT_I2C_BUS2_PB27_PB28
	bool "I2C2 on PB27/PB28"
	help
	  Routes I2C2 to GPIO PB27 and PB28.

	  PB27 is shared with the OTG DRVVBUS pin.

endchoice

endif

config BR2_PACKAGE_THINGINO_KOPT_USB_MASS_STORAGE
	bool "USB Storage"
	depends on BR2_PACKAGE_THINGINO_KOPT
	help
	  Enables USB Mass Storage device class support.

config BR2_PACKAGE_THINGINO_KOPT_EXTFS
	bool "EXT2/EXT4 Filesystem Support"
	depends on BR2_PACKAGE_THINGINO_KOPT
	help
	  Enables EXT2 and EXT4 filesystem support with all dependencies.

config BR2_PACKAGE_THINGINO_KOPT_DMIC
	bool "I2S DMIC Support"
	depends on BR2_PACKAGE_THINGINO_KOPT && KERNEL_VERSION_3
	help
	  Enables I2S DMIC (Digital Microphone) support.

config BR2_PACKAGE_THINGINO_KOPT_SLUB_DEBUG
	bool "SLUB allocator debugging"
	depends on BR2_PACKAGE_THINGINO_KOPT
	help
	  Enable SLUB allocator debugging (redzones, poisoning, use-after-free
	  detection). Boots with slub_debug on by default to catch heap
	  corruption at the point of the bad write/free.

config BR2_THINGINO_LOWMEM
	bool "32 MB low-memory tuning"
	depends on BR2_PACKAGE_THINGINO_KOPT
	depends on KERNEL_VERSION_3
	help
	  For boards with ~19 MB of Linux RAM (32 MB DDR, 7-8 MB rmem),
	  Lu-Fi/openimp#785. No feature is removed:
	  - kernel log buffer 64 KiB (LOG_BUF_SHIFT=16), Android
	    log_main ring 64 KiB instead of 256 KiB, JFFS2 deflate
	    workspace ~48 KiB instead of 268 KiB (kernel patch 0110);
	  - S03lowmem: TCP memory capped (tcp_mem 192/256/384 pages),
	    dirty page cache limit 1 MiB, the watchdog daemon and the ssh
	    listener exempt from the OOM killer (a killed watchdog daemon
	    means a hardware reset 60 s later);
	  - zram swap (Lu-Fi/openimp#800): kernel ZRAM + LZ4 and the
	    busybox mkswap/swapon applets; S03lowmem adds a 4 MiB
	    /dev/zram0 swap (swappiness 100, page-cluster 0,
	    min_free_kbytes 768) so reclaim takes cold anonymous pages
	    instead of thrashing the squashfs program text into a
	    watchdog reset. VM event counters on for /proc/vmstat;
	  - Android low-memory killer (#800, kernel STAGING/ANDROID):
	    below 3.5 MiB of file cache it kills the biggest process
	    with oom_score_adj >= 800. Every WebUI CGI raises itself to
	    800 (a line added to auth.sh at target-finalize), uhttpd
	    stays <= 0 and wpa_supplicant/dropbear get -500 (S61lowmem),
	    so an overloaded board drops a WebUI request instead of
	    thrashing into a hardware-watchdog reset;
	  - AIC8800 USB WLAN: 10 message-endpoint RX URBs like the OEM
	    driver instead of the upstream 100 (~360 KiB less slab,
	    Lu-Fi/openimp#802, BR2_PACKAGE_WIFI_AIC8800_USB_MSG_RX_URBS).
	  Pair it with BR2_TARGET_ROOTFS_SQUASHFS_BS_128K (squashfs read
	  caches and the XZ dictionary scale with the block size).

endmenu
```

## package/thingino-rhkd/Config.in
```kconfig
config BR2_PACKAGE_THINGINO_RHKD
	bool "Thingino HomeKit camera (rhkd)"
	depends on BR2_PACKAGE_THINGINO_RAPTOR
	depends on BR2_TOOLCHAIN_HAS_THREADS
	select BR2_PACKAGE_THINGINO_RAPTOR_RVD
	select BR2_PACKAGE_THINGINO_RAPTOR_RAD
	select BR2_PACKAGE_THINGINO_RAPTOR_OPUS
	select BR2_PACKAGE_FAAC
	help
	  rhkd: native Apple HomeKit camera daemon for raptor cameras,
	  so the camera can be added to the Home app directly.

	  Built on Apple's HomeKit ADK (Apache-2.0), with the camera
	  code ported from HAP-NodeJS. Live view (H.264 and Opus over
	  SRTP, straight from raptor's rings), two-way audio (the
	  controller's Opus played through rad), snapshots, HomeKit Secure
	  Video recording (fragmented MP4 over the HomeKit Data Stream,
	  AAC-LC audio), the camera settings in Home (on/off, night
	  vision, status light), and a Services > HomeKit web UI page
	  with the setup code and QR.

	  Motion sensor (and so Secure Video recording triggers): fed by
	  rvd's IVS motion detection (the default "move" algorithm; IVS
	  object detection is not needed). It must be switched on in
	  /etc/raptor.conf ([motion] enabled = true); until then Home
	  shows the sensor as inactive. The package leaves it off,
	  because [motion] also controls raptor's own recording.

	  Selects raptor's RVD (video and JPEG rings), RAD (audio ring)
	  and Opus support (live view audio is Opus), and faac.
	  Recording audio is taken from a rad AAC output if there is
	  one; otherwise rad's Opus is converted to AAC with the system
	  libopus and libfaac.

	  Installs /usr/bin/rhkd, /usr/bin/hap-setupgen,
	  /usr/sbin/rhkd-setup, /etc/init.d/S98rhkd and
	  /etc/default/rhkd. On first boot it creates a setup code and,
	  once, switches raptor's audio to Opus if no audio output
	  carries Opus (and the substream to H.264 if no stream is
	  H.264), since HomeKit needs those.
	  Pairing survives sysupgrade -B (cfg-backup.list).

	  HomeKit ADK and raptor-ipc are fetched as extra downloads at
	  pinned commits, and mbedTLS 2.28 at its release tag; all are
	  hash-checked.

	  https://github.com/Small6oy/thingino-homekit

comment "rhkd needs raptor and a toolchain with threads"
	depends on !BR2_PACKAGE_THINGINO_RAPTOR || !BR2_TOOLCHAIN_HAS_THREADS
```
