## configs/cameras-exp/wyze_campan4_t32nq_cv8001_atbm6162s/wyze_campan4_t32nq_cv8001_atbm6162s_defconfig
```kconfig
# NAME: Wyze Cam Pan v4 (T32NQ, CV8001, ATBM6162S)
# FRAG: soc-xburst1 core ssl
BR2_INGENIC_SOC_MODEL="t32nq"
BR2_PACKAGE_WIFI=y
BR2_PACKAGE_WIFI_ATBM6162S=y
BR2_SENSOR_1_NAME="cv8001"
BR2_THINGINO_AUDIO=y
BR2_THINGINO_AUDIO_GPIO=-1
BR2_THINGINO_BUTTON=y
BR2_THINGINO_MOTOR=y
BR2_THINGINO_RMEM_MB=35
BR2_THINGINO_NMEM_MB=93
BR2_THINGINO_SDCARD=y
FLASH_SIZE_MB=16
BR2_PACKAGE_THINGINO_UBOOT_FLASH_CONTROLLER_JZ_SFC=n
BR2_PACKAGE_THINGINO_UBOOT_FLASH_CONTROLLER_SFC0_NOR=y
BR2_LINUX_KERNEL_EXT_THINGINO_KOPT=y
BR2_LINUX_KERNEL_EXT_THINGINO_KOPT_DTS=y
BR2_LINUX_KERNEL_EXT_THINGINO_KOPT_DTS_WYZEPANV4=y
```

## configs/cameras-exp/wyze_floodlightv2_t41nq_gc3003a_atbm6031/wyze_floodlightv2_t41nq_gc3003a_atbm6031_defconfig
```kconfig
# NAME: Wyze Floodlight v2 (T41NQ, GC3003A, ATBM6031)
# FRAG: soc-xburst2 core ssl
BR2_AVPU_CLK_550MHZ=y
BR2_AVPU_SCLKA=y
BR2_INGENIC_SOC_MODEL="t41nq"
BR2_LINUX_KERNEL_EXT_THINGINO_KOPT=y
BR2_PACKAGE_THINGINO_UBOOT_T41_INIT_BYPASS=y
BR2_LINUX_KERNEL_EXT_THINGINO_KOPT_DTS=y
BR2_LINUX_KERNEL_EXT_THINGINO_KOPT_DTS_WYZEFLOODV2=y
BR2_PACKAGE_THINGINO_FLOODLIGHTD=y
BR2_PACKAGE_THINGINO_UBOOT_FLASH_CONTROLLER_JZ_SFC=n
BR2_PACKAGE_THINGINO_UBOOT_FLASH_CONTROLLER_SFC0_NOR=y
BR2_PACKAGE_WIFI=y
BR2_PACKAGE_WIFI_ATBM6031=y
BR2_SENSOR_1_NAME="gc3003a"
BR2_THINGINO_AUDIO=y
BR2_THINGINO_AUDIO_GPIO=63
BR2_THINGINO_BUTTON=y
BR2_THINGINO_NMEM_MB=8
BR2_THINGINO_RMEM_MB=20
BR2_THINGINO_SDCARD=y
FLASH_SIZE_MB=16
```

## configs/cameras/360_ap1pa3_t31x_gc4653_atbm6031/360_ap1pa3_t31x_gc4653_atbm6031_defconfig
```kconfig
# NAME: 360 AP1PA3 (T31X, GC4653, ATBM6031)
# MODULE: t31x_gc4653_atbm6031
BR2_ISP_CLK_200MHZ=y
BR2_PACKAGE_THINGINO_KOPT_DWC2=y
BR2_PACKAGE_THINGINO_KOPT_DWC2_OTG=y
BR2_PACKAGE_THINGINO_KOPT_MMC0=y
BR2_PACKAGE_THINGINO_KOPT_MMC0_PB_4BIT=y
BR2_PACKAGE_THINGINO_KOPT_MMC1=y
BR2_PACKAGE_THINGINO_KOPT_MMC1_PA_4BIT=y
BR2_SENSOR_PARAMS="shvflip=1"
BR2_THINGINO_AUDIO=y
BR2_THINGINO_BUTTON=y
BR2_THINGINO_MOTORS=y
BR2_THINGINO_PWM_ENABLE=y
BR2_THINGINO_RMEM_48=y
BR2_THINGINO_SDCARD=y
FLASH_SIZE_16=y
```

## configs/cameras/ajcloud_cp8010_t23n_sc2336p_atbm6132bu/ajcloud_cp8010_t23n_sc2336p_atbm6132bu_defconfig
```kconfig
# NAME: AJCloud T-CP8010TF-W3M (T23N, SC2336P, ATBM6132U)
# MODULE: t23n_sc2336p_atbm6132u
BR2_PACKAGE_THINGINO_KOPT_MMC0=y
BR2_PACKAGE_THINGINO_KOPT_MMC0_PB_4BIT=y
BR2_THINGINO_AUDIO=y
BR2_THINGINO_BUTTON=y
BR2_THINGINO_MOTORS=y
BR2_THINGINO_DEVICE_TYPE_IPCAM=y
BR2_THINGINO_DEVICE_TYPE_IPCAM_PAN_TILT=y
BR2_THINGINO_PWM_ENABLE=y
BR2_THINGINO_SDCARD=y
FLASH_SIZE_8=y
```

## configs/cameras/ajcloud_cp8040_t20n_gc1084_atbm6012bx/ajcloud_cp8040_t20n_gc1084_atbm6012bx_defconfig
```kconfig
# NAME: AJCloud T-CP8040LF-W2M (T20N, GC1084, ATBM6012BX)
# FRAG: soc-xburst1 toolchain-xburst1 ccache brand rootfs kernel system target uboot ssl
BR2_ETHERNET=y
BR2_PACKAGE_WIFI=y
BR2_PACKAGE_WIFI_ATBM6012BX=y
BR2_SENSOR_GC1084=y
BR2_SOC_INGENIC_T20N=y
BR2_PACKAGE_THINGINO_KOPT_MMC0=y
BR2_PACKAGE_THINGINO_KOPT_MMC0_PB_4BIT=y
BR2_THINGINO_AUDIO=y
BR2_THINGINO_BUTTON=y
BR2_THINGINO_MOTORS=y
BR2_THINGINO_PWM_ENABLE=y
BR2_THINGINO_SDCARD=y
FLASH_SIZE_8=y
```

## configs/cameras/ajcloud_cp8040_t23n_sc2336p_atbm6132bu/ajcloud_cp8040_t23n_sc2336p_atbm6132bu_defconfig
```kconfig
# NAME: AJCloud T-CP8040LF-W3M (T23N, SC2336P, ATBM6132U)
# FRAG: soc-xburst1 toolchain-xburst1 ccache brand rootfs kernel system target uboot ssl
BR2_PACKAGE_WIFI=y
BR2_PACKAGE_WIFI_ATBM6132U=y
BR2_SENSOR_SC2336P=y
BR2_SOC_INGENIC_T23N=y
BR2_PACKAGE_THINGINO_KOPT_MMC0=y
BR2_PACKAGE_THINGINO_KOPT_MMC0_PB_4BIT=y
BR2_THINGINO_AUDIO=y
BR2_THINGINO_BUTTON=y
BR2_THINGINO_MOTORS=y
BR2_THINGINO_PWM_ENABLE=y
BR2_THINGINO_SDCARD=y
FLASH_SIZE_8=y
```

## configs/cameras/aobocam_a12_t23dl_jxh63p_txw901u/aobocam_a12_t23dl_jxh63p_txw901u_defconfig
```kconfig
# NAME: Aobocam A12 (T23DL, JXH63P, TXW901U)
# FRAG: soc-xburst1 toolchain-xburst1 ccache brand rootfs kernel system target uboot ssl
BR2_SOC_INGENIC_T23DL=y
BR2_SENSOR_JXH63P=y
BR2_PACKAGE_WIFI=y
BR2_PACKAGE_WIFI_TXW901U=y
BR2_ISP_CLKA_600MHZ=y
BR2_ISP_CLKA_SCLKA=y
BR2_ISP_CLK_200MHZ=y
BR2_ISP_CLK_SCLKA=y
BR2_PACKAGE_THINGINO_KOPT_MMC0=y
BR2_PACKAGE_THINGINO_KOPT_MMC0_PB_4BIT=y
BR2_THINGINO_AUDIO=y
BR2_THINGINO_BUTTON=y
BR2_THINGINO_SDCARD=y
BR2_THINGINO_RMEM_10=y
FLASH_SIZE_8=y
```

## configs/cameras/aoqee_c1_t23n_sc2336_atbm6062/aoqee_c1_t23n_sc2336_atbm6062_defconfig
```kconfig
# NAME: AOQEE C1 (T23N, SC2336, ATBM6062)
# FRAG: soc-xburst1 core ssl
BR2_PACKAGE_THINGINO_KOPT_MMC0=y
BR2_PACKAGE_THINGINO_KOPT_MMC0_PB_4BIT=y
BR2_PACKAGE_WIFI=y
BR2_PACKAGE_WIFI_ATBM6062U=y
BR2_SENSOR_1_NAME="sc2336"
BR2_INGENIC_SOC_MODEL="t23n"
BR2_THINGINO_AUDIO=y
BR2_THINGINO_AUDIO_GPIO=39
BR2_THINGINO_AUDIO_GPIO_LOW=y
BR2_THINGINO_BUTTON=y
BR2_THINGINO_PWM_ENABLE=y
BR2_THINGINO_SDCARD=y
FLASH_SIZE_MB=8
```

## configs/cameras/aosu_c5l_t31l_sc3336_rtl8188ftv/aosu_c5l_t31l_sc3336_rtl8188ftv_defconfig
```kconfig
# NAME: AOSU C5L (T31L, SC3336, RTL8188FTV)
# FRAG: soc-xburst1 toolchain-xburst1 ccache brand rootfs kernel system target uboot ssl
BR2_PACKAGE_WIFI=y
BR2_PACKAGE_WIFI_RTL8188FU=y
BR2_SENSOR_SC3336=y
BR2_SOC_INGENIC_T31L=y
BR2_AVPU_MPLL=y
BR2_ISP_CH0_PRE_DEQUEUE_TIME=y
BR2_ISP_CH0_PRE_DEQUEUE_TIME_VALUE=24
BR2_ISP_CH0_PRE_DEQUEUE_INTERRUPT_PROCESS=y
BR2_ISP_CH0_PRE_DEQUEUE_INTERRUPT_PROCESS_VALUE=0
BR2_PACKAGE_THINGINO_KOPT_MMC0=y
BR2_PACKAGE_THINGINO_KOPT_MMC0_PB_4BIT=y
BR2_SENSOR_PARAMS="shvflip=1"
BR2_THINGINO_AUDIO=y
BR2_THINGINO_MOTORS=y
BR2_THINGINO_SDCARD=y
FLASH_SIZE_16=y
BR2_THINGINO_RMEM_33=y
BR2_THINGINO_BUTTON=y
```

## configs/cameras/cinnado_b6_t23zn_os02g10_atbm6461/cinnado_b6_t23zn_os02g10_atbm6461_defconfig
```kconfig
# NAME: Cinnado B6 (T23ZN, OS02G10, ATBM6461)
# FRAG: soc-xburst1 core ssl
#
# SoC:    Ingenic T23ZN, XBurst1 MIPS32 R1, 64MB RAM (46M+18M split)
# Sensor: OmniVision OS02G10, 1/2.9" 2MP, I2C 0x3c, reg_addr_size=0 (ZRT bank-switch)
# WiFi:   AltoBeam ATBM6461, SDIO, also manages hardware MCU watchdog
# Flash:  16MB NOR SPI
# UART:   ttyS1
#
# NOTES:
#  - Stock firmware tag says "OS02G10_6461_S" and loads atbm6461_wifi_sdio.ko.
#  - Stock user tag confirms Cinnado B6 product metadata and PTZ:
#      product_name=B6; [HW] ptz=1; flt=1; [PTZ] hstep=510; vstep=132; speed=500
#  - Motor phase GPIOs are not exposed in the rootfs/kernel strings. Motors are
#    enabled with the best available guess from the AJCloud T-CP8040LF/Cinnado
#    PTZ family because the stock user tag reports mould=804. Verify on hardware.
#  - GPIO hints from stock firmware: phwi0=/sys/class/gpio/gpio57/value,
#    phwi1=/sys/class/gpio/gpio38/value, phwi2=/sys/class/gpio/gpio16/value;
#    upgrade scripts drive LEDs on GPIO49/GPIO50.

BR2_ISP_CLKA_600MHZ=y
BR2_ISP_CLKA_SCLKA=y
BR2_ISP_CLK_200MHZ=y
BR2_ISP_CLK_SCLKA=y
BR2_PACKAGE_THINGINO_KOPT_MMC0=y
BR2_PACKAGE_THINGINO_KOPT_MMC0_PB_4BIT=y
BR2_PACKAGE_WIFI=y
BR2_PACKAGE_WIFI_ATBM6461=y
BR2_PACKAGE_THINGINO_WPA_SUPPLICANT_WEXT=y
BR2_SENSOR_1_NAME="os02g10"
BR2_INGENIC_SOC_MODEL="t23zn"
BR2_THINGINO_AUDIO=y
BR2_THINGINO_AUDIO_GPIO=63
BR2_THINGINO_MOTORS=y
BR2_THINGINO_RMEM_MB=18
BR2_THINGINO_SDCARD=y
FLASH_SIZE_MB=16
BR2_LINUX_KERNEL_CONFIG_FRAGMENT_FILES="$(BR2_EXTERNAL_THINGINO_PATH)/configs/cameras/cinnado_b6_t23zn_os02g10_atbm6461/cinnado_b6_t23zn.kernel.config"
BR2_ISP_PRINT_LEVEL_0=y
```

## configs/cameras/cinnado_d1_t23n_sc2336_atbm6012bx/cinnado_d1_t23n_sc2336_atbm6012bx_defconfig
```kconfig
# NAME: Cinnado D1 (T23N, SC2336, ATBM6012BX)
# FRAG: soc-xburst1 toolchain-xburst1 ccache brand rootfs kernel system target uboot ssl
BR2_PACKAGE_WIFI=y
BR2_PACKAGE_WIFI_ATBM6012BX=y
BR2_SENSOR_SC2336=y
BR2_SOC_INGENIC_T23N=y
BR2_ISP_CLKA_600MHZ=y
BR2_ISP_CLKA_SCLKA=y
BR2_ISP_CLK_200MHZ=y
BR2_ISP_CLK_SCLKA=y
BR2_PACKAGE_THINGINO_KOPT_MMC0=y
BR2_PACKAGE_THINGINO_KOPT_MMC0_PB_4BIT=y
BR2_THINGINO_AUDIO=y
BR2_THINGINO_BUTTON=y
BR2_THINGINO_MOTORS=y
BR2_THINGINO_RMEM_22=y
BR2_THINGINO_SDCARD=y
FLASH_SIZE_8=y
```

## configs/cameras/cinnado_d1_t31l_sc2336_atbm6031/cinnado_d1_t31l_sc2336_atbm6031_defconfig
```kconfig
# NAME: Cinnado D1 (T31L, SC2336, ATBM6031)
# FRAG: soc-xburst1 toolchain-xburst1 ccache brand rootfs kernel system target uboot ssl
BR2_PACKAGE_WIFI=y
BR2_PACKAGE_WIFI_ATBM6031=y
BR2_SENSOR_SC2336=y
BR2_SOC_INGENIC_T31L=y
BR2_AVPU_VPLL=y
BR2_ISP_CH0_PRE_DEQUEUE_TIME=y
BR2_ISP_CH0_PRE_DEQUEUE_TIME_VALUE=24
BR2_ISP_CH0_PRE_DEQUEUE_INTERRUPT_PROCESS=y
BR2_ISP_CH0_PRE_DEQUEUE_INTERRUPT_PROCESS_VALUE=0
BR2_PACKAGE_THINGINO_KOPT_DWC2=y
BR2_PACKAGE_THINGINO_KOPT_DWC2_OTG=y
BR2_PACKAGE_THINGINO_KOPT_MMC0=y
BR2_PACKAGE_THINGINO_KOPT_MMC0_PB_4BIT=y
BR2_PACKAGE_THINGINO_KOPT_MMC1=y
BR2_PACKAGE_THINGINO_KOPT_MMC1_PB_4BIT=y
BR2_SENSOR_PARAMS="shvflip=1"
BR2_THINGINO_AUDIO=y
BR2_THINGINO_BUTTON=y
BR2_THINGINO_MOTORS=y
BR2_THINGINO_RMEM_22=y
BR2_THINGINO_SDCARD=y
FLASH_SIZE_8=y
```

## configs/cameras/edison_wk1mpx_t20n_jxh62_rtl8188ftv/edison_wk1mpx_t20n_jxh62_rtl8188ftv_defconfig
```kconfig
# NAME: EDISON WK1MPx (T20N, JXH62, RTL8188FU)
# FRAG: soc-xburst1 ccache brand rootfs kernel system target uboot ssl
BR2_THINGINO_TOOLCHAIN_TYPE_EXTERNAL=y
BR2_THINGINO_TOOLCHAIN_GCC_15=y
BR2_THINGINO_TOOLCHAIN_LIBC_MUSL=y
BR2_PACKAGE_THINGINO_KOPT_MMC0=y
BR2_PACKAGE_THINGINO_KOPT_MMC0_PB_4BIT=y
BR2_PACKAGE_WIFI=y
BR2_PACKAGE_WIFI_RTL8188FU=y
BR2_SENSOR_1_NAME="jxh62"
BR2_INGENIC_SOC_MODEL="t20n"
BR2_THINGINO_AUDIO=y
BR2_THINGINO_AUDIO_GPIO=63
BR2_THINGINO_BUTTON=y
BR2_THINGINO_MOTORS=y
BR2_THINGINO_SDCARD=y
FLASH_SIZE_8=y
```

## configs/cameras/eufy_t8410x_t31x_sc3336_syn4343/eufy_t8410x_t31x_sc3336_syn4343_defconfig
```kconfig
# NAME: Eufy E220 T8410X (T31X, SC3336, SYN4343)
# FRAG: soc-xburst1 toolchain-xburst1 ccache brand rootfs kernel system target uboot ssl
BR2_PACKAGE_WIFI=y
BR2_PACKAGE_WIFI_SYN4343=y
BR2_SENSOR_SC3336=y
BR2_SOC_INGENIC_T31X=y
BR2_AVPU_CLK_600MHZ=y
BR2_ISP_CLK_200MHZ=y
BR2_PACKAGE_THINGINO_KOPT_DWC2=y
BR2_PACKAGE_THINGINO_KOPT_DWC2_OTG=y
BR2_PACKAGE_THINGINO_KOPT_MMC0=y
BR2_PACKAGE_THINGINO_KOPT_MMC0_PB_4BIT=y
BR2_PACKAGE_THINGINO_KOPT_MMC1=y
BR2_PACKAGE_THINGINO_KOPT_MMC1_PB_4BIT=y
BR2_PACKAGE_THINGINO_UBOOT_BOARDNAME="isvp_t31_sfcnor_msc1_ddr128M"
BR2_THINGINO_AUDIO=y
BR2_THINGINO_BUTTON=y
BR2_THINGINO_MOTORS=y
BR2_THINGINO_PWM_ENABLE=y
BR2_THINGINO_SDCARD=y
FLASH_SIZE_16=y
```

## configs/cameras/feisda_hd620_t31x_jxq03_eth+rtl8188ftv/feisda_hd620_t31x_jxq03_eth+rtl8188ftv_defconfig
```kconfig
# NAME: Feisda HD620 (T31X, JXQ03, ETH, RTL8188FTV)
# MODULE: t31x_jxq03_eth
BR2_AVPU_CLK_486MHZ=y
BR2_AVPU_VPLL=y
BR2_ISP_CLK_250MHZ=y
BR2_ISP_PARAMS="isp_day_night_switch_drop_frame_num=1"
BR2_PACKAGE_THINGINO_KOPT_ADC=y
BR2_PACKAGE_THINGINO_KOPT_DWC2=y
BR2_PACKAGE_THINGINO_KOPT_DWC2_OTG=y
BR2_PACKAGE_THINGINO_KOPT_MMC0=y
BR2_PACKAGE_THINGINO_KOPT_MMC0_PB_4BIT=y
BR2_PACKAGE_THINGINO_KOPT_MMC=y
BR2_PACKAGE_WIFI=y
BR2_PACKAGE_WIFI_RTL8188FU=y
BR2_THINGINO_AUDIO=y
BR2_THINGINO_BUTTON=y
BR2_THINGINO_MOTORS=y
BR2_THINGINO_DEVICE_TYPE_IPCAM=y
BR2_THINGINO_DEVICE_TYPE_IPCAM_PAN_TILT=y
BR2_THINGINO_RMEM_64=y
BR2_THINGINO_SDCARD=y
FLASH_SIZE_16=y
```

## configs/cameras/galayou_y4_t23n_sc2336_atbm6062/galayou_y4_t23n_sc2336_atbm6062_defconfig
```kconfig
# NAME: Galayou Y4 (T23N, SC2336, ATBM6062)
# FRAG: soc-xburst1 toolchain-xburst1 ccache brand rootfs kernel system target uboot ssl
BR2_PACKAGE_WIFI=y
BR2_PACKAGE_WIFI_ATBM6062U=y
BR2_SENSOR_SC2336=y
BR2_SOC_INGENIC_T23N=y
BR2_ISP_CLK_200MHZ=y
BR2_PACKAGE_THINGINO_KOPT_MMC0=y
BR2_SENSOR_PARAMS="shvflip=1"
BR2_THINGINO_AUDIO=y
BR2_THINGINO_BUTTON=y
BR2_THINGINO_MOTORS=y
BR2_THINGINO_RMEM_22=y
BR2_THINGINO_SDCARD=y
FLASH_SIZE_8=y
```

## configs/cameras/galayou_y4_t31l_sc2336_atbm6012bx/galayou_y4_t31l_sc2336_atbm6012bx_defconfig
```kconfig
# NAME: Galayou Y4 (T31L, SC2336, ATBM6012BX)
# MODULE: t31l_sc2336_atbm6012bx
BR2_AVPU_VPLL=y
BR2_ISP_CH0_PRE_DEQUEUE_TIME=y
BR2_ISP_CH0_PRE_DEQUEUE_TIME_VALUE=24
BR2_PACKAGE_THINGINO_KOPT_MMC0=y
BR2_PACKAGE_THINGINO_KOPT_MMC0_PB_4BIT=y
BR2_SENSOR_PARAMS="shvflip=1"
BR2_THINGINO_AUDIO=y
BR2_THINGINO_BUTTON=y
BR2_THINGINO_MOTORS=y
BR2_THINGINO_RMEM_22=y
BR2_THINGINO_SDCARD=y
FLASH_SIZE_8=y
```

## configs/cameras/galayou_y4_t31l_sc2336_atbm6032/galayou_y4_t31l_sc2336_atbm6032_defconfig
```kconfig
# NAME: Galayou Y4 (T31L, SC2336, ATBM6032)
# MODULE: t31l_sc2336_atbm6032
BR2_AVPU_VPLL=y
BR2_ISP_CLK_150MHZ=y
BR2_ISP_PARAMS="isp_ch0_pre_dequeue_time=24 isp_ch0_pre_dequeue_interrupt_process=0"
BR2_PACKAGE_THINGINO_KOPT_DWC2=y
BR2_PACKAGE_THINGINO_KOPT_DWC2_OTG=y
BR2_PACKAGE_THINGINO_KOPT_MMC0=y
BR2_PACKAGE_THINGINO_KOPT_MMC0_PB_4BIT=y
BR2_PACKAGE_THINGINO_KOPT_MMC1=y
BR2_PACKAGE_THINGINO_KOPT_MMC1_PB_4BIT=y
BR2_SENSOR_PARAMS="shvflip=1"
BR2_THINGINO_AUDIO=y
BR2_THINGINO_BUTTON=y
BR2_THINGINO_MOTORS=y
BR2_THINGINO_DEVICE_TYPE_IPCAM=y
BR2_THINGINO_DEVICE_TYPE_IPCAM_PAN_TILT=y
BR2_THINGINO_RMEM_22=y
BR2_THINGINO_SDCARD=y
FLASH_SIZE_8=y
```

## configs/cameras/galayou_y4_t31n_sc2336_atbm6012b/galayou_y4_t31n_sc2336_atbm6012b_defconfig
```kconfig
# NAME: Galayou Y4 (T31N, SC2336, ATBM6012B)
# FRAG: soc-xburst1 toolchain-xburst1 ccache brand rootfs kernel system target uboot ssl
BR2_PACKAGE_WIFI=y
BR2_PACKAGE_WIFI_ATBM6012B=y
BR2_SENSOR_SC2336=y
BR2_SOC_INGENIC_T31N=y
BR2_AVPU_VPLL=y
BR2_ISP_CLK_150MHZ=y
BR2_ISP_CH0_PRE_DEQUEUE_TIME=y
BR2_ISP_CH0_PRE_DEQUEUE_TIME_VALUE=24
BR2_ISP_CH0_PRE_DEQUEUE_INTERRUPT_PROCESS=y
BR2_ISP_CH0_PRE_DEQUEUE_INTERRUPT_PROCESS_VALUE=0
BR2_PACKAGE_THINGINO_KOPT_MMC0=y
BR2_PACKAGE_THINGINO_KOPT_MMC0_1BIT=y
BR2_SENSOR_PARAMS="shvflip=1"
BR2_THINGINO_AUDIO=y
BR2_THINGINO_BUTTON=y
BR2_THINGINO_MOTORS=y
BR2_THINGINO_RMEM_22=y
BR2_THINGINO_SDCARD=y
FLASH_SIZE_8=y
```

## configs/cameras/ginzzu_op200_t31l/ginzzu_op200_t31l_defconfig
```kconfig
# NAME: Ginzzu OP200 (T31L, GC2083, SSV6155)
# MODULE: t31l_gc2083_ssv6155
BR2_AVPU_VPLL=y
BR2_ISP_CLK_200MHZ=y
BR2_ISP_PARAMS="isp_ch0_pre_dequeue_time=14 isp_ch0_pre_dequeue_interrupt_process=0 isp_ch0_pre_dequeue_valid_lines=540 isp_memopt=1"
BR2_SENSOR_PARAMS="data_interface=1 shvflip=1"
BR2_THINGINO_AUDIO=y
BR2_THINGINO_BUTTON=y
BR2_THINGINO_MOTORS=y
BR2_THINGINO_MOTORS_TCU=y
BR2_THINGINO_SDCARD=y
FLASH_SIZE_16=y
```

## configs/cameras/ginzzu_op200_t31l_gc2083_ssv6155/ginzzu_op200_t31l_gc2083_ssv6155_defconfig
```kconfig
# NAME: Ginzzu OP200 (T31L, GC2083, SSV6155)
# FRAG: soc-xburst1 toolchain-xburst1 ccache brand rootfs kernel system target uboot ssl
BR2_PACKAGE_WIFI=y
BR2_PACKAGE_WIFI_SSV6X5X=y
BR2_PACKAGE_WIFI_SSV6X5X_SV6155P=y
BR2_SENSOR_GC2083=y
BR2_SOC_INGENIC_T31L=y
BR2_AVPU_VPLL=y
BR2_ISP_CLK_200MHZ=y
BR2_ISP_CH0_PRE_DEQUEUE_TIME=y
BR2_ISP_CH0_PRE_DEQUEUE_TIME_VALUE=14
BR2_ISP_CH0_PRE_DEQUEUE_INTERRUPT_PROCESS=y
BR2_ISP_CH0_PRE_DEQUEUE_INTERRUPT_PROCESS_VALUE=0
BR2_ISP_CH0_PRE_DEQUEUE_VALID_LINES=y
BR2_ISP_CH0_PRE_DEQUEUE_VALID_LINES_VALUE=540
BR2_SENSOR_PARAMS="data_interface=1 shvflip=1"
BR2_THINGINO_AUDIO=y
BR2_THINGINO_BUTTON=y
BR2_THINGINO_MOTORS=y
BR2_THINGINO_MOTORS_TCU=y
BR2_THINGINO_SDCARD=y
FLASH_SIZE_16=y
```

## configs/cameras/gncc_gc2_t23n_sc2336_atbm6012bx/gncc_gc2_t23n_sc2336_atbm6012bx_defconfig
```kconfig
# NAME: GNCC GC2 (T23N, SC2336, ATBM6012BX)
# FRAG: soc-xburst1 toolchain-xburst1 ccache brand rootfs kernel system target uboot ssl
BR2_PACKAGE_WIFI=y
BR2_PACKAGE_WIFI_ATBM6012BX=y
BR2_SENSOR_SC2336=y
BR2_SOC_INGENIC_T23N=y
BR2_PACKAGE_THINGINO_KOPT_MMC0=y
BR2_PACKAGE_THINGINO_KOPT_MMC0_1BIT=y
BR2_THINGINO_AUDIO=y
BR2_THINGINO_BUTTON=y
BR2_THINGINO_SDCARD=y
FLASH_SIZE_8=y
```
