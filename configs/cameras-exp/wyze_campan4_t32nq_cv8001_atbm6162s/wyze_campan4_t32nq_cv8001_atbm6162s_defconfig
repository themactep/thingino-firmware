## configs/cameras/gncc_gc2_t31l_sc2336_atbm6012b/gncc_gc2_t31l_sc2336_atbm6012b_defconfig
```kconfig
# NAME: GNCC GC2 (T31L, SC2336, ATBM6012B)
# FRAG: soc-xburst1 toolchain-xburst1 ccache brand rootfs kernel system target uboot ssl
BR2_PACKAGE_WIFI=y
BR2_PACKAGE_WIFI_ATBM6012B=y
BR2_SENSOR_SC2336=y
BR2_SOC_INGENIC_T31L=y
BR2_AVPU_VPLL=y
BR2_ISP_CLK_220MHZ=y
BR2_ISP_CH0_PRE_DEQUEUE_TIME=y
BR2_ISP_CH0_PRE_DEQUEUE_TIME_VALUE=20
BR2_ISP_CH0_PRE_DEQUEUE_INTERRUPT_PROCESS=y
BR2_ISP_CH0_PRE_DEQUEUE_INTERRUPT_PROCESS_VALUE=0
BR2_ISP_CH0_PRE_DEQUEUE_VALID_LINES=y
BR2_ISP_CH0_PRE_DEQUEUE_VALID_LINES_VALUE=540
BR2_ISP_DAY_NIGHT_SWITCH_DROP_FRAME_NUM=y
BR2_ISP_DAY_NIGHT_SWITCH_DROP_FRAME_NUM_VALUE=6
BR2_PACKAGE_THINGINO_KOPT_MMC0=y
BR2_PACKAGE_THINGINO_KOPT_MMC0_PB_4BIT=y
BR2_SENSOR_PARAMS="shvflip=1"
BR2_THINGINO_AUDIO=y
BR2_THINGINO_BUTTON=y
BR2_THINGINO_SDCARD=y
FLASH_SIZE_8=y
```

## configs/cameras/hamedal_c20_t31a/hamedal_c20_t31a_defconfig
```kconfig
# NAME: Hamedal C20 (T31A, GC2053)
# MODULE: t31a_gc2053
BR2_AVPU_CLK_600MHZ=y
BR2_ISP_CLK_200MHZ=y
BR2_PACKAGE_THINGINO_KOPT_DWC2=y
BR2_PACKAGE_THINGINO_KOPT_DWC2_OTG=y
BR2_PACKAGE_USBNET=y
BR2_PACKAGE_USBNET_USB_DIRECT_NCM=y
BR2_SENSOR_PARAMS="sensor_max_fps=30 data_interface=1"
BR2_THINGINO_AUDIO=y
BR2_THINGINO_BUTTON=y
FLASH_SIZE_16=y
```

## configs/cameras/hamedal_c20_t31a_gc2053/hamedal_c20_t31a_gc2053_defconfig
```kconfig
# NAME: Hamedal C20 (T31A, GC2053)
# FRAG: soc-xburst1 toolchain-xburst1 ccache brand rootfs kernel system target uboot ssl
BR2_SENSOR_GC2053=y
BR2_SOC_INGENIC_T31A=y
BR2_AVPU_CLK_600MHZ=y
BR2_ISP_CLK_200MHZ=y
BR2_PACKAGE_THINGINO_KOPT_DWC2=y
BR2_PACKAGE_THINGINO_KOPT_DWC2_OTG=y
BR2_PACKAGE_USBNET=y
BR2_PACKAGE_USBNET_USB_DIRECT_NCM=y
BR2_SENSOR_PARAMS="sensor_max_fps=30 data_interface=1"
BR2_THINGINO_AUDIO=y
BR2_THINGINO_BUTTON=y
FLASH_SIZE_16=y
```
