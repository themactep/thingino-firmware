## configs/cameras-exp/camsoy_okc01_t31lc_gc1084_hi3881/camsoy_okc01_t31lc_gc1084_hi3881_defconfig
```kconfig
# NAME: Camsoy OKC01 (T31LC, GC1084, HI3881)
# FRAG: soc-xburst1 core
BR2_INGENIC_SOC_MODEL="t31lc"
BR2_PACKAGE_THINGINO_KOPT_DWC2=y
BR2_PACKAGE_THINGINO_KOPT_DWC2_OTG=y
BR2_PACKAGE_THINGINO_KOPT_MMC0=y
BR2_PACKAGE_THINGINO_KOPT_MMC0_PB_4BIT=y
BR2_PACKAGE_THINGINO_KOPT_MMC1=y
BR2_PACKAGE_THINGINO_KOPT_MMC1_PB_4BIT=y
BR2_PACKAGE_WIFI=y
BR2_PACKAGE_WIFI_HI3881=y
BR2_SENSOR_1_NAME="gc1084"
BR2_TARGET_UBOOT_FORMAT_CUSTOM_NAME="u-boot-with-spl-lzma.bin"
BR2_THINGINO_AUDIO=y
BR2_THINGINO_LED_B_GPIO=49
BR2_THINGINO_LED_R_GPIO=50
BR2_THINGINO_SDCARD=y
BR2_PACKAGE_THINGINO_SECUREBOOP=y
BR2_PACKAGE_THINGINO_SECUREBOOP_T31_MODULUS="5e900acb9022ff08e67210b47c13eeecfbd637fee361e0972a75f696a643a5d0bce1829ac847f60c7dae4e2bef9081e3e61b93295637b3cdd3408a6f6f0218bd167d3a9b9f50914c32593d0ce12ecd318e4e025fa0af0f15371dd8a6dd7158a93de613176bdfa5c388c40cd48af9ac4de75c976e08ed920de38baa0aa3aa16e08c8d1a5849acfd660bfc3ae5c314f3478de36068bd7a361002664dd100e579940e437b987f594f7a3a6451e936317d4a4c10eec2d3d630bae510522a23b101ade75c1bcf5e1fa0b4bc0bc059e647db85c0a842b3dee7f8de751e58425ee73a1ddb242710714d3459809ea23be5fc49e53b3b451bf257fe00bc46e2fbbda8f553"
FLASH_SIZE_MB=8
```

## configs/cameras-exp/cinnado_d1_t32lq_sc4336p_atbm6132u/cinnado_d1_t32lq_sc4336p_atbm6132u_defconfig
```kconfig
# NAME: Cinnado D1 (T32LQ, SC4336P, ATBM6132U)
# FRAG: soc-xburst1 core
BR2_INGENIC_SOC_MODEL="t32lq"
BR2_ISP_CLKA_400MHZ=y
BR2_ISP_CLKA_VPLL=y
BR2_ISP_CLKS_400MHZ=y
BR2_ISP_CLKS_VPLL=y
BR2_ISP_CLKV_400MHZ=y
BR2_ISP_CLKV_VPLL=y
BR2_ISP_CLK_225MHZ=y
BR2_ISP_CLK_MPLL=y
BR2_PACKAGE_THINGINO_KOPT_MMC0=y
BR2_PACKAGE_THINGINO_KOPT_MMC0_PB_4BIT=y
BR2_PACKAGE_THINGINO_UBOOT_FLASH_CONTROLLER_JZ_SFC=n
BR2_PACKAGE_THINGINO_UBOOT_FLASH_CONTROLLER_SFC0_NOR=y
BR2_PACKAGE_WIFI=y
BR2_PACKAGE_WIFI_ATBM6132U=y
BR2_SENSOR_1_NAME="sc4336p"
BR2_THINGINO_AUDIO=y
BR2_THINGINO_MOTORS=y
BR2_THINGINO_RMEM_MB=22
BR2_THINGINO_SDCARD=y
FLASH_SIZE_MB=16
KERNEL_VERSION_4=y
```

## configs/cameras-exp/eufy_t8416_t40xp_sc830_aic8800d40/eufy_t8416_t40xp_sc830_aic8800d40_defconfig
```kconfig
# NAME: Eufy T8416 (T40XP, SC830, AIC8800D40)
# FRAG: soc-xburst2 core
BR2_AVPU_CLK_600MHZ=y
BR2_AVPU_MPLL=y
BR2_INGENIC_SOC_MODEL="t40xp"
BR2_ISP_CLK_300MHZ=y
BR2_LINUX_KERNEL_EXT_THINGINO_KOPT=y
BR2_PACKAGE_THINGINO_RAPTOR_CONF_S1S0_FPS="20"
BR2_PACKAGE_THINGINO_RAPTOR_CONF_S1S0_HEIGHT="1296"
BR2_PACKAGE_THINGINO_RAPTOR_CONF_S1S0_NR_VBS="3"
BR2_PACKAGE_THINGINO_RAPTOR_CONF_S1S0_WIDTH="2304"
BR2_PACKAGE_THINGINO_RAPTOR_CONF_S1S1_FPS="20"
BR2_PACKAGE_THINGINO_RAPTOR_CONF_S1S1_NR_VBS="3"
BR2_PACKAGE_THINGINO_RAPTOR_CONF_SENSOR0_BOOT="4"
BR2_PACKAGE_THINGINO_RAPTOR_CONF_SENSOR0_HEIGHT="2160"
BR2_PACKAGE_THINGINO_RAPTOR_CONF_SENSOR0_I2C_ADAPTER="1"
BR2_PACKAGE_THINGINO_RAPTOR_CONF_SENSOR0_I2C_ADDR="0x30"
BR2_PACKAGE_THINGINO_RAPTOR_CONF_SENSOR0_MCLK="1"
BR2_PACKAGE_THINGINO_RAPTOR_CONF_SENSOR0_NAME="sc830ai"
BR2_PACKAGE_THINGINO_RAPTOR_CONF_SENSOR0_PWDN_GPIO="-1"
BR2_PACKAGE_THINGINO_RAPTOR_CONF_SENSOR0_RST_GPIO="91"
BR2_PACKAGE_THINGINO_RAPTOR_CONF_SENSOR0_VIDEO_INTERFACE="0"
BR2_PACKAGE_THINGINO_RAPTOR_CONF_SENSOR0_WIDTH="3840"
BR2_PACKAGE_THINGINO_RAPTOR_CONF_SENSOR1_BOOT="0"
BR2_PACKAGE_THINGINO_RAPTOR_CONF_SENSOR1_FPS="20"
BR2_PACKAGE_THINGINO_RAPTOR_CONF_SENSOR1_HEIGHT="1296"
BR2_PACKAGE_THINGINO_RAPTOR_CONF_SENSOR1_I2C_ADAPTER="3"
BR2_PACKAGE_THINGINO_RAPTOR_CONF_SENSOR1_I2C_ADDR="0x32"
BR2_PACKAGE_THINGINO_RAPTOR_CONF_SENSOR1_MCLK="2"
BR2_PACKAGE_THINGINO_RAPTOR_CONF_SENSOR1_NAME="sc3338"
BR2_PACKAGE_THINGINO_RAPTOR_CONF_SENSOR1_PWDN_GPIO="-1"
BR2_PACKAGE_THINGINO_RAPTOR_CONF_SENSOR1_RST_GPIO="92"
BR2_PACKAGE_THINGINO_RAPTOR_CONF_SENSOR1_VIDEO_INTERFACE="1"
BR2_PACKAGE_THINGINO_RAPTOR_CONF_SENSOR1_WIDTH="2304"
BR2_PACKAGE_THINGINO_RAPTOR_CONF_STREAM0_FPS="20"
BR2_PACKAGE_THINGINO_RAPTOR_CONF_STREAM0_NR_VBS="3"
BR2_PACKAGE_THINGINO_RAPTOR_CONF_STREAM1_FPS="20"
BR2_PACKAGE_THINGINO_RAPTOR_CONF_STREAM1_NR_VBS="3"
BR2_PACKAGE_USBNET=y
BR2_PACKAGE_USBNET_ASIX=y
BR2_PACKAGE_WIFI=y
BR2_PACKAGE_WIFI_AIC8800=y
BR2_PACKAGE_WIFI_AIC8800_SDIO=y
BR2_PACKAGE_WIFI_AIC8800_SDIO_8800D80=y
BR2_SENSOR_1_NAME="sc830ai"
BR2_SENSOR_2_NAME="sc3338"
BR2_THINGINO_AUDIO=y
BR2_THINGINO_BUTTON=y
BR2_THINGINO_IMAGE_SENSOR_QTY=2
BR2_THINGINO_LED_B_GPIO=46
BR2_THINGINO_LED_R_GPIO=65
BR2_THINGINO_MOTORS=y
BR2_THINGINO_NMEM_MB=22
BR2_THINGINO_RMEM_MB=170
BR2_THINGINO_SDCARD=y
FLASH_SIZE_MB=32
```

## configs/cameras-exp/galayou_g2_t31lc_sc2336_atbm6012bx/galayou_g2_t31lc_sc2336_atbm6012bx_defconfig
```kconfig
# NAME: Galayou G2 (T31LC, SC2336, ATBM6012BX)
# FRAG: soc-xburst1 core
BR2_INGENIC_SOC_MODEL="t31lc"
BR2_ISP_CH0_PRE_DEQUEUE_INTERRUPT_PROCESS=y
BR2_ISP_CH0_PRE_DEQUEUE_INTERRUPT_PROCESS_VALUE=0
BR2_ISP_CH0_PRE_DEQUEUE_TIME=y
BR2_ISP_CH0_PRE_DEQUEUE_TIME_VALUE=20
BR2_ISP_CH0_PRE_DEQUEUE_VALID_LINES=y
BR2_ISP_CH0_PRE_DEQUEUE_VALID_LINES_VALUE=540
BR2_ISP_CLK_220MHZ=y
BR2_ISP_DAY_NIGHT_SWITCH_DROP_FRAME_NUM=y
BR2_ISP_DAY_NIGHT_SWITCH_DROP_FRAME_NUM_VALUE=6
BR2_PACKAGE_THINGINO_KOPT=y
BR2_PACKAGE_THINGINO_KOPT_MMC0=y
BR2_PACKAGE_THINGINO_KOPT_MMC0_1BIT=y
BR2_PACKAGE_THINGINO_KOPT_MMC=y
BR2_PACKAGE_WIFI=y
BR2_PACKAGE_WIFI_ATBM6012BX=y
BR2_SENSOR_1_NAME="sc2336"
BR2_SENSOR_1_PARAMS="shvflip=1"
BR2_TARGET_UBOOT_FORMAT_CUSTOM_NAME="u-boot-with-spl-lzma.bin"
BR2_THINGINO_AUDIO=y
BR2_THINGINO_LED_B_ACTIVE_LOW=y
BR2_THINGINO_LED_B_GPIO=9
BR2_THINGINO_MOTORS=y
BR2_THINGINO_RMEM_MB=23
BR2_THINGINO_SDCARD=y
BR2_WIFI_PARAMS="wifi_bt_comb=1"
BR2_PACKAGE_THINGINO_SECUREBOOP=y
BR2_PACKAGE_THINGINO_SECUREBOOP_T31_MODULUS="5e900acb9022ff08e67210b47c13eeecfbd637fee361e0972a75f696a643a5d0bce1829ac847f60c7dae4e2bef9081e3e61b93295637b3cdd3408a6f6f0218bd167d3a9b9f50914c32593d0ce12ecd318e4e025fa0af0f15371dd8a6dd7158a93de613176bdfa5c388c40cd48af9ac4de75c976e08ed920de38baa0aa3aa16e08c8d1a5849acfd660bfc3ae5c314f3478de36068bd7a361002664dd100e579940e437b987f594f7a3a6451e936317d4a4c10eec2d3d630bae510522a23b101ade75c1bcf5e1fa0b4bc0bc059e647db85c0a842b3dee7f8de751e58425ee73a1ddb242710714d3459809ea23be5fc49e53b3b451bf257fe00bc46e2fbbda8f553"
FLASH_SIZE_MB=8
```

## configs/cameras-exp/jooan_w5u_t40nn_os02g10_ssv6256p/jooan_w5u_t40nn_os02g10_ssv6256p_defconfig
```kconfig
# NAME: Jooan W5U (T40NN, OS02G10, SSV6256P)
# FRAG: soc-xburst2 core
BR2_ETHERNET=y
BR2_INGENIC_SOC_MODEL="t40nn"
BR2_PACKAGE_WIFI=y
BR2_PACKAGE_WIFI_SSV6X5X=y
BR2_PACKAGE_WIFI_SSV6X5X_SV6256P=y
BR2_SENSOR_1_NAME="os02g10"
BR2_THINGINO_AUDIO=y
BR2_THINGINO_BUTTON=y
BR2_THINGINO_FLASH_NOR=y
BR2_THINGINO_LED_R_GPIO=103
BR2_THINGINO_SDCARD=y
FLASH_SIZE_MB=8
```

## configs/cameras-exp/noorio_t110_t41nq_gc4023_aic8800d/noorio_t110_t41nq_gc4023_aic8800d_defconfig
```kconfig
# NAME: Noorio T110 (T41NQ, GC4023, AIC8800 USB)
# FRAG: soc-xburst2 core
BR2_INGENIC_SOC_MODEL="t41nq"
BR2_LINUX_KERNEL_EXT_THINGINO_KOPT=y
BR2_PACKAGE_THINGINO_KOPT_MMC0=y
BR2_PACKAGE_THINGINO_KOPT_MMC0_PB_4BIT=y
BR2_PACKAGE_THINGINO_UBOOT_FLASH_CONTROLLER_JZ_SFC=n
BR2_PACKAGE_THINGINO_UBOOT_FLASH_CONTROLLER_SFC0_NOR=y
BR2_PACKAGE_WIFI=y
BR2_PACKAGE_WIFI_AIC8800=y
# BR2_PACKAGE_WIFI_AIC8800_SDIO is not set
BR2_PACKAGE_WIFI_AIC8800_USB=y
BR2_PACKAGE_WIFI_AIC8800_USB_8800=y
BR2_SENSOR_1_NAME="gc4023"
BR2_THINGINO_AUDIO=y
BR2_THINGINO_AUDIO_GPIO=63
BR2_THINGINO_BUTTON=y
BR2_THINGINO_LED_B_GPIO=73
BR2_THINGINO_LED_R_GPIO=75
BR2_THINGINO_MOTORS=y
BR2_THINGINO_NMEM_MB=8
BR2_THINGINO_SDCARD=y
# BR2_THINGINO_UBOOT_VERSION_2013_07 is not set
BR2_THINGINO_UBOOT_VERSION_2026_07=y
FLASH_SIZE_MB=32
```

## configs/cameras-exp/tptek_wor605_t41nq_gc5603_eth_rtl8733bu/tptek_wor605_t41nq_gc5603_eth+rtl8733bu_defconfig
```kconfig
# NAME: TPTEK WOR605 (T41NQ, GC5603, ETH, RTL8733BU)
# FRAG: soc-xburst2 core
BR2_ETHERNET=y
BR2_INGENIC_SOC_MODEL="t41nq"
BR2_LINUX_KERNEL_CONFIG_FRAGMENT_FILES="$(BR2_EXTERNAL_THINGINO_PATH)/configs/cameras-exp/tptek_wor605_t41nq_gc5603_eth+rtl8733bu/tptek.kernel.config"
BR2_PACKAGE_THINGINO_KOPT_DWC2=y
BR2_PACKAGE_THINGINO_KOPT_DWC2_WIFI_ONLY=y
BR2_PACKAGE_THINGINO_KOPT_MMC0=y
BR2_PACKAGE_THINGINO_KOPT_MMC0_PB_4BIT=y
BR2_PACKAGE_THINGINO_RAPTOR_CONF_SENSOR_I2C_ADAPTER="0"
BR2_PACKAGE_THINGINO_RAPTOR_CONF_SENSOR_I2C_ADDR="0x31"
BR2_PACKAGE_THINGINO_RAPTOR_CONF_SENSOR_MCLK="0"
BR2_PACKAGE_THINGINO_RAPTOR_CONF_SENSOR_PWDN_GPIO="19"
BR2_PACKAGE_THINGINO_RAPTOR_CONF_SENSOR_RST_GPIO="18"
BR2_PACKAGE_THINGINO_UBOOT_FLASH_CONTROLLER_JZ_SFC=n
BR2_PACKAGE_THINGINO_UBOOT_FLASH_CONTROLLER_SFC0_NOR=y
BR2_PACKAGE_WIFI=y
BR2_PACKAGE_WIFI_RTL8733BU=y
BR2_SENSOR_1_NAME="gc5603"
BR2_THINGINO_AUDIO=y
BR2_THINGINO_BUTTON=y
BR2_THINGINO_MOTORS=y
BR2_THINGINO_NMEM_MB=8
BR2_THINGINO_RMEM_MB=64
BR2_THINGINO_SDCARD=y
FLASH_SIZE_MB=16
```

## configs/cameras-exp/vanhua_s62i_t40nn_imx307_eth/vanhua_s62i_t40nn_imx307_eth_defconfig
```kconfig
# NAME: Vanhua S62I (T40NN, IMX307, ETH)
# FRAG: soc-xburst2 core
BR2_ETHERNET=y
BR2_INGENIC_SOC_MODEL="t40n"
BR2_PACKAGE_THINGINO_KOPT_DWC2=y
BR2_PACKAGE_THINGINO_KOPT_DWC2_OTG=y
BR2_SENSOR_1_NAME="imx307"
BR2_THINGINO_LED_R_GPIO=69
BR2_THINGINO_RMEM_MB=64
BR2_THINGINO_SDCARD=y
FLASH_SIZE_MB=16
```

## configs/cameras-exp/vanhua_s62i_t40xp_imx307_eth/vanhua_s62i_t40xp_imx307_eth_defconfig
```kconfig
# NAME: Vanhua S62I (T40XP, IMX307, ETH, SPI-NAND)
# FRAG: soc-xburst2 core flash-nand
BR2_ETHERNET=y
BR2_INGENIC_SOC_MODEL="t40xp"
BR2_PACKAGE_THINGINO_KOPT_DWC2=y
BR2_PACKAGE_THINGINO_KOPT_DWC2_OTG=y
BR2_SENSOR_1_NAME="imx307"
BR2_THINGINO_FLASH_NAND=y
BR2_THINGINO_LED_R_GPIO=69
BR2_THINGINO_RMEM_MB=64
BR2_THINGINO_SDCARD=y
FLASH_SIZE_MB=256
```

## configs/cameras-exp/wuuk_y0910_t41nq_sc4336p_atbm6031/wuuk_y0910_t41nq_sc4336p_atbm6031_defconfig
```kconfig
# NAME: WUUK Y0910 (T41NQ, SC4336P, ATBM6031, SPI-NAND)
# FRAG: soc-xburst2 core flash-nand
BR2_AVPU_CLK_550MHZ=y
BR2_AVPU_SCLKA=y
BR2_INGENIC_SOC_MODEL="t41nq"
BR2_PACKAGE_THINGINO_UBOOT_FLASH_CONTROLLER_SFC0_NAND=y
BR2_PACKAGE_WIFI=y
BR2_PACKAGE_WIFI_ATBM6031=y
BR2_SENSOR_1_NAME="sc4336p"
BR2_THINGINO_AUDIO=y
BR2_THINGINO_BUTTON=y
BR2_THINGINO_FLASH_NAND=y
BR2_THINGINO_NMEM_MB=8
BR2_THINGINO_RMEM_MB=20
BR2_THINGINO_SDCARD=y
FLASH_SIZE_MB=128
```

## configs/cameras-exp/zintronic_ikpw530tv1_t41nq_gc5603_eth+rtl8733bu/zintronic_ikpw530tv1_t41nq_gc5603_eth+rtl8733bu_defconfig
```kconfig
# NAME: Zintronic IKPW530TV1 (T41NQ, GC5603, ETH, RTL8733BU)
# FRAG: soc-xburst2 core
BR2_ETHERNET=y
BR2_INGENIC_SOC_MODEL="t41nq"
BR2_PACKAGE_THINGINO_UBOOT_FLASH_CONTROLLER_JZ_SFC=n
BR2_PACKAGE_THINGINO_UBOOT_FLASH_CONTROLLER_SFC0_NOR=y
BR2_PACKAGE_WIFI=y
BR2_PACKAGE_WIFI_RTL8733BU=y
BR2_SENSOR_1_NAME="gc5603"
BR2_THINGINO_AUDIO=y
BR2_THINGINO_NMEM_MB=8
BR2_THINGINO_RMEM_MB=22
BR2_THINGINO_SDCARD=y
FLASH_SIZE_MB=16
```

## configs/cameras-secureboot/wyze_campan3_t31x_gc2053_atbm6031_mmc/wyze_campan3_t31x_gc2053_atbm6031_mmc_defconfig
```kconfig
# NAME: Wyze Cam Pan v3 MMC Boot (T31X, GC2053, ATBM6031)
# FRAG: soc-xburst1 core
BR2_AVPU_CLK_600MHZ=y
BR2_INGENIC_SOC_MODEL="t31x"
BR2_ISP_CLK_200MHZ=y
BR2_PACKAGE_THINGINO_KOPT_DWC2=y
BR2_PACKAGE_THINGINO_KOPT_DWC2_OTG=y
BR2_PACKAGE_THINGINO_KOPT_MMC0=y
BR2_PACKAGE_THINGINO_KOPT_MMC0_BOOT=y
BR2_PACKAGE_THINGINO_KOPT_MMC0_PB_4BIT=y
BR2_PACKAGE_THINGINO_KOPT_MMC1=y
BR2_PACKAGE_THINGINO_KOPT_MMC1_PB_4BIT=y
BR2_PACKAGE_THINGINO_UBOOT_ROOT="/dev/mmcblk0p2"
BR2_PACKAGE_THINGINO_UBOOT_ROOTFSTYPE="ext4"
BR2_PACKAGE_WIFI=y
BR2_PACKAGE_WIFI_ATBM6031=y
BR2_PACKAGE_WYZE_ACCESSORY=y
BR2_PACKAGE_WYZE_ACCESSORY_CAR=y
BR2_PACKAGE_WYZE_ACCESSORY_SPOTLIGHT=y
BR2_SENSOR_1_NAME="gc2053"
BR2_SENSOR_1_PARAMS="sensor_max_fps=30 data_interface=1"
BR2_TARGET_ROOTFS_EXT2=y
BR2_TARGET_ROOTFS_EXT2_4=y
BR2_TARGET_ROOTFS_EXT2_MKFS_OPTIONS="-O ^metadata_csum,^64bit"
BR2_TARGET_ROOTFS_EXT2_SIZE="64M"
BR2_TARGET_UBOOT_BOARDNAME="isvp_t31x_msc0"
BR2_TARGET_UBOOT_BOARD_DEFCONFIG="isvp_t31x_msc0"
BR2_TARGET_UBOOT_FORMAT_CUSTOM_NAME="u-boot-with-tpl-mmc-lzma.bin"
BR2_THINGINO_AUDIO=y
BR2_THINGINO_BUTTON=y
BR2_THINGINO_MOTORS=y
BR2_THINGINO_PWM_ENABLE=y
BR2_THINGINO_SDCARD=y
FLASH_SIZE_MB=16
KERNEL_VERSION_3=y
```

## configs/cameras-testing/qemu_a1n/qemu_a1n_defconfig
```kconfig
# NAME: QEMU A1N (virtual WiFi)
# FRAG: soc-xburst2 core
BR2_INGENIC_SOC_MODEL="a1n"
BR2_LINUX_KERNEL_EXT_THINGINO_KOPT=y
BR2_THINGINO_DEV_NVR=y
BR2_PACKAGE_THINGINO_STREAMER_NONE=y
BR2_PACKAGE_HOST_QEMU_INGENIC=y
BR2_PACKAGE_WIFI=y
BR2_PACKAGE_WIFI_HWSIM=y
FLASH_SIZE_MB=16
```

## configs/cameras-testing/qemu_a1n_usbncm/qemu_a1n_usbncm_defconfig
```kconfig
# NAME: QEMU A1N (Ethernet, USB direct NCM server)
# FRAG: soc-xburst2 core
BR2_ETHERNET=y
BR2_INGENIC_SOC_MODEL="a1n"
BR2_LINUX_KERNEL_EXT_THINGINO_KOPT=y
BR2_PACKAGE_THINGINO_KOPT_JZ_MAC=y
BR2_THINGINO_DEV_NVR=y
BR2_PACKAGE_THINGINO_STREAMER_NONE=y
BR2_PACKAGE_THINGINO_KOPT_DWC2=y
BR2_PACKAGE_THINGINO_KOPT_DWC2_DUAL_ROLE=y
BR2_PACKAGE_USBNET=y
BR2_PACKAGE_USBNET_USB_DIRECT_NCM=y
BR2_PACKAGE_HOST_QEMU_INGENIC=y
FLASH_SIZE_MB=16
```

## configs/cameras-testing/qemu_t10n/qemu_t10n_defconfig
```kconfig
# NAME: QEMU T10N (virtual WiFi)
# FRAG: soc-xburst1 core
BR2_INGENIC_SOC_MODEL="t10n"
BR2_SENSOR_1_NAME="jxh42"
BR2_THINGINO_AUDIO=y
BR2_THINGINO_RMEM_MB=14
BR2_PACKAGE_HOST_QEMU_INGENIC=y
BR2_PACKAGE_THINGINO_KOPT_JZ_MAC=y
BR2_PACKAGE_THINGINO_KOPT_JZ_MAC_V13=y
BR2_PACKAGE_WIFI=y
BR2_PACKAGE_WIFI_HWSIM=y
FLASH_SIZE_MB=16
```

## configs/cameras-testing/qemu_t23n/qemu_t23n_defconfig
```kconfig
# NAME: QEMU T23N (virtual WiFi)
# FRAG: soc-xburst1 core
BR2_INGENIC_SOC_MODEL="t23n"
BR2_SENSOR_1_NAME="sc2336"
BR2_THINGINO_AUDIO=y
BR2_THINGINO_RMEM_MB=20
BR2_PACKAGE_HOST_QEMU_INGENIC=y
BR2_PACKAGE_WIFI=y
BR2_PACKAGE_WIFI_HWSIM=y
FLASH_SIZE_MB=16
```

## configs/cameras-testing/qemu_t30x/qemu_t30x_defconfig
```kconfig
# NAME: QEMU T30X (virtual WiFi)
# FRAG: soc-xburst1 core
BR2_INGENIC_SOC_MODEL="t30x"
BR2_SENSOR_1_NAME="sc4236"
BR2_THINGINO_AUDIO=y
BR2_THINGINO_RMEM_MB=20
BR2_PACKAGE_HOST_QEMU_INGENIC=y
BR2_PACKAGE_THINGINO_KOPT_JZ_MAC=y
BR2_PACKAGE_THINGINO_KOPT_JZ_MAC_V13=y
BR2_PACKAGE_WIFI=y
BR2_PACKAGE_WIFI_HWSIM=y
FLASH_SIZE_MB=16
```

## configs/cameras-testing/qemu_t31x/qemu_t31x_defconfig
```kconfig
# NAME: QEMU T31X (virtual WiFi)
# FRAG: soc-xburst1 core
BR2_INGENIC_SOC_MODEL="t31x"
BR2_PACKAGE_HOST_QEMU_INGENIC=y
BR2_PACKAGE_WIFI=y
BR2_PACKAGE_WIFI_HWSIM=y
BR2_SENSOR_1_NAME="gc2053"
BR2_THINGINO_AUDIO=y
BR2_THINGINO_RMEM_MB=20
FLASH_SIZE_MB=16
KERNEL_VERSION_3=y
```

## configs/cameras-testing/qemu_t32nq/qemu_t32nq_defconfig
```kconfig
# NAME: QEMU T32NQ (virtual WiFi)
# FRAG: soc-xburst1 core
BR2_INGENIC_SOC_MODEL="t32nq"
BR2_PACKAGE_HOST_QEMU_INGENIC=y
BR2_PACKAGE_THINGINO_UBOOT_FLASH_CONTROLLER_JZ_SFC=n
BR2_PACKAGE_THINGINO_UBOOT_FLASH_CONTROLLER_SFC0_NOR=y
BR2_PACKAGE_WIFI=y
BR2_PACKAGE_WIFI_HWSIM=y
BR2_SENSOR_1_NAME="cv8001"
BR2_THINGINO_AUDIO=y
BR2_THINGINO_RMEM_MB=20
FLASH_SIZE_MB=16
```

## configs/cameras-testing/qemu_t40nn/qemu_t40nn_defconfig
```kconfig
# NAME: QEMU T40NN (virtual WiFi)
# FRAG: soc-xburst2 core
BR2_ETHERNET=y
BR2_INGENIC_SOC_MODEL="t40n"
BR2_PACKAGE_THINGINO_KOPT_DWC2=y
BR2_PACKAGE_THINGINO_KOPT_DWC2_OTG=y
BR2_SENSOR_1_NAME="imx307"
BR2_PACKAGE_HOST_QEMU_INGENIC=y
BR2_THINGINO_RMEM_MB=64
BR2_THINGINO_SDCARD=y
BR2_PACKAGE_WIFI=y
BR2_PACKAGE_WIFI_HWSIM=y
FLASH_SIZE_MB=16
```
