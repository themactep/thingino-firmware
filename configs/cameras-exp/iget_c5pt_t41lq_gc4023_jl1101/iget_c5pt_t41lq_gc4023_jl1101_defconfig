## configs/cameras-exp/wyze_cam3_t31x_gc2053_rtl8189ftv_uclibc/wyze_cam3_t31x_gc2053_rtl8189ftv_defconfig
```kconfig
BR2_mipsel=y
BR2_mips_xburst=y
# BR2_MIPS_SOFT_FLOAT is not set
BR2_MIPS_FP32_MODE_32=y
BR2_TOOLCHAIN_EXTERNAL=y
BR2_TOOLCHAIN_EXTERNAL_CUSTOM=y
BR2_TOOLCHAIN_EXTERNAL_PATH="/home/paul/dev/mipsel-thingino-linux-uclibc_sdk-buildroot"
BR2_TOOLCHAIN_EXTERNAL_GCC_14=y
BR2_TOOLCHAIN_EXTERNAL_HEADERS_3_10=y
# BR2_TOOLCHAIN_EXTERNAL_HAS_THREADS_DEBUG is not set
BR2_TOOLCHAIN_EXTERNAL_CXX=y
BR2_TARGET_LDFLAGS="-z max-page-size=0x1000"
BR2_CCACHE=y
BR2_CCACHE_DIR="$(HOME)/.ccache"
BR2_STRIP_EXCLUDE_FILES="libimp.so libalog.so libsysutils.so"
BR2_OPTIMIZE_S=y
BR2_GLOBAL_PATCH_DIR="$(BR2_EXTERNAL)/package/all-patches"
BR2_REPRODUCIBLE=y
BR2_PER_PACKAGE_DIRECTORIES=y
BR2_TARGET_GENERIC_HOSTNAME="thingino-$(SOC_MODEL)"
BR2_TARGET_GENERIC_ISSUE="Welcome to Thingino firmware"
BR2_TARGET_GENERIC_PASSWD_SHA512=y
BR2_ROOTFS_MERGED_USR=y
BR2_TARGET_GENERIC_ROOT_PASSWD="root"
BR2_SYSTEM_DEFAULT_PATH="/bin:/sbin:/usr/bin:/usr/sbin"
BR2_ROOTFS_OVERLAY="$(BR2_EXTERNAL)/overlay/lower"
BR2_ROOTFS_POST_BUILD_SCRIPT="$(BR2_EXTERNAL)/scripts/rootfs_script.sh"
BR2_LINUX_KERNEL_CUSTOM_GIT=y
BR2_LINUX_KERNEL_CUSTOM_REPO_URL="$(KERNEL_SITE)"
BR2_LINUX_KERNEL_CUSTOM_REPO_VERSION="$(KERNEL_HASH)"
BR2_LINUX_KERNEL_USE_CUSTOM_CONFIG=y
BR2_LINUX_KERNEL_CUSTOM_CONFIG_FILE="$(BR2_EXTERNAL)/board/ingenic/$(INGENIC_ARCH)/kernel/$(KERNEL_VERSION)/$(SOC_FAMILY).generic.config"
BR2_LINUX_KERNEL_LZMA=y
BR2_PACKAGE_BUSYBOX_CONFIG="$(BR2_EXTERNAL)/package/busybox/busybox.config"
BR2_PACKAGE_GDB=y
BR2_PACKAGE_MDNSD=y
BR2_PACKAGE_MDNSD_HTTP_SERVICE=y
# BR2_PACKAGE_MDNSD_SSH_SERVICE is not set
BR2_PACKAGE_ODHCP6C=y
BR2_PACKAGE_WIREGUARD_LINUX_COMPAT=y
BR2_PACKAGE_WIREGUARD_TOOLS=y
BR2_TARGET_ROOTFS_SQUASHFS=y
BR2_TARGET_ROOTFS_SQUASHFS4_XZ=y
BR2_TARGET_ROOTFS_SQUASHFS_EXTREME_COMP=y
BR2_PACKAGE_HOST_MTD=y
BR2_PACKAGE_HOST_UBOOT_TOOLS_ENVIMAGE=y
BR2_PACKAGE_HOST_UBOOT_TOOLS_ENVIMAGE_SOURCE="$(O)/uenv.txt"
BR2_PACKAGE_HOST_UBOOT_TOOLS_ENVIMAGE_SIZE="32768"
BR2_SOC_INGENIC_T31X=y
BR2_AVPU_CLK_600MHZ=y
BR2_AVPU_VPLL=y
BR2_ISP_CLK_200MHZ=y
BR2_PACKAGE_THINGINO_KOPT_DWC2=y
BR2_PACKAGE_THINGINO_KOPT_MMC0=y
BR2_PACKAGE_THINGINO_KOPT_MMC1=y
BR2_PACKAGE_THINGINO_KOPT_MMC1_PB_4BIT=y
BR2_PACKAGE_THINGINO_DIAG=y
BR2_PACKAGE_THINGINO_GPIO=y
BR2_PACKAGE_THINGINO_LEDD=y
BR2_PACKAGE_THINGINO_SYSTEM=y
BR2_PACKAGE_THINGINO_SYSUPGRADE=y
BR2_PACKAGE_THINGINO_UBOOT_BOARDNAME="$(UBOOT_BOARDNAME)"
BR2_PACKAGE_THINGINO_UBOOT_CUSTOM_GIT=y
BR2_PACKAGE_THINGINO_UBOOT_CUSTOM_REPO_URL="$(UBOOT_REPO)"
BR2_PACKAGE_THINGINO_UBOOT_CUSTOM_REPO_VERSION="$(UBOOT_REPO_VERSION)"
BR2_PACKAGE_THINGINO_UBOOT_NEEDS_LZOP=y
# BR2_PACKAGE_THINGINO_UBOOT_FORMAT_BIN is not set
BR2_PACKAGE_THINGINO_UBOOT_FORMAT_CUSTOM=y
BR2_PACKAGE_THINGINO_UBOOT_FORMAT_CUSTOM_NAME="u-boot-lzo-with-spl.bin"
BR2_PACKAGE_THINGINO_UBOOT_EXTERNAL_ENV_ENABLE=y
BR2_PACKAGE_THINGINO_UBOOT_CUSTOM_MAKEOPTS="-j1"
BR2_PACKAGE_THINGINO_UBOOT_ROOT="/dev/mtdblock4"
BR2_PACKAGE_THINGINO_UBOOT_ROOTFSTYPE="squashfs"
BR2_PACKAGE_THINGINO_UBOOT_INIT="/init"
BR2_PACKAGE_THINGINO_UBOOT_MTDPARTS="setenv mtdparts mtdparts=$(UBOOT_FLASH_CONTROLLER):256k(boot),32k(env),224k(config),${kern_size_dec}(kernel),${rootfs_size}(rootfs),-(rootfs_data)${update}"
BR2_PACKAGE_THINGINO_UBOOT_BOOTARGS="setenv bootargs mem=${osmem} rmem=${rmem}$(UBOOT_ISPMEM)$(UBOOT_NMEM)console=${serialport},${baudrate}n8 panic=${panic_timeout} root=${root} rootfstype=${rootfstype} init=${init} \\${mtdparts}"
BR2_PACKAGE_THINGINO_UBOOT_BOOTCMD="sf probe-alt;sq probe-alt;run mtdparts;run bootargs;sf read ${baseaddr} ${kern_addr} ${kern_size};bootm ${baseaddr}"
BR2_PACKAGE_THINGINO_STREAMER=y
BR2_PACKAGE_THINGINO_MOSQUITTO=y
BR2_PACKAGE_WIFI=y
BR2_PACKAGE_WIFI_RTL8189FS=y
#BR2_PACKAGE_WYZE_ACCESSORY is not set
#BR2_PACKAGE_WYZE_ACCESSORY_SPOTLIGHT is not set
#BR2_PACKAGE_WYZE_ACCESSORY_CAR is not set
BR2_PACKAGE_SELECT_STRACE=y
BR2_THINGINO_AUDIO=y
BR2_SENSOR_GC2053=y
BR2_SENSOR_PARAMS="sensor_max_fps=30 data_interface=1"
BR2_THINGINO_DEV_PACKAGES=y
BR2_THINGINO_AUDIO_DMIC=y
BR2_THINGINO_BUTTON=y
BR2_THINGINO_PWM_ENABLE=y
BR2_THINGINO_SDCARD=y
FLASH_SIZE_16=y
```

## configs/cameras-exp/wyze_cam3pro_nor_t40xp_gc4653_rtl8192fs/wyze_cam3pro_nor_t40xp_gc4653_rtl8192fs_defconfig
```kconfig
# NAME: Wyze Cam v3 Pro (T40XP, GC4653, RTL8192FS)
# FRAG: soc-xburst2 toolchain-xburst2 ccache brand rootfs kernel system target uboot ssl
BR2_AVPU_CLK_400MHZ=y
BR2_AVPU_VPLL=y
BR2_ETHERNET=y
BR2_ISP_CLK_200MHZ=y
BR2_LINUX_KERNEL_EXT_THINGINO_KOPT=y
BR2_LINUX_KERNEL_EXT_THINGINO_KOPT_DTS=y
BR2_LINUX_KERNEL_EXT_THINGINO_KOPT_DTS_WYZEC3P=y
BR2_PACKAGE_WIFI=y
BR2_PACKAGE_WIFI_RTL8192FS=y
BR2_SENSOR_1_NAME="gc4653"
BR2_SOC_INGENIC_T40XP=y
BR2_THINGINO_AUDIO=y
BR2_THINGINO_BUTTON=y
BR2_THINGINO_SDCARD=y
FLASH_NOR=y
FLASH_SIZE_MB=32
```

## configs/cameras-exp/wyze_cam3pro_t40xp/wyze_cam3pro_t40xp_defconfig
```kconfig
# NAME: Wyze Cam V3 Pro (T40XP,  GC4653, RTL8192FS)
# MODULE: t40xp_gc4653_rtl8192fs
BR2_THINGINO_AUDIO=y
BR2_THINGINO_BUTTON=y
BR2_THINGINO_SDCARD=y
FLASH_SIZE_128=y
FLASH_NAND=y
```

## configs/cameras-exp/wyze_cam3pro_t40xp_gc4653_rtl8192fs/wyze_cam3pro_t40xp_gc4653_rtl8192fs_defconfig
```kconfig
# NAME: Wyze Cam v3 Pro (T40XP, GC4653, RTL8192FS)
# FRAG: soc-xburst2 core ssl flash-nand
BR2_AVPU_CLK_400MHZ=y
BR2_AVPU_VPLL=y
BR2_ETHERNET=y
BR2_ISP_CLK_200MHZ=y
BR2_LINUX_KERNEL_EXT_THINGINO_KOPT=y
BR2_LINUX_KERNEL_EXT_THINGINO_KOPT_DTS=y
BR2_LINUX_KERNEL_EXT_THINGINO_KOPT_DTS_WYZEC3P=y
BR2_PACKAGE_WIFI=y
BR2_PACKAGE_WIFI_RTL8192FS=y
BR2_PACKAGE_THINGINO_RAPTOR_CONF_SENSOR_NAME="gc4653"
BR2_PACKAGE_THINGINO_RAPTOR_CONF_SENSOR_I2C_ADDR="0x29"
BR2_PACKAGE_THINGINO_RAPTOR_CONF_SENSOR_I2C_ADAPTER="1"
BR2_PACKAGE_THINGINO_RAPTOR_CONF_SENSOR_RST_GPIO="91"
BR2_PACKAGE_THINGINO_RAPTOR_CONF_SENSOR_MCLK="1"
BR2_PACKAGE_THINGINO_RAPTOR_CONF_SENSOR_VIDEO_INTERFACE="0"
BR2_SENSOR_1_NAME="gc4653"
BR2_INGENIC_SOC_MODEL="t40xp"
BR2_THINGINO_RMEM_MB=128
BR2_THINGINO_NMEM_MB=28
BR2_THINGINO_AUDIO=y
BR2_THINGINO_BUTTON=y
BR2_THINGINO_SDCARD=y
BR2_THINGINO_FLASH_NAND=y
FLASH_SIZE_MB=128
```

## configs/cameras-exp/wyze_cam4_t41nq_os04d10_atbm6062s/wyze_cam4_t41nq_os04d10_atbm6062s_defconfig
```kconfig
# NAME: Wyze Cam 4 (T41NQ, OS04D10, ATBM6062S)
# FRAG: soc-xburst2 core ssl
BR2_AVPU_SCLKA=y
BR2_AVPU_CLK_550MHZ=y
BR2_INGENIC_SOC_MODEL="t41nq"
BR2_PACKAGE_WIFI=y
BR2_PACKAGE_WIFI_ATBM6062S=y
BR2_SENSOR_1_NAME="os04d10"
BR2_THINGINO_AUDIO=y
BR2_THINGINO_AUDIO_GPIO=63
BR2_THINGINO_BUTTON=y
BR2_THINGINO_RMEM_MB=20
BR2_THINGINO_NMEM_MB=8
BR2_THINGINO_SDCARD=y
FLASH_SIZE_MB=16
BR2_PACKAGE_THINGINO_UBOOT_FLASH_CONTROLLER_JZ_SFC=n
BR2_PACKAGE_THINGINO_UBOOT_FLASH_CONTROLLER_SFC0_NOR=y
BR2_LINUX_KERNEL_EXT_THINGINO_KOPT=y
BR2_LINUX_KERNEL_EXT_THINGINO_KOPT_DTS=y
BR2_LINUX_KERNEL_EXT_THINGINO_KOPT_DTS_WYZEV4=y
```
