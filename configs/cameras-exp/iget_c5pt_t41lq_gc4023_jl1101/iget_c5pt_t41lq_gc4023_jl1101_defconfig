## configs/cameras-exp/iget_c5pt_t41lq_gc4023_jl1101/iget_c5pt_t41lq_gc4023_jl1101_defconfig
```kconfig
# NAME: Vanhua T55A (T41LQ, GC5603, ETH)
# FRAG: soc-xburst2 ccache brand rootfs kernel system target uboot ssl
BR2_THINGINO_TOOLCHAIN_TYPE_EXTERNAL=y
BR2_THINGINO_TOOLCHAIN_GCC_15=y
BR2_THINGINO_TOOLCHAIN_LIBC_MUSL=y
BR2_ETHERNET=y
BR2_SENSOR_GC4023=y
BR2_SENSOR_1_NAME=gc4023
BR2_INGENIC_SOC_MODEL="t41lq"
BR2_PACKAGE_THINGINO_UBOOT_FLASH_CONTROLLER_JZ_SFC=n
BR2_PACKAGE_THINGINO_UBOOT_FLASH_CONTROLLER_SFC0_NOR=y
BR2_THINGINO_AUDIO=y
BR2_THINGINO_BUTTON=y
BR2_THINGINO_RMEM_MB=22
BR2_THINGINO_NMEM_MB=8
FLASH_SIZE_MB=16
BR2_PACKAGE_THINGINO_UBOOT_SD_ENABLE=y
BR2_LINUX_KERNEL_EXT_THINGINO_KOPT=y
BR2_LINUX_KERNEL_EXT_THINGINO_KOPT_DTS=y
BR2_LINUX_KERNEL_EXT_THINGINO_KOPT_DTS_IGETC5PT=y

BR2_PACKAGE_THINGINO_UBOOT_PHY_RESET_AFTER_CONFIG=y
BR2_PACKAGE_THINGINO_UBOOT_GPIO_PHY_RESET=60
BR2_PACKAGE_THINGINO_UBOOT_CUSTOM_DTS_PATH=$(BR2_EXTERNAL_THINGINO_PATH)/board/ingenic/dts/iget_c5pt_t41lq.dts
BR2_PACKAGE_THINGINO_UBOOT_CUSTOM_GIT=y
BR2_PACKAGE_THINGINO_UBOOT_CUSTOM_REPO_URL=https://github.com/LukasMojzis/ingenic-u-boot-xburst2
```

## configs/cameras-exp/ingenic_k3_100_c100_gc2053_bcmdhd_ap6214a/ingenic_k3_100_c100_gc2053_bcmdhd_ap6214a_defconfig
```kconfig
# NAME: Ingenic K3 100 EVB (C100, GC2053, SYN4343)
# FRAG: soc-xburst1 toolchain-xb1-gcc14-glibc-br ccache brand rootfs kernel system target uboot ssl
BR2_PACKAGE_WIFI=y
BR2_PACKAGE_WIFI_BCMDHD_AP6214A=y
BR2_SENSOR_GC2053=y
BR2_SOC_INGENIC_C100=y
BR2_AVPU_CLK_600MHZ=y
BR2_ISP_CLK_200MHZ=y
BR2_PACKAGE_THINGINO_KOPT_DWC2=y
BR2_PACKAGE_THINGINO_KOPT_DWC2_OTG=y
BR2_PACKAGE_THINGINO_KOPT_MMC0=y
BR2_PACKAGE_THINGINO_KOPT_MMC0_PB_4BIT=y
BR2_PACKAGE_THINGINO_KOPT_MMC1=y
BR2_PACKAGE_THINGINO_KOPT_MMC1_PB_4BIT=y
BR2_PACKAGE_THINGINO_UBOOT_BOARDNAME="isvp_c100_sfcnor_msc1"
BR2_THINGINO_AUDIO=y
BR2_THINGINO_AUDIO_DMIC=y
BR2_THINGINO_RMEM_64=y
FLASH_SIZE_16=y
#BR2_PACKAGE_USBNET=y
#BR2_PACKAGE_USBNET_USB_DIRECT_NCM=y
KERNEL_VERSION_4=y
```

## configs/cameras-exp/jooan_w8u_t23n_sc2336_atbm6132u/jooan_w8u_t23n_sc2336_atbm6132u_defconfig
```kconfig
# NAME: Jooan W8U (T23N, SC2336P, ATBM6132U)
# MODULE: t23n_sc2336ps0+sc2336ps1_atbm6132u
BR2_ISP_CLK_300MHZ=y
BR2_ISP_DIRECT_MODE_2=y
BR2_ISP_IVDC_MEM_LINE=y
BR2_ISP_IVDC_MEM_LINE_VALUE=540
BR2_PACKAGE_THINGINO_KOPT_MMC0=y
BR2_PACKAGE_THINGINO_KOPT_MMC0_PB_4BIT=y
BR2_THINGINO_AUDIO=y
BR2_THINGINO_BUTTON=y
BR2_THINGINO_MOTORS=y
BR2_THINGINO_PWM_ENABLE=y
BR2_THINGINO_SDCARD=y
FLASH_SIZE_8=y
```

## configs/cameras-exp/kiwibit_bc111_t23zn_unk_aiw4211l/kiwibit_bc111_t23zn_unk_aiw4211l_defconfig
```kconfig
# NAME: Kiwibit BC111 (T23ZN, unknown, AiW4211L)
# FRAG: soc-xburst1 core ssl
#
# SoC:    Ingenic T23ZN, XBurst1 MIPS32 R1, 64MB RAM (46M+18M split)
# Sensor: unknown
# WiFi:   Aichtech AiW4211L, SDIO
# Flash:  16MB NOR SPI
# UART:   ttyS1

BR2_INGENIC_SOC_MODEL="t23zn"
BR2_ISP_CLKA_600MHZ=y
BR2_ISP_CLKA_SCLKA=y
BR2_ISP_CLK_200MHZ=y
BR2_ISP_CLK_SCLKA=y
BR2_ISP_PRINT_LEVEL_0=y
BR2_LINUX_KERNEL_CONFIG_FRAGMENT_FILES="$(BR2_EXTERNAL_THINGINO_PATH)/configs/cameras/kiwibit_bc111_t23zn_unk_aiw4211l/kernel.config"
BR2_PACKAGE_THINGINO_KOPT_MMC0=y
BR2_PACKAGE_THINGINO_KOPT_MMC0_PB_4BIT=y
#BR2_PACKAGE_THINGINO_WPA_SUPPLICANT_WEXT=y
BR2_PACKAGE_WIFI=y
#BR2_PACKAGE_WIFI_ATBM6461=y
#BR2_SENSOR_1_NAME="os02g10"
BR2_THINGINO_AUDIO=y
BR2_THINGINO_AUDIO_GPIO=63
BR2_THINGINO_RMEM_MB=18
BR2_THINGINO_SDCARD=y
FLASH_SIZE_MB=16
```

## configs/cameras-exp/longplus_x07_t31n_gc2063_rtl8189ftv/longplus_x07_t31n_gc2063_rtl8189ftv_defconfig
```kconfig
# NAME: LongPlus X07 (T31N, GC2063, RTL8189FTV)
# FRAG: soc-xburst1 toolchain-xburst1 ccache brand rootfs kernel system target uboot ssl
BR2_PACKAGE_WIFI=y
BR2_PACKAGE_WIFI_RTL8189FS=y
BR2_SENSOR_GC2063=y
BR2_SOC_INGENIC_T31N=y
BR2_AVPU_VPLL=y
BR2_PACKAGE_THINGINO_KOPT_DWC2=y
BR2_PACKAGE_THINGINO_KOPT_DWC2_OTG=y
BR2_PACKAGE_THINGINO_KOPT_MMC0=y
BR2_PACKAGE_THINGINO_KOPT_MMC0_PB_4BIT=y
BR2_PACKAGE_THINGINO_KOPT_MMC1=y
BR2_PACKAGE_THINGINO_KOPT_MMC1_PB_4BIT=y
BR2_THINGINO_AUDIO=y
BR2_THINGINO_BUTTON=y
BR2_THINGINO_MOTORS=y
BR2_THINGINO_RMEM_32=y
BR2_THINGINO_SDCARD=y
FLASH_SIZE_16=y
```

## configs/cameras-exp/noname_green_t10_ov9712_ap6181/noname_green_t10_ov9712_ap6181_defconfig
```kconfig
# NAME: Noname Green (T10, OV9712, AP6181)
# FRAG: soc-xburst1 ccache brand rootfs kernel system target uboot ssl
BR2_THINGINO_TOOLCHAIN_TYPE_EXTERNAL=y
BR2_THINGINO_TOOLCHAIN_GCC_15=y
BR2_THINGINO_TOOLCHAIN_LIBC_MUSL=y
BR2_PACKAGE_GADGET_SERIAL=y
BR2_PACKAGE_THINGINO_KOPT=y
BR2_PACKAGE_THINGINO_KOPT_DWC2=y
BR2_PACKAGE_THINGINO_KOPT_DWC2_OTG=y
BR2_PACKAGE_THINGINO_KOPT_MMC0=y
BR2_PACKAGE_THINGINO_KOPT_MMC0_PB_4BIT=y
BR2_PACKAGE_THINGINO_KOPT_MMC1=y
BR2_PACKAGE_THINGINO_KOPT_MMC1_PC_4BIT=y
BR2_PACKAGE_THINGINO_KOPT_MMC=y
BR2_PACKAGE_WIFI=y
BR2_PACKAGE_WIFI_BCMDHD_AP6181=y
BR2_SENSOR_1_NAME="ov9712"
BR2_SENSOR_1_PARAMS="pwdn_gpio=21"
BR2_INGENIC_SOC_MODEL="t10l"
BR2_THINGINO_SDCARD=y
FLASH_SIZE_MB=16
```

## configs/cameras-exp/noorio_t110_t41nq_gc4023_aic880d/noorio_t110_t41nq_gc4023_aic880d_defconfig
```kconfig
# NAME: Noorio T110 (T41NQ, GC4023, AIC8800D)
# FRAG: soc-xburst2 toolchain-xburst2 ccache brand rootfs kernel system target uboot ssl
BR2_SENSOR_GC4023=y
BR2_SOC_INGENIC_T41NQ=y
BR2_PACKAGE_THINGINO_UBOOT_FLASH_CONTROLLER_JZ_SFC=n
BR2_PACKAGE_THINGINO_UBOOT_FLASH_CONTROLLER_SFC0_NOR=y
BR2_PACKAGE_WIFI=y
BR2_PACKAGE_WIFI_AIC8800=y
BR2_PACKAGE_WIFI_AIC8800_USB=y
BR2_THINGINO_AUDIO=y
BR2_THINGINO_MOTORS=y
BR2_PACKAGE_THINGINO_KOPT_MMC0=y
BR2_PACKAGE_THINGINO_KOPT_MMC0_PB_4BIT=y
BR2_THINGINO_SDCARD=y
BR2_THINGINO_BUTTON=y
FLASH_SIZE_32=y
```

## configs/cameras-exp/okam_qc3_t23dl_gc1084_aic8800dc/okam_qc3_t23dl_gc1084_aic8800dc_defconfig
```kconfig
# NAME: O-KAM QC3 (T23DL, GC1084, AIC8800DC USB)
# FRAG: soc-xburst1 core ssl
BR2_THINGINO_TOOLCHAIN_TYPE_EXTERNAL=y
BR2_THINGINO_TOOLCHAIN_GCC_15=y
BR2_THINGINO_TOOLCHAIN_LIBC_UCLIBC=y
BR2_INGENIC_SOC_MODEL="t23dl"
BR2_ISP_CLKA_600MHZ=y
BR2_ISP_CLKA_SCLKA=y
BR2_ISP_CLK_200MHZ=y
BR2_ISP_CLK_SCLKA=y
BR2_ISP_DIRECT_MODE_1=y
BR2_ISP_IVDC_MEM_LINE=y
BR2_ISP_IVDC_MEM_LINE_VALUE=300
BR2_PACKAGE_THINGINO_KOPT_MMC0=y
BR2_PACKAGE_THINGINO_KOPT_MMC0_PB_4BIT=y
BR2_PACKAGE_WIFI=y
BR2_PACKAGE_WIFI_AIC8800=y
BR2_PACKAGE_WIFI_AIC8800_USB=y
BR2_PACKAGE_WIFI_AIC8800_USB_8800DC=y
BR2_SENSOR_1_NAME="gc1084"
BR2_SENSOR_1_PARAMS="shvflip=1"
BR2_SENSOR_1_IQ_FILE="configs/cameras/okam_qc3_t23dl_gc1084_aic8800dc/gc1084-t23.bin"
BR2_THINGINO_AUDIO=y
BR2_THINGINO_AUDIO_GPIO=63
BR2_THINGINO_BUTTON=y
BR2_THINGINO_PWM_ENABLE=y
BR2_THINGINO_RMEM_MB=10
BR2_THINGINO_SDCARD=y
FLASH_SIZE_MB=8

#BR2_PACKAGE_TELEGRAMBOT=n
#BR2_PACKAGE_THINGINO_DIAG=n
#BR2_PACKAGE_THINGINO_HA=n
#BR2_PACKAGE_THINGINO_LEDD=n
#BR2_PACKAGE_THINGINO_SYSUPGRADE=n
#BR2_PACKAGE_THINGINO_MOSQUITTO_20X=n
#BR2_PACKAGE_WIREGUARD_LINUX_COMPAT=n
#BR2_PACKAGE_WIREGUARD_TOOLS=n
#BR2_PACKAGE_THINGINO_WPA_SUPPLICANT_DEBUG_SYSLOG=n
#BR2_PACKAGE_THINGINO_DEVELOPER=y

BR2_PACKAGE_THINGINO_STREAMER_PRUDYNT=y
#BR2_PACKAGE_THINGINO_STREAMER_STRERO=y

# tx-isp-t23.ko isp_memopt=1 direct_mode=1 isp_clk=200000000 isp_clka=600000000 ivdc_mem_line=300
# sensor_gc1084_t23.ko shvflip=1
# day2night=60000 night2day=4100 gblimit=54 dayevcomp=3000 nightevcomp=0 gbmaxvalid=220 gbcomp=41
# voice input config sample_rate:16000 bits:16 channel:1
# voice output config sample_rate:16000 bits:16 channel:1
# hpf: 1, co_frequency: 400, ns: 1, agc: 1, agc_ns: 2, agc_db_fs: 5, agc_gain_db: 15, hs: 1
# mirror:1, flip:1
# vp_wifi_aic8800.c:0123 [vp_wifi_insmod_driver]:*** insmod /addfs/wifi/aic_load_fw.ko aic_fw_path="/addfs/wifi" ***
# vp_wifi_aic8800.c:0127 [vp_wifi_insmod_driver]:*** insmod /addfs/wifi/aic8800_fdrv.ko ***
```

## configs/cameras-exp/okam_qc3_t23n_gc2083_aic8800u/okam_qc3_t23n_gc2083_aic8800u_defconfig
```kconfig
# NAME: O-KAM QC3 (T23N, GC2083, AIC8800 USB)
# FRAG: soc-xburst1 toolchain-xburst1 ccache brand rootfs kernel system target uboot ssl
BR2_PACKAGE_WIFI=y
BR2_PACKAGE_WIFI_AIC8800=y
BR2_PACKAGE_WIFI_AIC8800_USB=y
BR2_PACKAGE_WIFI_AIC8800_USB_8800D80=y
BR2_SENSOR_GC2083=y
BR2_SOC_INGENIC_T23N=y
BR2_PACKAGE_THINGINO_KOPT_MMC0=y
BR2_PACKAGE_THINGINO_KOPT_MMC0_PB_4BIT=y
BR2_THINGINO_AUDIO=y
BR2_THINGINO_BUTTON=y
BR2_THINGINO_PWM_ENABLE=y
BR2_THINGINO_SDCARD=y
# NB! needs larger flash size due to WiFi firmware
FLASH_SIZE_16=y
```

## configs/cameras-exp/szt_ct213_t23n_gc1084_atbm6012b/szt_ct213_t23n_gc1084_atbm6012b_defconfig
```kconfig
# NAME: SZT CT213 (T23N, GC1084, ATBM6012)
# MODULE: t23n_gc1084_atbm6012b
BR2_ISP_CLK_200MHZ=y
BR2_ISP_PARAMS="direct_mode=2 ivdc_mem_line=648 isp_memopt=1"
BR2_PACKAGE_THINGINO_KOPT_MMC0=y
BR2_PACKAGE_THINGINO_KOPT_MMC0_PB_4BIT=y
BR2_THINGINO_AUDIO=y
BR2_THINGINO_BUTTON=y
BR2_THINGINO_MOTORS=y
BR2_THINGINO_PWM_ENABLE=y
BR2_THINGINO_SDCARD=y
FLASH_SIZE_8=y
```

## configs/cameras-exp/t31al_xxx_rtl8189ftv/t31al_xxx_rtl8189ftv_defconfig
```kconfig
# NAME: Wyze Cam v3 (T31AL, GC2053, RTL8189FTV)
BR2_mipsel=y
BR2_mips_xburst=y
# BR2_MIPS_SOFT_FLOAT is not set
BR2_MIPS_FP32_MODE_32=y
BR2_TOOLCHAIN_EXTERNAL=y
BR2_TOOLCHAIN_EXTERNAL_CUSTOM=y
BR2_TOOLCHAIN_EXTERNAL_DOWNLOAD=y
BR2_TOOLCHAIN_EXTERNAL_URL="$(THINGINO_TOOLCHAIN)"
BR2_TOOLCHAIN_EXTERNAL_HEADERS_3_10=y
BR2_TOOLCHAIN_EXTERNAL_CUSTOM_MUSL=y
BR2_TOOLCHAIN_EXTERNAL_CXX=y
BR2_CCACHE=y
BR2_CCACHE_DIR="$(HOME)/.ccache"
BR2_OPTIMIZE_S=y
BR2_GLOBAL_PATCH_DIR="$(BR2_EXTERNAL)/package/all-patches"
BR2_REPRODUCIBLE=y
BR2_PER_PACKAGE_DIRECTORIES=y
BR2_TARGET_GENERIC_HOSTNAME="thingino"
BR2_TARGET_GENERIC_ISSUE="Welcome to Thingino"
BR2_ROOTFS_MERGED_USR=y
BR2_TARGET_GENERIC_ROOT_PASSWD="root"
BR2_SYSTEM_DEFAULT_PATH="/bin:/sbin:/usr/bin:/usr/sbin"
BR2_ROOTFS_OVERLAY="$(BR2_EXTERNAL)/overlay"
BR2_ROOTFS_POST_BUILD_SCRIPT="$(BR2_EXTERNAL)/scripts/rootfs_script.sh"
BR2_LINUX_KERNEL_CUSTOM_TARBALL=y
BR2_LINUX_KERNEL_CUSTOM_TARBALL_LOCATION="$(KERNEL_TARBALL_URL)"
BR2_LINUX_KERNEL_USE_CUSTOM_CONFIG=y
BR2_LINUX_KERNEL_CUSTOM_CONFIG_FILE="$(BR2_EXTERNAL)/board/$(SOC_VENDOR)/xburst1/kernel/$(SOC_FAMILY).generic.config"
BR2_LINUX_KERNEL_LZMA=y
BR2_PACKAGE_BUSYBOX_CONFIG="$(BR2_EXTERNAL)/package/busybox/busybox.config"
BR2_TARGET_ROOTFS_SQUASHFS=y
BR2_TARGET_ROOTFS_SQUASHFS4_XZ=y
BR2_TARGET_ROOTFS_SQUASHFS_EXTREME_COMP=y
BR2_SOC_INGENIC_T31L=y
BR2_SENSOR_GC2053=y
BR2_PACKAGE_WIFI=y
BR2_PACKAGE_WIFI_RTL8189FS=y
BR2_THINGINO_DEV_PACKAGES=y
BR2_THINGINO_DEVICE_TYPE_IPCAM=y
BR2_THINGINO_DEVICE_TYPE_IPCAM_STANDARD=y
```

## configs/cameras-exp/t31x_gc2053_rtl8189ftv_kernel44/t31x_gc2053_rtl8189ftv_kernel44_defconfig
```kconfig
# NAME: (T31X, GC2053, RTL8189FTV) with Kernel 4.4
# FRAG: soc toolchain ccache brand rootfs kernel system target local
BR2_LINUX_KERNEL_CUSTOM_CONFIG_FILE="$(BR2_EXTERNAL)/board/ingenic/xburst1/kernel/$(KERNEL_VERSION)/t31x.wyze_v3.config"
BR2_PACKAGE_E2FSPROGS=y
BR2_PACKAGE_HOST_LINUX_HEADERS_CUSTOM_4_4=y
BR2_PACKAGE_WIFI=y
BR2_PACKAGE_WIFI_RTL8189FS=y
BR2_SENSOR_GC2053=y
BR2_SOC_INGENIC_T31X=y
#BR2_PACKAGE_HOST_LINUX_HEADERS_CUSTOM_3_10 is not set
BR2_TOOLCHAIN_EXTERNAL_HEADERS_4_4=y
BR2_TOOLCHAIN_EXTERNAL_URL="https://github.com/matteius/ingenic-t31-zrt-kernel-4.4.94/releases/download/4.4.latest/mipsel-thingino-linux-musl_sdk-buildroot.tar.gz"
BR2_TOOLCHAIN_USES_MUSL=y
BR2_THINGINO_DEVICE_TYPE_IPCAM=y
BR2_THINGINO_DEVICE_TYPE_IPCAM_STANDARD=y
FLASH_SIZE_16=y
KERNEL_VERSION_4=y
```

## configs/cameras-exp/t31zx_ov5647_eth/t31zx_ov5647_eth_defconfig
```kconfig
# NAME: (T31ZX, OV5647, ETH)
# FRAG: soc toolchain ccache brand rootfs kernel system target local
BR2_SENSOR_OV5647=y
BR2_SOC_INGENIC_T31ZX=y
BR2_PACKAGE_USBNET=y
BR2_THINGINO_DEVICE_TYPE_IPCAM=y
BR2_THINGINO_DEVICE_TYPE_IPCAM_STANDARD=y
```

## configs/cameras-exp/tplink_tapo_c200_t23n_sc2336p_rtl8188ftv/tplink_tapo_c200_t23n_sc2336p_rtl8188ftv_defconfig
```kconfig
# NAME: TP-LINK TAPO C200 v5 (T23N, SC2336P, RTL8188FTV)
# FRAG: soc-xburst1 toolchain-xburst1 ccache brand rootfs kernel system target uboot ssl
BR2_SOC_INGENIC_T23N=y
BR2_SENSOR_SC2336P=y
BR2_PACKAGE_WIFI=y
BR2_PACKAGE_WIFI_RTL8188FU=y
BR2_PACKAGE_SPI_TMI8152=y
BR2_PACKAGE_THINGINO_KOPT=y
BR2_PACKAGE_THINGINO_KOPT_MMC=y
BR2_PACKAGE_THINGINO_KOPT_MMC0=y
BR2_PACKAGE_THINGINO_KOPT_MMC0_1BIT=y
BR2_SENSOR_PARAMS="data_interface=1 shvflip=1"
BR2_THINGINO_AUDIO=y
BR2_THINGINO_BUTTON=y
BR2_THINGINO_SDCARD=y
```

## configs/cameras-exp/vanhua_t55a_t41lq_gc5603_eth/vanhua_t55a_t41lq_gc5603_eth_defconfig
```kconfig
# NAME: Vanhua T55A (T41LQ, GC5603, ETH)
# FRAG: soc-xburst2 toolchain-xburst2 ccache brand rootfs kernel system target uboot ssl
BR2_ETHERNET=y
BR2_SENSOR_GC5603=y
BR2_SOC_INGENIC_T41LQ=y
BR2_PACKAGE_THINGINO_UBOOT_FLASH_CONTROLLER_JZ_SFC=n
BR2_PACKAGE_THINGINO_UBOOT_FLASH_CONTROLLER_SFC0_NOR=y
BR2_THINGINO_AUDIO=y
BR2_THINGINO_RMEM_22=y
BR2_THINGINO_NMEM_8=y
FLASH_SIZE_16=y
```

## configs/cameras-exp/vanhua_z66si_t41nq_gc4023_eth/vanhua_z66si_t41nq_gc4023_eth_defconfig
```kconfig
# NAME: Vanhua Z66SI (T41NQ, GC4023, ETH)
# FRAG: soc-xburst2 toolchain-xburst2 ccache brand rootfs kernel system target uboot ssl
BR2_ETHERNET=y
BR2_SENSOR_GC4023=y
BR2_SOC_INGENIC_T41NQ=y
BR2_PACKAGE_THINGINO_UBOOT_FLASH_CONTROLLER_JZ_SFC=n
BR2_PACKAGE_THINGINO_UBOOT_FLASH_CONTROLLER_SFC0_NOR=y
BR2_AVPU_APLL=y
BR2_AVPU_CLK_550MHZ=y
BR2_ISP_CLK_VPLL=y
BR2_ISP_CLK_300MHZ=y
BR2_ISP_CLKS_SCLKA=y
BR2_ISP_CLKS_550MHZ=y
BR2_ISP_CLKA_SCLKA=y
BR2_ISP_CLKA_550MHZ=y
BR2_THINGINO_AUDIO=y
BR2_THINGINO_RMEM_46=y
BR2_THINGINO_NMEM_8=y
FLASH_SIZE_16=y
```

## configs/cameras-exp/vstarcam_c662_t23n_gc2083_ssv6355/vstarcam_c662_t23n_gc2083_ssv6355_defconfig
```kconfig
# NAME: Vstarcam C662 (T23N, GC2083, SSV6355)
# FRAG: soc-xburst1 toolchain-xburst1 ccache brand rootfs kernel system target uboot ssl
BR2_PACKAGE_THINGINO_KOPT_MMC0=y
BR2_PACKAGE_THINGINO_KOPT_MMC0_PB_4BIT=y
BR2_PACKAGE_WIFI=y
BR2_PACKAGE_WIFI_SSV6X5X=y
BR2_PACKAGE_WIFI_SSV6X5X_SV6355=y
BR2_SENSOR_1_NAME="gc2083"
#BR2_SENSOR_1_PARAMS="shvflip=1"
BR2_SOC_INGENIC_T23N=y
BR2_THINGINO_AUDIO=y
BR2_THINGINO_AUDIO_GPIO=63
BR2_THINGINO_SDCARD=y
FLASH_SIZE_MB=8
```

## configs/cameras-exp/wansview_q6_t21n_ov2735b_rtl8188ftv/wansview_q6_t21n_ov2735b_rtl8188ftv_defconfig
```kconfig
# NAME: Wansview Q6 (T21N, OV2735B, RTL8188FTV)
# FRAG: soc-xburst1 toolchain-xburst1 ccache brand rootfs kernel system target uboot ssl
BR2_PACKAGE_WIFI=y
BR2_PACKAGE_WIFI_RTL8188FU=y
BR2_SENSOR_OV2735B=y
BR2_SOC_INGENIC_T21N=y
BR2_THINGINO_AUDIO=y
BR2_ISP_CLK_125MHZ=y
BR2_THINGINO_MOTORS=y
BR2_PACKAGE_THINGINO_KOPT_ADC=y
BR2_PACKAGE_THINGINO_KOPT_MMC0=y
BR2_PACKAGE_THINGINO_KOPT_MMC0_PB_4BIT=y
BR2_THINGINO_RMEM_22=y
BR2_THINGINO_SDCARD=y
BR2_SENSOR_PARAMS="sensor_gpio_func=0"
FLASH_SIZE_16=y
```

## configs/cameras-exp/wansview_y1_t31l_os02g10_atbm6031/wansview_y1_t31l_os02g10_atbm6031_defconfig
```kconfig
# NAME: Wansview Y1 (T31L, OS02G10, ATBM6031)
# FRAG: soc-xburst1 toolchain-xburst1 ccache brand rootfs kernel system target uboot ssl
BR2_PACKAGE_WIFI=y
BR2_PACKAGE_WIFI_ATBM6031=y
BR2_SENSOR_OS02G10=y
BR2_SOC_INGENIC_T31L=y
BR2_PACKAGE_THINGINO_KOPT_DWC2=y
BR2_PACKAGE_THINGINO_KOPT_DWC2_OTG=y
BR2_PACKAGE_THINGINO_KOPT_MMC0=y
BR2_PACKAGE_THINGINO_KOPT_MMC0_PB_4BIT=y
BR2_PACKAGE_THINGINO_KOPT_MMC1=y
BR2_PACKAGE_THINGINO_KOPT_MMC1_PB_4BIT=y
BR2_THINGINO_AUDIO=y
BR2_THINGINO_BUTTON=y
BR2_THINGINO_SDCARD=y
FLASH_SIZE_8=y
```

## configs/cameras-exp/wj01_t31l_jxh62_rtl8188ftv/wj01_t31l_jxh62_rtl8188ftv_defconfig
```kconfig
# NAME: WJ01 (T31L, JXH62, RTL8188FTV)
# FRAG: soc-xburst1 toolchain-xburst1 ccache brand rootfs kernel system target uboot ssl
BR2_PACKAGE_WIFI=y
BR2_PACKAGE_WIFI_RTL8188FU=y
BR2_SENSOR_JXH62=y
BR2_SOC_INGENIC_T31L=y
BR2_THINGINO_AUDIO=y
BR2_PACKAGE_THINGINO_KOPT_MMC0=y
BR2_PACKAGE_THINGINO_KOPT_MMC0_PB_4BIT=y
BR2_THINGINO_RMEM_22=y
BR2_THINGINO_SDCARD=y
BR2_SENSOR_PARAMS="data_interface=1"
FLASH_SIZE_8=y
```
