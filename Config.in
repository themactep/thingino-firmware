## br-ext-chip-grainmedia/configs/sz016_defconfig
```kconfig
# OpenIPC Buildroot for GM8136

# OpenIPC
BR2_OPENIPC=y
BR2_OPENIPC_BR_VERSION="2023.02"
BR2_OPENIPC_SOC_VENDOR="grainmedia"
BR2_OPENIPC_SOC_FAMILY="gm8136"
BR2_OPENIPC_SOC_MODEL="gm8136"
BR2_OPENIPC_SENSOR_MODEL="sc1135"
BR2_OPENIPC_FLASH_SIZE_16M=y
BR2_OPENIPC_FLAVOR_LITE=y

# Architecture
BR2_arm=y
BR2_arm926t=y

# Kernel Header Options
BR2_KERNEL_HEADERS_VERSION=y
BR2_DEFAULT_KERNEL_VERSION="3.3"
BR2_PACKAGE_HOST_LINUX_HEADERS_CUSTOM_3_3=y

# Binutils Options
BR2_PACKAGE_HOST_BINUTILS_SUPPORTS_CFI=y
BR2_BINUTILS_VERSION_2_39_X=y
BR2_BINUTILS_VERSION="2.39"
BR2_BINUTILS_EXTRA_CONFIG_OPTIONS=""

# Host GDB Options
# BR2_PACKAGE_HOST_GDB is not set
# BR2_PACKAGE_GDB is not set

BR2_GLOBAL_PATCH_DIR="$(BR2_EXTERNAL_GRAINMEDIA_PATH)/../general/package/all-patches"
BR2_PER_PACKAGE_DIRECTORIES=y

BR2_TARGET_GENERIC_HOSTNAME="openipc-gm8136"
BR2_TARGET_GENERIC_ISSUE="Welcome to OpenIPC"
# BR2_TARGET_TZ_INFO is not set
BR2_ROOTFS_OVERLAY="$(BR2_EXTERNAL_GRAINMEDIA_PATH)/../general/overlay"
BR2_ROOTFS_POST_BUILD_SCRIPT="$(BR2_EXTERNAL_GRAINMEDIA_PATH)/../scripts/executing_commands_for_$(BR2_TOOLCHAIN_BUILDROOT_LIBC).sh"

# Kernel
BR2_LINUX_KERNEL=y
BR2_LINUX_KERNEL_CUSTOM_VERSION=y
BR2_LINUX_KERNEL_CUSTOM_VERSION_VALUE="3.3"
BR2_LINUX_KERNEL_PATCH=""
BR2_LINUX_KERNEL_USE_CUSTOM_CONFIG=y
BR2_LINUX_KERNEL_CUSTOM_CONFIG_FILE="$(BR2_EXTERNAL_GRAINMEDIA_PATH)/board/gm8136/kernel/gm8136.generic.config"
BR2_LINUX_KERNEL_CONFIG_FRAGMENT_FILES=""
BR2_LINUX_KERNEL_CUSTOM_LOGO_PATH=""
BR2_LINUX_KERNEL_UIMAGE=y
BR2_LINUX_KERNEL_XZ=y

# Linux Kernel Extensions
BR2_LINUX_KERNEL_EXT_GRAINMEDIA_PATCHER=y
BR2_LINUX_KERNEL_EXT_GRAINMEDIA_PATCHER_LIST="$(BR2_EXTERNAL_GRAINMEDIA_PATH)/board/gm8136/kernel/patches/ $(BR2_EXTERNAL_GRAINMEDIA_PATH)/board/gm8136/kernel/overlay"

# Target packages
BR2_PACKAGE_BUSYBOX=y
BR2_PACKAGE_BUSYBOX_CONFIG="$(BR2_EXTERNAL_GRAINMEDIA_PATH)/../general/package/busybox/busybox.config"
# BR2_PACKAGE_LAME is not set
BR2_PACKAGE_UBOOT_TOOLS=y
BR2_PACKAGE_HASERL=y
# BR2_PACKAGE_FDK_AAC is not set
# BR2_PACKAGE_OPUS is not set
# BR2_PACKAGE_OPUS_FIXED_POINT is not set
BR2_PACKAGE_ZLIB=y
BR2_PACKAGE_MBEDTLS=y
BR2_PACKAGE_JSON_C=y
BR2_PACKAGE_LIBYAML=y
BR2_PACKAGE_LIBOGG=y
BR2_PACKAGE_LIBCURL=y
BR2_PACKAGE_LIBCURL_CURL=y
BR2_PACKAGE_LIBCURL_MBEDTLS=y
BR2_PACKAGE_LIBWEBSOCKETS=y
BR2_PACKAGE_DROPBEAR=y
# BR2_PACKAGE_MINI_SNMPD is not set
BR2_PACKAGE_MOSQUITTO=y
# BR2_PACKAGE_MOSQUITTO_BROKER is not set
# BR2_PACKAGE_SSHPASS is not set
# BR2_PACKAGE_UACME is not set
# BR2_PACKAGE_WIREGUARD_LINUX_COMPAT is not set
# BR2_PACKAGE_WIREGUARD_TOOLS is not set

# Filesystem
# BR2_TARGET_ROOTFS_CPIO is not set
BR2_TARGET_ROOTFS_SQUASHFS=y
BR2_TARGET_ROOTFS_SQUASHFS4_XZ=y

# OpenIPC packages
BR2_PACKAGE_GRAINMEDIA_OSDRV_GM8136=y
# BR2_PACKAGE_FDK_AAC_OPENIPC is not set
BR2_PACKAGE_IPCTOOL=y
BR2_PACKAGE_JSONFILTER=y
BR2_PACKAGE_LIBEVENT_OPENIPC=y
LIBEVENT_OPENIPC_REMOVE_PYSCRIPT=y
BR2_PACKAGE_MAJESTIC_FONTS=y
BR2_PACKAGE_MAJESTIC=y
BR2_PACKAGE_MICROBE_WEB=y
# BR2_PACKAGE_MOTORS is not set
# BR2_PACKAGE_NABTO is not set
# BR2_PACKAGE_QUIRC_OPENIPC is not set
# BR2_PACKAGE_UACME_OPENIPC is not set
# BR2_PACKAGE_VTUND_OPENIPC is not set
BR2_PACKAGE_YAML_CLI=y
# BR2_PACKAGE_ZEROTIER_ONE is not set

# WiFi
BR2_PACKAGE_WIRELESS_TOOLS=y
BR2_PACKAGE_WPA_SUPPLICANT=y
BR2_PACKAGE_WPA_SUPPLICANT_NL80211=y
# BR2_PACKAGE_WPA_SUPPLICANT_WEXT is not set
BR2_PACKAGE_WPA_SUPPLICANT_CLI=y
BR2_PACKAGE_WPA_SUPPLICANT_PASSPHRASE=y
# BR2_PACKAGE_LINUX_FIRMWARE is not set
# BR2_PACKAGE_LINUX_FIRMWARE_MT7601U is not set
BR2_PACKAGE_RTL8188EU=y

# ------------------------------------------------------------------------------

BR2_TOOLCHAIN_BUILDROOT=y
# BR2_TOOLCHAIN_EXTERNAL=y

# Toolchain
BR2_TOOLCHAIN=y
BR2_TOOLCHAIN_USES_UCLIBC=y
BR2_TOOLCHAIN_BUILDROOT_VENDOR="openipc"
BR2_TOOLCHAIN_BUILDROOT_UCLIBC=y
BR2_TOOLCHAIN_BUILDROOT_LIBC="uclibc"
# BR2_TOOLCHAIN_USES_MUSL is not set
# BR2_TOOLCHAIN_BUILDROOT_MUSL is not set
# BR2_TOOLCHAIN_BUILDROOT_LIBC="musl"
BR2_TOOLCHAIN_BUILDROOT_CXX=y
# BR2_TOOLCHAIN_BUILDROOT_LOCALE is not set
BR2_TOOLCHAIN_BUILDROOT_USE_SSP=y

# GCC Options
BR2_GCC_VERSION_12_X=y
BR2_GCC_VERSION="12.2.0"
# BR2_EXTRA_GCC_CONFIG_OPTIONS="--with-float=hard"
```

## br-ext-chip-ingenic/configs/t21z_shopperplus_defconfig
```kconfig
# OpenIPC Buildroot for Shoppers+ Camera (Ingenic T21Z)

# OpenIPC
BR2_OPENIPC_SOC_VENDOR="ingenic"
BR2_OPENIPC_SOC_FAMILY="t21"
BR2_OPENIPC_SOC_MODEL="t21z"
BR2_OPENIPC_SENSOR_MODEL="sc2300"
BR2_OPENIPC_FLASH_SIZE_8M=y
# BR2_OPENIPC_FLASH_SIZE_16M is not set
BR2_OPENIPC_FLAVOR_LITE=y
# BR2_OPENIPC_FLAVOR_FPV is not set
# BR2_OPENIPC_FLAVOR_ULTIMATE is not set

# Architecture
BR2_mipsel=y
BR2_mips_xburst=y
# BR2_MIPS_SOFT_FLOAT is not set
BR2_MIPS_FP32_MODE_32=y
# BR2_MIPS_FP32_MODE_XX is not set
BR2_MIPS_NAN_LEGACY=y
BR2_MIPS_OABI32=y

# Toolchain
BR2_TOOLCHAIN_USES_MUSL=y
BR2_TOOLCHAIN_BUILDROOT_VENDOR="openipc"
BR2_TOOLCHAIN_BUILDROOT_MUSL=y
BR2_TOOLCHAIN_BUILDROOT_LIBC="musl"
BR2_KERNEL_HEADERS_VERSION=y
BR2_DEFAULT_KERNEL_VERSION="3.10.14"
BR2_PACKAGE_HOST_LINUX_HEADERS_CUSTOM_3_10=y
BR2_EXTRA_GCC_CONFIG_OPTIONS="--with-float=hard"
BR2_TOOLCHAIN_BUILDROOT_CXX=y

# BR2_PACKAGE_HOST_GDB is not set

BR2_GLOBAL_PATCH_DIR="$(BR2_EXTERNAL)/../general/package/all-patches"
BR2_PER_PACKAGE_DIRECTORIES=y

BR2_TARGET_GENERIC_HOSTNAME="openipc-t21z-shopperplus"
BR2_TARGET_GENERIC_ISSUE="Welcome to OpenIPC"
# BR2_TARGET_TZ_INFO is not set
BR2_ROOTFS_OVERLAY="$(BR2_EXTERNAL)/../general/overlay"
BR2_ROOTFS_POST_BUILD_SCRIPT="$(BR2_EXTERNAL)/../scripts/executing_commands_for_musl.sh"

# Kernel
BR2_LINUX_KERNEL=y
BR2_LINUX_KERNEL_CUSTOM_VERSION=y
BR2_LINUX_KERNEL_CUSTOM_VERSION_VALUE="3.10.14"
BR2_LINUX_KERNEL_USE_CUSTOM_CONFIG=y
BR2_LINUX_KERNEL_CUSTOM_CONFIG_FILE="$(BR2_EXTERNAL_INGENIC_PATH)/board/t31/kernel/t21z_shopperplus.config"
BR2_LINUX_KERNEL_UIMAGE=y
BR2_LINUX_KERNEL_LZMA=y

# OpenIPC packages
BR2_LINUX_KERNEL_EXT_INGENIC_PATCHER=y
BR2_LINUX_KERNEL_EXT_INGENIC_PATCHER_LIST="$(BR2_EXTERNAL_INGENIC_PATH)/board/t31/kernel/patches/0001 $(BR2_EXTERNAL_INGENIC_PATH)/board/t31/kernel/patches $(BR2_EXTERNAL_INGENIC_PATH)/board/t31/kernel/overlay"
BR2_PACKAGE_BUSYBOX_CONFIG="$(BR2_EXTERNAL)/../general/package/busybox/busybox.config"
BR2_PACKAGE_LAME=y
# BR2_PACKAGE_GDB is not set
BR2_PACKAGE_LINUX_FIRMWARE=y
# BR2_PACKAGE_LINUX_FIRMWARE_OPENIPC_MT7601U=y
BR2_PACKAGE_RTL8188EU=y
# BR2_PACKAGE_RTL8188FU_OPENIPC s not set
BR2_PACKAGE_UBOOT_TOOLS=y
BR2_PACKAGE_HASERL=y
BR2_PACKAGE_FDK_AAC=y
BR2_PACKAGE_OPUS=y
# BR2_PACKAGE_OPUS_FIXED_POINT=y
BR2_PACKAGE_ZLIB=y
BR2_PACKAGE_MBEDTLS=y
BR2_PACKAGE_JSON_C=y
BR2_PACKAGE_LIBYAML=y
BR2_PACKAGE_LIBOGG=y
BR2_PACKAGE_LIBCURL=y
BR2_PACKAGE_LIBCURL_CURL=y
BR2_PACKAGE_LIBCURL_MBEDTLS=y
BR2_PACKAGE_LIBWEBSOCKETS=y
BR2_PACKAGE_DROPBEAR=y
# BR2_PACKAGE_MINI_SNMPD is not set
BR2_PACKAGE_MOSQUITTO=y
# BR2_PACKAGE_SSHPASS is not set
BR2_PACKAGE_UACME=y
# BR2_PACKAGE_WIREGUARD_LINUX_COMPAT=y
# BR2_PACKAGE_WIREGUARD_TOOLS=y

# WiFi
BR2_PACKAGE_WIRELESS_TOOLS=y
BR2_PACKAGE_WPA_SUPPLICANT=y
BR2_PACKAGE_WPA_SUPPLICANT_NL80211=y
# BR2_PACKAGE_WPA_SUPPLICANT_WEXT is not set
BR2_PACKAGE_WPA_SUPPLICANT_CLI=y
BR2_PACKAGE_WPA_SUPPLICANT_PASSPHRASE=y

# Filesystem
# BR2_TARGET_ROOTFS_CPIO is not set
BR2_TARGET_ROOTFS_SQUASHFS=y
BR2_TARGET_ROOTFS_SQUASHFS4_XZ=y

# BR2_PACKAGE_HISI_GPIO is not set
BR2_PACKAGE_INGENIC_OSDRV_T21=y
BR2_PACKAGE_INGENIC_PATCHER=y
BR2_PACKAGE_IPCTOOL=y
BR2_PACKAGE_JSONFILTER=y
BR2_PACKAGE_LIBEVENT_OPENIPC=y
LIBEVENT_OPENIPC_REMOVE_PYSCRIPT=y
BR2_PACKAGE_MAJESTIC_FONTS=y
BR2_PACKAGE_MAJESTIC=y
BR2_PACKAGE_MICROBE_WEB=y
# BR2_PACKAGE_MOTORS is not set
# BR2_PACKAGE_NABTO is not set
BR2_PACKAGE_QUIRC_OPENIPC=y
BR2_PACKAGE_VTUND_OPENIPC=y
BR2_PACKAGE_YAML_CLI=y
# BR2_PACKAGE_ZEROTIER_ONE is not set
```

## br-ext-chip-ingenic/configs/t31_ultimate_defconfig
```kconfig
# OpenIPC Buildroot for Ingenic T31 (Ultimate)

# OpenIPC
BR2_OPENIPC_SOC_INGENIC=y
BR2_OPENIPC_SOC_INGENIC_T31=y
BR2_OPENIPC_FLASH_SIZE_16M=y
BR2_OPENIPC_FLAVOR_ULTIMATE=y

# Target options
BR2_mipsel=y
BR2_mips_xburst=y
# BR2_MIPS_SOFT_FLOAT is not set
BR2_MIPS_FP32_MODE_32=y
# BR2_MIPS_FP32_MODE_XX is not set
BR2_MIPS_NAN_LEGACY=y
BR2_MIPS_OABI32=y

# Toolchain
BR2_TOOLCHAIN_USES_MUSL=y

# Toolchain Buildroot Options
BR2_TOOLCHAIN_BUILDROOT_VENDOR="openipc"
# BR2_TOOLCHAIN_BUILDROOT_UCLIBC is not set
# BR2_TOOLCHAIN_BUILDROOT_GLIBC is not set
BR2_TOOLCHAIN_BUILDROOT_MUSL=y
BR2_TOOLCHAIN_BUILDROOT_LIBC="musl"

# Kernel Header Options
BR2_KERNEL_HEADERS_VERSION=y
BR2_DEFAULT_KERNEL_VERSION="3.10.14"
BR2_PACKAGE_HOST_LINUX_HEADERS_CUSTOM_3_10=y

BR2_GCC_VERSION_13_X=y
BR2_EXTRA_GCC_CONFIG_OPTIONS="--with-float=hard"
BR2_TOOLCHAIN_BUILDROOT_CXX=y
# BR2_PACKAGE_HOST_GDB is not set

# Mirrors and Download locations
BR2_CCACHE=y
BR2_CCACHE_DIR="$(HOME)/.ccache"
BR2_GLOBAL_PATCH_DIR="$(BR2_EXTERNAL)/package/all-patches"

# Advanced
BR2_PER_PACKAGE_DIRECTORIES=y

# System configuration
BR2_TARGET_GENERIC_HOSTNAME="openipc-t31"
BR2_TARGET_GENERIC_ISSUE="Welcome to OpenIPC"
# BR2_TARGET_TZ_INFO is not set
BR2_ROOTFS_OVERLAY="$(BR2_EXTERNAL)/overlay"
BR2_ROOTFS_POST_BUILD_SCRIPT="$(BR2_EXTERNAL)/scripts/rootfs_script.sh"

# Kernel
BR2_LINUX_KERNEL=y
BR2_LINUX_KERNEL_CUSTOM_TARBALL=y
BR2_LINUX_KERNEL_CUSTOM_TARBALL_LOCATION="https://github.com/openipc/linux/archive/$(OPENIPC_KERNEL).tar.gz"
BR2_LINUX_KERNEL_USE_CUSTOM_CONFIG=y
BR2_LINUX_KERNEL_CUSTOM_CONFIG_FILE="$(EXTERNAL_VENDOR)/board/t31/kernel/t31.generic.config"
BR2_LINUX_KERNEL_UIMAGE=y
BR2_LINUX_KERNEL_LZMA=y

# Target packages
BR2_PACKAGE_BUSYBOX_CONFIG="$(BR2_EXTERNAL)/package/busybox/busybox.config"

# Debugging, profiling and benchmark
# BR2_PACKAGE_GDB is not set

BR2_PACKAGE_UBOOT_TOOLS=y

# SSL
BR2_PACKAGE_MBEDTLS=y
# BR2_PACKAGE_MBEDTLS_PROGRAMS is not set
# BR2_PACKAGE_MBEDTLS_COMPRESSION is not set
BR2_PACKAGE_MBEDTLS_DTLS_SRTP=y

BR2_PACKAGE_LIBCURL=y
BR2_PACKAGE_LIBCURL_CURL=y
BR2_PACKAGE_LIBCURL_VERBOSE=y
BR2_PACKAGE_LIBCURL_PROXY_SUPPORT=y
# BR2_PACKAGE_LIBCURL_COOKIES_SUPPORT is not set
BR2_PACKAGE_LIBCURL_EXTRA_PROTOCOLS_FEATURES=y
BR2_PACKAGE_LIBCURL_MBEDTLS=y
BR2_PACKAGE_DROPBEAR=y
# BR2_PACKAGE_IFUPDOWN_SCRIPTS is not set

BR2_TARGET_ROOTFS_CPIO=y
BR2_TARGET_ROOTFS_SQUASHFS=y
BR2_TARGET_ROOTFS_SQUASHFS4_XZ=y

# Wireless
BR2_PACKAGE_LINUX_FIRMWARE=y
# BR2_PACKAGE_LINUX_FIRMWARE_MEDIATEK_MT7601U is not set
# BR2_PACKAGE_RTL8188EU is not set
BR2_PACKAGE_RTL8189FS=y
BR2_PACKAGE_ATBM60XX=y
BR2_PACKAGE_WIRELESS_TOOLS=y
BR2_PACKAGE_WPA_SUPPLICANT=y
BR2_PACKAGE_WPA_SUPPLICANT_NL80211=y
BR2_PACKAGE_WPA_SUPPLICANT_CLI=y
BR2_PACKAGE_WPA_SUPPLICANT_PASSPHRASE=y

# Ingenic
# BR2_PACKAGE_AUTONIGHT is not set
# BR2_PACKAGE_CAPJPEG is not set
BR2_PACKAGE_INGENIC_MOTORS_T31=y
# BR2_PACKAGE_INGENIC_ATBM603X_SDIO_T31 is not set
BR2_PACKAGE_INGENIC_OPENSDK=y
BR2_PACKAGE_INGENIC_OSDRV_T31=y
BR2_PACKAGE_INGENIC_PWM=y

BR2_PACKAGE_IPCTOOL=y
BR2_PACKAGE_MAJESTIC=y
BR2_PACKAGE_YAML_CLI=y
BR2_PACKAGE_MICROBE_WEB=y

BR2_PACKAGE_NGINX=y
BR2_PACKAGE_NGINX_HTTP=y
BR2_PACKAGE_NGINX_HTTP_SSL_MODULE=y
```
