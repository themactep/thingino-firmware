## configs/cameras-exp/escam_g16_t21n_jxh62_mt7601u/escam_g16_t21n_jxh62_mt7601u_defconfig
```kconfig
# NAME: ESCAM G16 (T21N, JXH62, MT7601U)
# FRAG: soc-xburst1 toolchain-xburst1 ccache brand rootfs kernel system target uboot ssl
BR2_PACKAGE_WIFI=y
BR2_PACKAGE_WIFI_MT7601U=y
BR2_SENSOR_JXH62=y
BR2_SOC_INGENIC_T21N=y
BR2_AVPU_VPLL=y
BR2_PACKAGE_THINGINO_KOPT_MMC0=y
BR2_PACKAGE_THINGINO_KOPT_MMC0_PB_4BIT=y
BR2_THINGINO_AUDIO=y
BR2_THINGINO_SDCARD=y
FLASH_SIZE_8=y
```

## configs/cameras-exp/ezviz_csmy33why_t31x_jxq03_rtl8188ftv/ezviz_csmy33why_t31x_jxq03_rtl8188ftv_defconfig
```kconfig
# NAME: Ezviz CS-MY3-3WHY (T31X, JXQ03, RTL8188FTV)
# FRAG: soc-xburst1 core ssl
BR2_PACKAGE_THINGINO_KOPT=y
BR2_PACKAGE_THINGINO_KOPT_JZ_MAC=y
BR2_PACKAGE_THINGINO_KOPT_JZ_MAC_V13=y
BR2_PACKAGE_THINGINO_KOPT_SPI1_PB2=y
BR2_PACKAGE_WIFI=y
BR2_PACKAGE_WIFI_RTL8188FU=y
BR2_SENSOR_1_NAME="jxq03"
BR2_INGENIC_SOC_MODEL="t31x"
BR2_THINGINO_AUDIO=y
BR2_THINGINO_AUDIO_GPIO=9
BR2_THINGINO_MOTORS=y
BR2_THINGINO_SDCARD=y
BR2_THINGINO_LED_B_GPIO=8
BR2_THINGINO_LED_R_GPIO=16
FLASH_SIZE_MB=16
```

## configs/cameras-exp/galayou_g7_t31lc_sc2336_atbm6012b/galayou_g7_t31lc_sc2336_atbm6012b_defconfig
```kconfig
# NAME: Galayou G7 (T31LC, SC2336, ATBM6012B)
# FRAG: soc-xburst1 toolchain-xburst1 ccache brand rootfs kernel system target uboot ssl
BR2_PACKAGE_WIFI=y
BR2_PACKAGE_WIFI_ATBM6012B=y
BR2_SENSOR_SC2336=y
BR2_SOC_INGENIC_T31LC=y
BR2_PACKAGE_THINGINO_UBOOT_FORMAT_CUSTOM_NAME="u-boot-with-spl.bin"
BR2_PACKAGE_THINGINO_KOPT=y
BR2_PACKAGE_THINGINO_KOPT_MMC0=y
BR2_PACKAGE_THINGINO_KOPT_MMC0_1BIT=y
BR2_PACKAGE_THINGINO_KOPT_MMC=y
FLASH_SIZE_8=y
```

## configs/cameras-exp/h3c_c2041_t31x_jxk04_eth+rtl8188ftv/h3c_c2041_t31x_jxk04_eth+rtl8188ftv_defconfig
```kconfig
# NAME: H3C C2041 (T31X, JXK04, ETH, RTL8188FTV)
# FRAG: soc-xburst1 core ssl
BR2_ETHERNET=y
BR2_INGENIC_SOC_MODEL="t31x"
BR2_ISP_CLK_150MHZ=y
BR2_PACKAGE_THINGINO_KOPT_JZ_MAC=y
BR2_PACKAGE_THINGINO_KOPT_JZ_MAC_V13=y
BR2_PACKAGE_THINGINO_KOPT_MMC0=y
BR2_PACKAGE_THINGINO_KOPT_MMC0_PB_4BIT=y
BR2_PACKAGE_WIFI=y
BR2_PACKAGE_WIFI_RTL8188FU=y
BR2_SENSOR_1_NAME="jxk04"
BR2_SENSOR_1_PARAMS="shvflip=1"
BR2_THINGINO_AUDIO=y
BR2_THINGINO_AUDIO_GPIO=9
BR2_THINGINO_AUDIO_GPIO_LOW=y
BR2_THINGINO_BUTTON=y
BR2_THINGINO_LED_B_ACTIVE_LOW=y
BR2_THINGINO_LED_B_GPIO=16
BR2_THINGINO_LED_R_ACTIVE_LOW=y
BR2_THINGINO_LED_R_GPIO=17
BR2_THINGINO_MOTORS=y
BR2_THINGINO_RMEM_MB=48
BR2_THINGINO_SDCARD=y
FLASH_SIZE_MB=16
```

## configs/cameras-exp/h3c_c2041_t31x_jxk04_rtl8188ftv/h3c_c2041_t31x_jxk04_rtl8188ftv_defconfig
```kconfig
# NAME: H3C C2041 (T31X, JXK04, RTL8188FTV)
# FRAG: soc-xburst1 toolchain-xburst1 ccache brand rootfs kernel system target uboot ssl
BR2_PACKAGE_WIFI=y
BR2_PACKAGE_WIFI_RTL8188FU=y
BR2_SENSOR_JXK04=y
BR2_SOC_INGENIC_T31X=y
BR2_ISP_CLK_150MHZ=y
BR2_THINGINO_MOTORS=y
BR2_THINGINO_MOTORS_TCU=y
BR2_THINGINO_SDCARD=y
BR2_PACKAGE_THINGINO_KOPT=y
BR2_PACKAGE_THINGINO_KOPT_MMC0=y
BR2_PACKAGE_THINGINO_KOPT_MMC0_1BIT=y
BR2_PACKAGE_THINGINO_KOPT_MMC=y
BR2_SENSOR_PARAMS="shvflip=1"
FLASH_SIZE_16=y
```

## configs/cameras-exp/h3c_tc2100_t31n_jxq03_eth+ssv6155/h3c_tc2100_t31n_jxq03_eth+ssv6155_defconfig
```kconfig
# NAME: H3C TC2100 (T31N, JXQ03, ETH, SSV6155)
# FRAG: soc-xburst1 core ssl
BR2_ETHERNET=y
BR2_PACKAGE_THINGINO_KOPT_JZ_MAC=y
BR2_PACKAGE_THINGINO_KOPT_JZ_MAC_V13=y
BR2_PACKAGE_THINGINO_KOPT_MMC0=y
BR2_PACKAGE_THINGINO_KOPT_MMC0_PB_4BIT=y
BR2_PACKAGE_WIFI=y
BR2_PACKAGE_WIFI_SSV6X5X=y
BR2_PACKAGE_WIFI_SSV6X5X_SV6155P=y
BR2_SENSOR_1_NAME="jxq03"
BR2_SENSOR_1_PARAMS="shvflip=1"
BR2_INGENIC_SOC_MODEL="t31n"
BR2_THINGINO_AUDIO=y
BR2_THINGINO_AUDIO_GPIO=9
BR2_THINGINO_AUDIO_GPIO_LOW=y
BR2_THINGINO_BUTTON=y
BR2_THINGINO_LED_B_GPIO=16
BR2_THINGINO_LED_B_ACTIVE_LOW=y
BR2_THINGINO_LED_R_GPIO=17
BR2_THINGINO_LED_R_ACTIVE_LOW=y
BR2_THINGINO_MOTORS=y
BR2_THINGINO_RMEM_MB=27
BR2_THINGINO_SDCARD=y
FLASH_SIZE_MB=16
```

## configs/cameras-exp/hugolog_e5p_t41lq_sc4336p_atbm6062u/hugolog_e5p_t41lq_sc4336p_atbm6062u_defconfig
```kconfig
# NAME: Hugolog E5P (T41LQ, SC4336P, ATBM6062U)
# FRAG: soc-xburst2 core ssl
BR2_AVPU_APLL=y
BR2_AVPU_CLK_550MHZ=y
BR2_ISP_CLKA_550MHZ=y
BR2_ISP_CLKA_SCLKA=y
BR2_ISP_CLKS_550MHZ=y
BR2_ISP_CLKS_SCLKA=y
BR2_ISP_CLK_300MHZ=y
BR2_ISP_CLK_VPLL=y
BR2_INGENIC_SOC_MODEL="t41lq"
BR2_PACKAGE_THINGINO_UBOOT_FLASH_CONTROLLER_JZ_SFC=n
BR2_PACKAGE_THINGINO_UBOOT_FLASH_CONTROLLER_SFC0_NOR=y
BR2_PACKAGE_THINGINO_UBOOT_SD_ENABLE=y
BR2_PACKAGE_WIFI=y
BR2_PACKAGE_WIFI_ATBM6062U=y
BR2_SENSOR_1_NAME="sc4336p"
BR2_PACKAGE_THINGINO_RAPTOR_CONF_SENSOR_NAME="sc4336p"
BR2_PACKAGE_THINGINO_RAPTOR_CONF_SENSOR_VIDEO_INTERFACE="0"
BR2_THINGINO_AUDIO=y
BR2_THINGINO_AUDIO_GPIO=71
BR2_THINGINO_BUTTON=y
BR2_THINGINO_SDCARD=y
BR2_THINGINO_RMEM_MB=24
BR2_THINGINO_NMEM_MB=0
BR2_THINGINO_FLASH_NOR=y
FLASH_SIZE_MB=16
BR2_LINUX_KERNEL_EXT_THINGINO_KOPT=y
BR2_LINUX_KERNEL_EXT_THINGINO_KOPT_DTS=y
BR2_LINUX_KERNEL_EXT_THINGINO_KOPT_DTS_HUGOLOGE5P=y

# Stock (GV/Brovision ODM firmware, T41 "isvp_marmot" 3.10.14 kernel):
#   bootargs mem=40M rmem=19M nmem=5M (64MB total -> T41LQ)
#   This board multi-sources sc5336/sc4336p/sc200ai (stock auto-detects via
#   sinfo). The unit on the bench answers i2c0@0x30 with chip-id 0x9c42 =
#   SC4336P (sc5336=0xce50, sc200ai=0xcb1c). Other units may differ.
#   Stock sc4336p ISP: clks=vpll@594M isp_clk=300M direct_mode=1
#           ivdc_mem_line=256 isp_memopt=2; avpu sclka@552M.
# WLAN power = GPIO 60 active-high (verified on device: AltoBeam enumerates on USB
# only with 60 high; stock gv-gpio table id14, the special-cased entry).
# GPIO 71 as audio amp enable is a best guess (stock holds it high at boot;
# id 19 in the stock table).
# stock also ships atbm613x_wifi_usb.ko (ATBM6132U) as alternate sourcing;
# this unit runs atbm606x_wifi_usb.ko (verified on device 2026-07-06)
```

## configs/cameras-exp/iegeek_sc1_t23n_cv2003_atbm6132u/iegeek_sc1_t23n_cv2003_atbm6132u_defconfig
```kconfig
# NAME: ieGeek SC1 (T23N, CV2003, ATBM6132U)
# FRAG: soc-xburst1 toolchain-xburst1 ccache brand rootfs kernel system target uboot ssl
BR2_PACKAGE_WIFI=y
BR2_PACKAGE_WIFI_ATBM6132U=y
BR2_SENSOR_SV2003=y
BR2_SOC_INGENIC_T23N=y
BR2_THINGINO_AUDIO=y
BR2_THINGINO_BUTTON=y
BR2_THINGINO_FLASH_NOR=y
BR2_THINGINO_MOTORS=y
BR2_THINGINO_PWM_ENABLE=y
BR2_THINGINO_SDCARD=y
FLASH_SIZE_8=y
```
