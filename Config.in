## Config.in
```kconfig
menu "Thingino Firmware"

source "$BR2_EXTERNAL_THINGINO_PATH/Config.soc.in"
source "$BR2_EXTERNAL_THINGINO_PATH/package/wifi/Config.in"
source "$BR2_EXTERNAL_THINGINO_PATH/package/thingino-kopt/Config.in"
source "$BR2_EXTERNAL_THINGINO_PATH/package/thingino-cloner/Config.in"
source "$BR2_EXTERNAL_THINGINO_PATH/package/usbnet/Config.in"

config BR2_THINGINO_TOOLCHAIN
	bool
	default y if BR2_THINGINO_TOOLCHAIN_BUILD

menu "Toolchain"

	choice
		prompt "Thingino toolchain type"
		default BR2_THINGINO_TOOLCHAIN_TYPE_EXTERNAL
		help
		  Select toolchain source used to build fragment name.

	config BR2_THINGINO_TOOLCHAIN_TYPE_BUILDROOT
		bool "Buildroot"

	config BR2_THINGINO_TOOLCHAIN_TYPE_EXTERNAL
		bool "External"

	config BR2_THINGINO_TOOLCHAIN_TYPE_LOCAL
		bool "Local"

	endchoice

	choice
		prompt "Thingino GCC version"
		default BR2_THINGINO_TOOLCHAIN_GCC_15
		help
		  Select GCC major version used to build fragment name.

	config BR2_THINGINO_TOOLCHAIN_GCC_13
		bool "GCC 13"

	config BR2_THINGINO_TOOLCHAIN_GCC_14
		bool "GCC 14"

	config BR2_THINGINO_TOOLCHAIN_GCC_15
		bool "GCC 15"

	endchoice

	choice
		prompt "Thingino toolchain libc"
		default BR2_THINGINO_TOOLCHAIN_LIBC_MUSL
		help
		  Select C library used to build fragment name.

	config BR2_THINGINO_TOOLCHAIN_LIBC_GLIBC
		bool "glibc"

	config BR2_THINGINO_TOOLCHAIN_LIBC_MUSL
		bool "musl"

	config BR2_THINGINO_TOOLCHAIN_LIBC_UCLIBC
		bool "uClibc"

	endchoice

endmenu

menuconfig BR2_THINGINO_SYSTEM_PACKAGES
	bool "System Packages"
	default y if !BR2_THINGINO_TOOLCHAIN
	select BR2_PACKAGE_DROPBEAR
	select BR2_PACKAGE_INGENIC_DIAG_TOOLS
	select BR2_PACKAGE_INGENIC_LIB
	select BR2_PACKAGE_INGENIC_PWM
	select BR2_PACKAGE_INGENIC_SDK
	select BR2_PACKAGE_THINGINO_CORE
	select BR2_PACKAGE_THINGINO_JCT
	select BR2_PACKAGE_THINGINO_KOPT
	select BR2_PACKAGE_THINGINO_LIBCURL
	select BR2_PACKAGE_THINGINO_ONVIF if BR2_PACKAGE_PRUDYNT_T || BR2_PACKAGE_THINGINO_RAPTOR
	select BR2_PACKAGE_THINGINO_UBOOT
	select BR2_PACKAGE_THINGINO_WEBUI
	select BR2_PACKAGE_UBOOT_TOOLS
	# buildroot package configuration
	select BR2_PACKAGE_DROPBEAR_SMALL if BR2_PACKAGE_DROPBEAR
	select BR2_PACKAGE_DROPBEAR_DISABLE_REVERSEDNS if BR2_PACKAGE_DROPBEAR
	select BR2_PACKAGE_WPA_SUPPLICANT_DEBUG_SYSLOG if BR2_PACKAGE_WPA_SUPPLICANT
	# abstractions
	select BR2_PACKAGE_INGENIC_MUSL if BR2_TOOLCHAIN_USES_MUSL
	select BR2_PACKAGE_THINGINO_ETHERNET if BR2_ETHERNET
	select BR2_PACKAGE_THINGINO_MOTORS if BR2_THINGINO_MOTORS
	select BR2_PACKAGE_THINGINO_SOUNDS if BR2_THINGINO_AUDIO
	select BR2_PACKAGE_EXFAT_NOFUSE if BR2_THINGINO_SDCARD
	# virtual packages
	select BR2_PACKAGE_THINGINO_SSL
	select BR2_PACKAGE_THINGINO_VPN
	select BR2_PACKAGE_THINGINO_WEBSERVER
	help
	  Thingino System Packages
	  include essential system setup.
	  https://github.com/thingino/firmware

if BR2_THINGINO_SYSTEM_PACKAGES
source "$BR2_EXTERNAL_THINGINO_PATH/package/ingenic-diag-tools/Config.in"
source "$BR2_EXTERNAL_THINGINO_PATH/package/ingenic-lib/Config.in"
source "$BR2_EXTERNAL_THINGINO_PATH/package/magik-models/Config.in"
source "$BR2_EXTERNAL_THINGINO_PATH/package/ingenic-musl/Config.in"
source "$BR2_EXTERNAL_THINGINO_PATH/package/libaudioshim/Config.in"
source "$BR2_EXTERNAL_THINGINO_PATH/package/ingenic-pwm/Config.in"
source "$BR2_EXTERNAL_THINGINO_PATH/package/ingenic-sdk/Config.in"
source "$BR2_EXTERNAL_THINGINO_PATH/package/open-tx-isp/Config.in"
source "$BR2_EXTERNAL_THINGINO_PATH/package/ingenic-uclibc/Config.in"
source "$BR2_EXTERNAL_THINGINO_PATH/package/logcat-mini/Config.in"
source "$BR2_EXTERNAL_THINGINO_PATH/package/logcat/Config.in"
source "$BR2_EXTERNAL_THINGINO_PATH/package/mbedtls-certgen/Config.in"
source "$BR2_EXTERNAL_THINGINO_PATH/package/openimp/Config.in"
source "$BR2_EXTERNAL_THINGINO_PATH/package/spi-tmi8152/Config.in"
source "$BR2_EXTERNAL_THINGINO_PATH/package/subzeroclaw/Config.in"
source "$BR2_EXTERNAL_THINGINO_PATH/package/telegrambot/Config.in"
source "$BR2_EXTERNAL_THINGINO_PATH/package/thingino-core/Config.in"
source "$BR2_EXTERNAL_THINGINO_PATH/package/thingino-jct/Config.in"
source "$BR2_EXTERNAL_THINGINO_PATH/package/thingino-libubox/Config.in"
source "$BR2_EXTERNAL_THINGINO_PATH/package/thingino-ustream-ssl/Config.in"
source "$BR2_EXTERNAL_THINGINO_PATH/package/thingino-odhcp6c/Config.in"
source "$BR2_EXTERNAL_THINGINO_PATH/package/thingino-button/Config.in"
source "$BR2_EXTERNAL_THINGINO_PATH/package/thingino-bluetooth/Config.in"
source "$BR2_EXTERNAL_THINGINO_PATH/package/thingino-bluez/Config.in"
source "$BR2_EXTERNAL_THINGINO_PATH/package/thingino-daynightd/Config.in"
source "$BR2_EXTERNAL_THINGINO_PATH/package/thingino-diag/Config.in"
source "$BR2_EXTERNAL_THINGINO_PATH/package/thingino-dusk2dawn/Config.in"
source "$BR2_EXTERNAL_THINGINO_PATH/package/thingino-ethernet/Config.in"
source "$BR2_EXTERNAL_THINGINO_PATH/package/thingino-gpio/Config.in"
source "$BR2_EXTERNAL_THINGINO_PATH/package/thingino-ledd/Config.in"
source "$BR2_EXTERNAL_THINGINO_PATH/package/thingino-libble/Config.in"
source "$BR2_EXTERNAL_THINGINO_PATH/package/thingino-libcurl/Config.in"
source "$BR2_EXTERNAL_THINGINO_PATH/package/thingino-mmc/Config.in"
source "$BR2_EXTERNAL_THINGINO_PATH/package/thingino-mxml/Config.in"
source "$BR2_EXTERNAL_THINGINO_PATH/package/thingino-motors/Config.in"
source "$BR2_EXTERNAL_THINGINO_PATH/package/thingino-nimble/Config.in"
source "$BR2_EXTERNAL_THINGINO_PATH/package/thingino-provision/Config.in"
source "$BR2_EXTERNAL_THINGINO_PATH/package/thingino-prusa-connect/Config.in"
source "$BR2_EXTERNAL_THINGINO_PATH/package/thingino-sounds/Config.in"
source "$BR2_EXTERNAL_THINGINO_PATH/package/thingino-system/Config.in"
source "$BR2_EXTERNAL_THINGINO_PATH/package/thingino-sysupgrade/Config.in"
source "$BR2_EXTERNAL_THINGINO_PATH/package/thingino-ubus/Config.in"
source "$BR2_EXTERNAL_THINGINO_PATH/package/thingino-uboot/Config.in"
source "$BR2_EXTERNAL_THINGINO_PATH/package/thingino-webui/Config.in"

source "$BR2_EXTERNAL_THINGINO_PATH/package/thingino-webserver/Config.in"
source "$BR2_EXTERNAL_THINGINO_PATH/package/thingino-httpd-ssl/Config.in"
source "$BR2_EXTERNAL_THINGINO_PATH/package/thingino-onvif/Config.in"
source "$BR2_EXTERNAL_THINGINO_PATH/package/thingino-uhttpd/Config.in"
endif

menuconfig BR2_THINGINO_STREAMER_PACKAGES
	bool "Streamer Packages"
	default y if !BR2_THINGINO_TOOLCHAIN
  select BR2_PACKAGE_THINGINO_STREAMER
	help
	  Thingino Streamer Packages
	  Audio/Video Streaming related packages
	  https://github.com/thingino/firmware

if BR2_THINGINO_STREAMER_PACKAGES
source "$BR2_EXTERNAL_THINGINO_PATH/package/faac/Config.in"
source "$BR2_EXTERNAL_THINGINO_PATH/package/libhelix-aac/Config.in"
source "$BR2_EXTERNAL_THINGINO_PATH/package/libhelix-mp3/Config.in"
source "$BR2_EXTERNAL_THINGINO_PATH/package/libflac/Config.in"
source "$BR2_EXTERNAL_THINGINO_PATH/package/go2rtc/Config.in"
source "$BR2_EXTERNAL_THINGINO_PATH/package/go2rtc-mini/Config.in"
source "$BR2_EXTERNAL_THINGINO_PATH/package/ingenic-audiodaemon/Config.in"
source "$BR2_EXTERNAL_THINGINO_PATH/package/ingenic-libimp-control/Config.in"
source "$BR2_EXTERNAL_THINGINO_PATH/package/libjuice/Config.in"
source "$BR2_EXTERNAL_THINGINO_PATH/package/libdatachannel/Config.in"
source "$BR2_EXTERNAL_THINGINO_PATH/package/usrsctp/Config.in"
source "$BR2_EXTERNAL_THINGINO_PATH/package/thingino-streamer/Config.in"
source "$BR2_EXTERNAL_THINGINO_PATH/package/compy/Config.in"
source "$BR2_EXTERNAL_THINGINO_PATH/package/thingino-ffmpeg/Config.in"
source "$BR2_EXTERNAL_THINGINO_PATH/package/thingino-fonts/Config.in"
source "$BR2_EXTERNAL_THINGINO_PATH/package/thingino-logo/Config.in"
source "$BR2_EXTERNAL_THINGINO_PATH/package/thingino-live555/Config.in"
source "$BR2_EXTERNAL_THINGINO_PATH/package/thingino-v4l2loopback/Config.in"
endif

menu "Extra Packages"
source "$BR2_EXTERNAL_THINGINO_PATH/package/thingino-vpn/Config.in"

source "$BR2_EXTERNAL_THINGINO_PATH/package/exfat-nofuse/Config.in"
source "$BR2_EXTERNAL_THINGINO_PATH/package/jsonpath/Config.in"
source "$BR2_EXTERNAL_THINGINO_PATH/package/libschrift/Config.in"
source "$BR2_EXTERNAL_THINGINO_PATH/package/nino/Config.in"
source "$BR2_EXTERNAL_THINGINO_PATH/package/thingino-esphome/Config.in"
source "$BR2_EXTERNAL_THINGINO_PATH/package/thingino-ha/Config.in"
source "$BR2_EXTERNAL_THINGINO_PATH/package/thingino-agent/Config.in"
source "$BR2_EXTERNAL_THINGINO_PATH/package/thingino-freetype/Config.in"
source "$BR2_EXTERNAL_THINGINO_PATH/package/thingino-libwebsockets/Config.in"
source "$BR2_EXTERNAL_THINGINO_PATH/package/thingino-mosquitto-20x/Config.in"
source "$BR2_EXTERNAL_THINGINO_PATH/package/thingino-mosquitto-212/Config.in"
source "$BR2_EXTERNAL_THINGINO_PATH/package/thingino-wpa_supplicant/Config.in"
source "$BR2_EXTERNAL_THINGINO_PATH/package/wyze-accessory/Config.in"
source "$BR2_EXTERNAL_THINGINO_PATH/package/llhttp/Config.in"
source "$BR2_EXTERNAL_THINGINO_PATH/package/lightnvr/Config.in"

config BR2_PACKAGE_IFUPDOWN_SCRIPTS
	bool "ifupdown-scripts"

config BR2_PACKAGE_SSHPASS
	bool "sshpass"
endmenu

menuconfig BR2_THINGINO_DEV_PACKAGES
	bool "Development Packages"
	select BR2_PACKAGE_THINGINO_KOPT
	help
	  Thingino Development Packages
	  include tools for firmware development.
	  https://github.com/thingino/firmware

if BR2_THINGINO_DEV_PACKAGES
config BR2_THINGINO_NFS
	string "NFS Mount Point"
	default "/nfs"
	help
	  NFS mount point for debug builds and development tools

config BR2_THINGINO_TOOLCHAIN_BUILD
	bool "Enable Toolchain Build"

config BR2_PACKAGE_GDB
	bool "gdb Server and Client"
	select BR2_PACKAGE_HOST_GDB

config BR2_PACKAGE_SELECT_LTRACE
	bool "ltrace"
	select BR2_PACKAGE_LTRACE
	depends on BR2_USE_WCHAR
	depends on !BR2_STATIC_LIBS
	depends on BR2_TOOLCHAIN_HAS_THREADS
	depends on BR2_TOOLCHAIN_USES_UCLIBC || BR2_TOOLCHAIN_USES_GLIBC
	depends on BR2_PACKAGE_LTRACE_ARCH_SUPPORTS
	help
	  Debugging program which runs a specified command until it
	  exits. While the command is executing, ltrace intercepts and
	  records the dynamic library calls which are called by the
	  executed process and the signals received by that process.

comment "WARNING: ltrace is unsupported on musl; selection will not build ltrace"
	depends on BR2_TOOLCHAIN_USES_MUSL && BR2_PACKAGE_SELECT_LTRACE

config BR2_PACKAGE_SELECT_STRACE
	bool "strace"
	select BR2_PACKAGE_STRACE
	help
	  A useful diagnostic, instructional, and debugging tool.
	  Allows you to track what system calls a program makes
	  while it is running.

config BR2_PACKAGE_SELECT_TCPDUMP
	bool "tcpdump"
	select BR2_PACKAGE_TCPDUMP
	help
	  Select tcpdump package from Buildroot.

config BR2_THINGINO_SINFO
	bool "sinfo"
	help
	  A useful diagnostic kernel module for detecting I2C based sensors

config BR2_PACKAGE_SELECT_VALGRIND
	bool "valgrind"
	select BR2_PACKAGE_VALGRIND
	select BR2_PACKAGE_VALGRIND_MEMCHECK
	select BR2_PACKAGE_VALGRIND_HELGRIND
	select BR2_PACKAGE_VALGRIND_DRD
	select BR2_PACKAGE_VALGRIND_MASSIF
	select BR2_PACKAGE_VALGRIND_DHAT
	help
	  Tool for debugging and profiling Linux programs.

source "$BR2_EXTERNAL_THINGINO_PATH/package/libimp-debug/Config.in"
source "$BR2_EXTERNAL_THINGINO_PATH/package/thingino-imp-test/Config.in"
source "$BR2_EXTERNAL_THINGINO_PATH/package/thingino-rt-tests/Config.in"
source "$BR2_EXTERNAL_THINGINO_PATH/package/thingino-developer/Config.in"
source "$BR2_EXTERNAL_THINGINO_PATH/package/thingino-devscripts/Config.in"
source "$BR2_EXTERNAL_THINGINO_PATH/package/gadget-serial/Config.in"

config BR2_THINGINO_DEV_EXPERIMENTAL
	bool "Enable experimental items in menuconfig"
	help
	  Enables experimental options hidden in menuconfig.
	  These features may be unstable, have unexpected behavior, or be non-functional.
	  For developers only.
endif

endmenu
```

## Config.in.host
```kconfig
menu "Thingino host utilities"

source "$BR2_EXTERNAL_THINGINO_PATH/package/thingino-jct/Config.in.host"

endmenu
```
