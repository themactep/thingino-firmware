## br-ext-chip-ingenic/configs/wyze_v3_defconfig
```kconfig
# OpenIPC Buildroot for Wyze V3 (Ingenic T31X)

# OpenIPC
BR2_OPENIPC_SOC_VENDOR="ingenic"
BR2_OPENIPC_SOC_FAMILY="t31"
BR2_OPENIPC_SOC_MODEL="t31x"
BR2_OPENIPC_SENSOR_MODEL="gc2053"
BR2_OPENIPC_FLASH_SIZE_16M=y
BR2_OPENIPC_FLAVOR_ULTIMATE=y

# Architecture
BR2_mipsel=y
BR2_mips_xburst=y
# BR2_MIPS_SOFT_FLOAT is not set
BR2_MIPS_FP32_MODE_32=y
# BR2_MIPS_FP32_MODE_XX is not set
BR2_MIPS_NAN_LEGACY=y
BR2_MIPS_OABI32=y

# BR2_TOOLCHAIN_BUILDROOT is not set
BR2_TOOLCHAIN_EXTERNAL=y

#
# Toolchain
#
BR2_TOOLCHAIN=y
BR2_TOOLCHAIN_USES_MUSL=y
BR2_TOOLCHAIN_BUILDROOT_VENDOR="openipc"
BR2_TOOLCHAIN_BUILDROOT_MUSL=y
BR2_TOOLCHAIN_BUILDROOT_LIBC="musl"
BR2_TOOLCHAIN_BUILDROOT_CXX=y

#
# Kernel Header Options
#
BR2_KERNEL_HEADERS_AS_KERNEL=y
# BR2_KERNEL_HEADERS_VERSION is not set
BR2_PACKAGE_HOST_LINUX_HEADERS_CUSTOM_3_10=y
BR2_PACKAGE_LINUX_HEADERS=y
BR2_PACKAGE_MUSL_ARCH_SUPPORTS=y
BR2_PACKAGE_MUSL_SUPPORTS=y
BR2_PACKAGE_MUSL=y
BR2_PACKAGE_UCLIBC_ARCH_SUPPORTS=y
BR2_PACKAGE_UCLIBC_SUPPORTS=y
BR2_PACKAGE_GLIBC_ARCH_SUPPORTS=y
BR2_PACKAGE_GLIBC_SUPPORTS=y

#
# Binutils Options
#
BR2_PACKAGE_HOST_BINUTILS_SUPPORTS_CFI=y
BR2_BINUTILS_VERSION_2_39_X=y
BR2_BINUTILS_VERSION="2.39"
BR2_BINUTILS_EXTRA_CONFIG_OPTIONS=""

#
# GCC Options
#
BR2_PACKAGE_HOST_GDB_ARCH_SUPPORTS=y
BR2_GCC_VERSION_12_X=y
BR2_GCC_VERSION="12.2.0"
BR2_EXTRA_GCC_CONFIG_OPTIONS="--with-float=hard"

#
# Host GDB Options
#
# BR2_PACKAGE_HOST_GDB is not set

BR2_TOOLCHAIN_EXTERNAL=y
BR2_TOOLCHAIN_EXTERNAL_CUSTOM=y
BR2_TOOLCHAIN_EXTERNAL_PREINSTALLED=y
BR2_TOOLCHAIN_EXTERNAL_PATH="/opt/toolchains/themactep/mipsel-openipc-linux-musl_sdk-buildroot"
BR2_TOOLCHAIN_EXTERNAL_MUSL=y
# BR2_PACKAGE_HAS_TOOLCHAIN_EXTERNAL=y
# BR2_PACKAGE_PROVIDES_TOOLCHAIN_EXTERNAL="toolchain-external-custom"
BR2_TOOLCHAIN_EXTERNAL_PREFIX="$(ARCH)-linux"
BR2_TOOLCHAIN_EXTERNAL_CUSTOM_PREFIX="$(ARCH)-linux"
BR2_TOOLCHAIN_EXTERNAL_GCC_12=y
BR2_TOOLCHAIN_EXTERNAL_HEADERS_3_10=y
BR2_TOOLCHAIN_EXTERNAL_CUSTOM_MUSL=y
BR2_TOOLCHAIN_EXTERNAL_HAS_SSP=y
BR2_TOOLCHAIN_EXTERNAL_HAS_SSP_STRONG=y
BR2_TOOLCHAIN_EXTERNAL_CXX=y

BR2_GLOBAL_PATCH_DIR="$(BR2_EXTERNAL_INGENIC_PATH)/../general/package/all-patches"
BR2_PER_PACKAGE_DIRECTORIES=y

BR2_TARGET_GENERIC_HOSTNAME="wyze-v3"
BR2_TARGET_GENERIC_ISSUE="Welcome to OpenIPC"
# BR2_TARGET_TZ_INFO is not set
BR2_ROOTFS_OVERLAY="$(BR2_EXTERNAL_INGENIC_PATH)/../general/overlay"
BR2_ROOTFS_POST_BUILD_SCRIPT="$(BR2_EXTERNAL_INGENIC_PATH)/../scripts/executing_commands_for_musl.sh"

# Kernel
BR2_LINUX_KERNEL=y
BR2_LINUX_KERNEL_CUSTOM_VERSION=y
BR2_LINUX_KERNEL_CUSTOM_VERSION_VALUE="3.10.14"
BR2_LINUX_KERNEL_VERSION="3.10.14"
BR2_LINUX_KERNEL_PATCH=""
BR2_LINUX_KERNEL_USE_CUSTOM_CONFIG=y
BR2_LINUX_KERNEL_CUSTOM_CONFIG_FILE="$(BR2_EXTERNAL_INGENIC_PATH)/board/t31/kernel/t31_wyzev3.config"
BR2_LINUX_KERNEL_CONFIG_FRAGMENT_FILES=""
BR2_LINUX_KERNEL_CUSTOM_LOGO_PATH=""
BR2_LINUX_KERNEL_UIMAGE=y
BR2_LINUX_KERNEL_LZMA=y

#
# Linux Kernel Extensions
#
BR2_LINUX_KERNEL_EXT_INGENIC_PATCHER=y
BR2_LINUX_KERNEL_EXT_INGENIC_PATCHER_LIST="$(BR2_EXTERNAL_INGENIC_PATH)/board/t31/kernel/patches $(BR2_EXTERNAL_INGENIC_PATH)/board/t31/kernel/overlay"

#
# Target packages
#
BR2_PACKAGE_BUSYBOX=y
BR2_PACKAGE_BUSYBOX_CONFIG="$(BR2_EXTERNAL_INGENIC_PATH)/../general/package/busybox/busybox.config"
# BR2_PACKAGE_LAME is not set
# BR2_PACKAGE_GDB is not set
# BR2_PACKAGE_LINUX_FIRMWARE is not set
# BR2_PACKAGE_RTL8188EU is not set
BR2_PACKAGE_RTL8189FS=y
BR2_PACKAGE_UBOOT_TOOLS=y
BR2_PACKAGE_HASERL=y
# BR2_PACKAGE_FDK_AAC is not set
# BR2_PACKAGE_OPUS is not set
# BR2_PACKAGE_OPUS_FIXED_POINT is not set
BR2_PACKAGE_ZLIB=y
BR2_PACKAGE_MBEDTLS=y
BR2_PACKAGE_MBEDTLS_DTLS_SRTP=y
BR2_PACKAGE_JSON_C=y
BR2_PACKAGE_LIBYAML=y
BR2_PACKAGE_LIBOGG=y
BR2_PACKAGE_LIBCURL=y
BR2_PACKAGE_LIBCURL_CURL=y
BR2_PACKAGE_LIBCURL_MBEDTLS=y
BR2_PACKAGE_LIBCURL_EXTRA_PROTOCOLS_FEATURES=y
BR2_PACKAGE_LIBWEBSOCKETS=y
BR2_PACKAGE_DROPBEAR=y
# BR2_PACKAGE_MINI_SNMPD is not set
BR2_PACKAGE_MOSQUITTO=y
# BR2_PACKAGE_MOSQUITTO_BROKER is not set
# BR2_PACKAGE_SSHPASS is not set
# BR2_PACKAGE_UACME is not set
# BR2_PACKAGE_WIREGUARD_LINUX_COMPAT is not set
# BR2_PACKAGE_WIREGUARD_TOOLS is not set

# WiFi
BR2_PACKAGE_WIRELESS_TOOLS=y
BR2_PACKAGE_WPA_SUPPLICANT=y
BR2_PACKAGE_WPA_SUPPLICANT_NL80211=y
# BR2_PACKAGE_WPA_SUPPLICANT_WEXT is not set
BR2_PACKAGE_WPA_SUPPLICANT_CLI=y
BR2_PACKAGE_WPA_SUPPLICANT_PASSPHRASE=y

# Filesystem
# BR2_TARGET_ROOTFS_CPIO is not set
BR2_TARGET_ROOTFS_SQUASHFS=y
BR2_TARGET_ROOTFS_SQUASHFS4_XZ=y

# OpenIPC packages
BR2_PACKAGE_INGENIC_OSDRV_T31=y
BR2_PACKAGE_INGENIC_PATCHER=y
BR2_PACKAGE_IPCTOOL=y
BR2_PACKAGE_JSONFILTER=y
BR2_PACKAGE_LIBEVENT_OPENIPC=y
LIBEVENT_OPENIPC_REMOVE_PYSCRIPT=y
BR2_PACKAGE_MAJESTIC_FONTS=y
BR2_PACKAGE_MAJESTIC=y
BR2_PACKAGE_MICROBE_WEB=y
# BR2_PACKAGE_MOTORS is not set
# BR2_PACKAGE_NABTO is not set
# BR2_PACKAGE_QUIRC_OPENIPC is not set
# BR2_PACKAGE_VTUND_OPENIPC is not set
# BR2_PACKAGE_WIREGUARD_LINUX_COMPAT_OPENIPC is not set
BR2_PACKAGE_YAML_CLI=y
# BR2_PACKAGE_ZEROTIER_ONE ius not set
```

## br-ext-openipc/Config.in
```kconfig
#source "$BR2_EXTERNAL_OPENIPC_PATH/toolchain/toolchain-external-mine/Config.in.options"
#source "$BR2_EXTERNAL_OPENIPC_PATH/package/pkg-1/Config.in"
#source "$BR2_EXTERNAL_OPENIPC_PATH/package/pkg-2/Config.in"
#source "$BR2_EXTERNAL_OPENIPC_PATH/package/my-jpeg/Config.in"

#config BAR_OPENIPC_ADDR
#    hex "my-board flash address"
#    default 0x10AD

config BR2_OPENIPC
	bool "OpenIPC Firmware"
	default y
	help
	  OpenIPC firmware.

	  https://openipc.org

if BR2_OPENIPC

config BR2_OPENIPC_SOC_VENDOR
	string "SoC manufacturer"

config BR2_OPENIPC_SOC_FAMILY
	string "SoC family"

config BR2_OPENIPC_SOC_MODEL
	string "SoC model"

config BR2_OPENIPC_SENSOR_MODEL
	string "Image sensor model"

config BR2_OPENIPC_BR_VERSION
	string "Version of Buildroot"

config BR2_OPENIPC_FLAVOR
	bool
	depends on BR2_OPENIPC

choice
	prompt "Flash chip size"

config BR2_OPENIPC_FLASH_SIZE_8M
	bool "8MB Flash Chip"

config BR2_OPENIPC_FLASH_SIZE_16M
	bool "16MB Flash Chip"
endchoice

choice
	prompt "Which flavor to use"

config BR2_OPENIPC_FLAVOR_LITE
	bool "Lite"
	help
	  Light version for 8MB flash chip

config BR2_OPENIPC_FLAVOR_FPV
	bool "FPV"
	help
	  Version for drones

config BR2_OPENIPC_FLAVOR_ULTIMATE
	bool "Ultimate"
	help
	  Advanced version for 16MB flash chip
	select BR2_OPENIPC_FLASH_SIZE_16M
	select BR2_PACKAGE_LAME_OPENIPC
	select BR2_PACKAGE_LIBWEBSOCKETS_OPENIPC
	select BR2_PACKAGE_ZEROTIER_ONE
endchoice

endif
```

## configs/_generic_t30_defconfig
```kconfig
BR2_mipsel=y
BR2_mips_xburst=y
# BR2_MIPS_SOFT_FLOAT is not set
BR2_MIPS_FP32_MODE_32=y
BR2_TOOLCHAIN_EXTERNAL=y
BR2_TOOLCHAIN_EXTERNAL_CUSTOM=y
BR2_TOOLCHAIN_EXTERNAL_PATH="$(BR2_EXTERNAL)/toolchain/mipsel-thingino-linux-musl_sdk-buildroot"
BR2_TOOLCHAIN_EXTERNAL_HEADERS_3_10=y
BR2_TOOLCHAIN_EXTERNAL_CUSTOM_MUSL=y
BR2_TOOLCHAIN_EXTERNAL_CXX=y
BR2_CCACHE=y
BR2_CCACHE_DIR="$(HOME)/.ccache"
BR2_OPTIMIZE_S=y
BR2_GLOBAL_PATCH_DIR="$(BR2_EXTERNAL)/package/all-patches"
BR2_REPRODUCIBLE=y
BR2_PER_PACKAGE_DIRECTORIES=y
BR2_ROOTFS_MERGED_USR=y
BR2_SYSTEM_DEFAULT_PATH="/bin:/sbin:/usr/bin:/usr/sbin"
BR2_TARGET_GENERIC_HOSTNAME="thingino"
BR2_TARGET_GENERIC_ISSUE="Welcome to Thingino"
BR2_ROOTFS_OVERLAY="$(BR2_EXTERNAL)/overlay"
BR2_ROOTFS_POST_BUILD_SCRIPT="$(BR2_EXTERNAL)/scripts/rootfs_script.sh"
BR2_LINUX_KERNEL=y
BR2_LINUX_KERNEL_CUSTOM_TARBALL=y
BR2_LINUX_KERNEL_CUSTOM_TARBALL_LOCATION="$(THINGINO_KERNEL)"
BR2_LINUX_KERNEL_USE_CUSTOM_CONFIG=y
BR2_LINUX_KERNEL_CUSTOM_CONFIG_FILE="$(BR2_EXTERNAL)/board/$(SOC_VENDOR)/xburst1/kernel/$(SOC_FAMILY).generic.config"
BR2_LINUX_KERNEL_LZMA=y
BR2_PACKAGE_BUSYBOX_CONFIG="$(BR2_EXTERNAL)/package/busybox/busybox.config"
BR2_TARGET_ROOTFS_SQUASHFS=y
BR2_TARGET_ROOTFS_SQUASHFS4_XZ=y
BR2_TARGET_ROOTFS_SQUASHFS_EXTREME_COMP=y
BR2_SOC_INGENIC_T30=y
BR2_THINGINO_SYSTEM_PACKAGES=y
```

## configs/_generic_t31_defconfig
```kconfig
# OpenIPC Buildroot for Ingenic T31

# Board options
BR2_SOC_INGENIC=y
BR2_SOC_INGENIC_T31=y
BR2_SOC_INGENIC_T31L=y
BR2_SENSOR_MODEL="sc2336"

# Architecture
BR2_mipsel=y
BR2_mips_xburst=y
# BR2_MIPS_SOFT_FLOAT is not set
BR2_MIPS_FP32_MODE_32=y
# BR2_MIPS_FP32_MODE_XX is not set
BR2_MIPS_NAN_LEGACY=y
BR2_MIPS_OABI32=y

# Toolchain
BR2_CCACHE=y
BR2_CCACHE_DIR="$(HOME)/.ccache"
BR2_GCC_VERSION_13_X=y
BR2_PER_PACKAGE_DIRECTORIES=y
BR2_TOOLCHAIN_USES_MUSL=y
BR2_TOOLCHAIN_BUILDROOT_MUSL=y
BR2_TOOLCHAIN_BUILDROOT_LIBC="musl"
# BR2_TOOLCHAIN_BUILDROOT_UCLIBC is not set
# BR2_TOOLCHAIN_BUILDROOT_GLIBC is not set
BR2_EXTRA_GCC_CONFIG_OPTIONS="--with-float=hard"
BR2_TOOLCHAIN_BUILDROOT_CXX=y
BR2_TOOLCHAIN_BUILDROOT_LOCALE=y
BR2_TOOLCHAIN_BUILDROOT_USE_SSP=y

# Kernel
BR2_LINUX_KERNEL=y
BR2_LINUX_KERNEL_CUSTOM_TARBALL=y
BR2_LINUX_KERNEL_CUSTOM_TARBALL_LOCATION="$(THINGINO_KERNEL)"
BR2_LINUX_KERNEL_USE_CUSTOM_CONFIG=y
BR2_LINUX_KERNEL_CUSTOM_CONFIG_FILE="$(BR2_EXTERNAL)/board/$(SOC_VENDOR)/xburst1/kernel/$(SOC_FAMILY).generic.config"
BR2_LINUX_KERNEL_UIMAGE=y
BR2_LINUX_KERNEL_LZMA=y
BR2_KERNEL_HEADERS_VERSION=y
BR2_DEFAULT_KERNEL_VERSION="3.10.14"
BR2_PACKAGE_HOST_LINUX_HEADERS_CUSTOM_3_10=y

# System configuration
# BR2_TARGET_TZ_INFO is not set
BR2_ROOTFS_OVERLAY="$(BR2_EXTERNAL)/overlay"
BR2_ROOTFS_POST_BUILD_SCRIPT="$(BR2_EXTERNAL)/scripts/rootfs_script.sh"

# Filesystem
BR2_TARGET_ROOTFS_SQUASHFS=y
BR2_TARGET_ROOTFS_SQUASHFS4_XZ=y

BR2_THINGINO_SYSTEM_PACKAGES=y

BR2_PACKAGE_BUSYBOX_CONFIG="$(BR2_EXTERNAL)/package/busybox/busybox.config"
BR2_GLOBAL_PATCH_DIR="$(BR2_EXTERNAL)/package/all-patches"

# Wireless
# BR2_PACKAGE_ATBM60XX is not set
# BR2_PACKAGE_RTL8188EU is not set
# BR2_PACKAGE_RTL8189ES_OPENIPC is not set
BR2_PACKAGE_RTL8189FS=y
BR2_PACKAGE_WIRELESS_TOOLS=y
BR2_PACKAGE_WPA_SUPPLICANT=y
BR2_PACKAGE_WPA_SUPPLICANT_PASSPHRASE=y
# BR2_PACKAGE_LINUX_FIRMWARE is not set
# BR2_PACKAGE_LINUX_FIRMWARE_MEDIATEK_MT7601U is not set
```

## configs/cameras-exp/360_ap6pcm03_t31x_gc4653_eth+atbm6031/360_ap6pcm03_t31x_gc4653_eth+atbm6031_defconfig
```kconfig
# NAME: 360 AP6PCM03 (T31X, GC4653, ETH, ATBM6031)
# FRAG: soc-xburst1 core ssl
BR2_AVPU_CLK_486MHZ=y
BR2_AVPU_VPLL=y
BR2_ETHERNET=y
BR2_INGENIC_SOC_MODEL="t31x"
BR2_ISP_CLK_250MHZ=y
BR2_PACKAGE_THINGINO_KOPT_DWC2=y
BR2_PACKAGE_THINGINO_KOPT_DWC2_OTG=y
BR2_PACKAGE_THINGINO_KOPT_JZ_MAC_V13=y
BR2_PACKAGE_THINGINO_KOPT_MMC0=y
BR2_PACKAGE_THINGINO_KOPT_MMC0_PB_4BIT=y
BR2_PACKAGE_THINGINO_KOPT_MMC1=y
BR2_PACKAGE_THINGINO_KOPT_MMC1_PA_4BIT=y
BR2_PACKAGE_THINGINO_RAPTOR_CONF_IMAGE_HFLIP="1"
BR2_PACKAGE_THINGINO_RAPTOR_CONF_IMAGE_VFLIP="1"
BR2_PACKAGE_USBNET=y
BR2_PACKAGE_USBNET_USB_DIRECT_NCM=y
BR2_PACKAGE_WIFI=y
BR2_PACKAGE_WIFI_ATBM6031=y
BR2_SENSOR_1_NAME="gc4653"
BR2_SENSOR_1_PARAMS="shvflip=1"
BR2_THINGINO_AUDIO=y
BR2_THINGINO_AUDIO_GPIO=63
BR2_THINGINO_BUTTON=y
BR2_THINGINO_CLONER=y
BR2_THINGINO_LED_B_GPIO=51
BR2_THINGINO_LED_G_GPIO=54
BR2_THINGINO_MOTORS=y
BR2_THINGINO_PWM_ENABLE=y
BR2_THINGINO_RMEM_MB=48
BR2_THINGINO_SDCARD=y
FLASH_SIZE_MB=32
```

## configs/cameras-exp/360_d619_t10_ov9732_rtl8188eus/360_d619_t10_ov9732_rtl8188eus_defconfig
```kconfig
# NAME: 360 D619 (T10, OV9732, RTL8188EUS)
# FRAG: soc-xburst1 toolchain-xburst1 ccache brand rootfs kernel system target uboot ssl
BR2_PACKAGE_WIFI=y
BR2_PACKAGE_WIFI_RTL8188EUS=y
BR2_SENSOR_OV9732=y
BR2_SOC_INGENIC_T10A=y
BR2_PACKAGE_THINGINO_KOPT_DWC2=y
BR2_PACKAGE_THINGINO_KOPT_DWC2_OTG=y
BR2_PACKAGE_THINGINO_KOPT_MMC0=y
BR2_PACKAGE_THINGINO_KOPT_MMC0_PB_4BIT=y
BR2_PACKAGE_THINGINO_KOPT_MMC1=y
BR2_PACKAGE_THINGINO_KOPT_MMC1_PC_4BIT=y
BR2_THINGINO_AUDIO=y
BR2_THINGINO_BUTTON=y
BR2_THINGINO_PWM_ENABLE=y
BR2_THINGINO_SDCARD=y
FLASH_SIZE_16=y
```

## configs/cameras-exp/360_k7ts_t41nq_gc4023_eth/360_k7ts_t41nq_gc4023_eth_defconfig
```kconfig
# NAME: 360 K7TS (T41NQ, GC4023, ETH, SPI-NAND)
# FRAG: soc-xburst2 core ssl flash-nand
BR2_ETHERNET=y
BR2_INGENIC_SOC_MODEL="t41nq"
BR2_LINUX_KERNEL_EXT_THINGINO_KOPT=y
BR2_LINUX_KERNEL_EXT_THINGINO_KOPT_DTS=y
BR2_LINUX_KERNEL_EXT_THINGINO_KOPT_DTS_360K7TS=y
BR2_PACKAGE_THINGINO_KOPT_MMC0=y
BR2_PACKAGE_THINGINO_KOPT_MMC0_PB_4BIT=y
BR2_PACKAGE_THINGINO_RAPTOR_CONF_SENSOR_I2C_ADAPTER="0"
BR2_PACKAGE_THINGINO_RAPTOR_CONF_SENSOR_I2C_ADDR="0x29"
BR2_PACKAGE_THINGINO_RAPTOR_CONF_SENSOR_MCLK="1"
BR2_PACKAGE_THINGINO_RAPTOR_CONF_SENSOR_NAME="gc4023"
BR2_PACKAGE_THINGINO_RAPTOR_CONF_SENSOR_PWDN_GPIO="19"
BR2_PACKAGE_THINGINO_RAPTOR_CONF_SENSOR_RST_GPIO="18"
BR2_PACKAGE_THINGINO_RAPTOR_CONF_SENSOR_VIDEO_INTERFACE="0"
BR2_PACKAGE_THINGINO_UBOOT_FLASH_CONTROLLER_JZ_SFC=n
BR2_PACKAGE_THINGINO_UBOOT_FLASH_CONTROLLER_SFC0_NAND=y
BR2_SENSOR_1_NAME="gc4023"
BR2_THINGINO_AUDIO=y
BR2_THINGINO_AUDIO_GPIO=63
BR2_THINGINO_AUDIO_GPIO_LOW=y
BR2_THINGINO_BUTTON=y
BR2_THINGINO_FLASH_NAND=y
BR2_THINGINO_MOTORS=y
BR2_THINGINO_NMEM_MB=20
BR2_THINGINO_RMEM_MB=33
BR2_THINGINO_SDCARD=y
FLASH_SIZE_MB=128
```

## configs/cameras-exp/anker_c200_t31x_sc500ai/anker_c200_t31x_sc500ai_defconfig
```kconfig
# NAME: Anker C200 (T31X, SC500AI)
# FRAG: soc-xburst1 toolchain-xburst1 ccache brand rootfs kernel system target uboot ssl
BR2_AVPU_CLK_600MHZ=y
BR2_ISP_CLK_200MHZ=y
BR2_PACKAGE_MOTORS=y
BR2_PACKAGE_THINGINO_KOPT_DWC2=y
BR2_PACKAGE_THINGINO_KOPT_DWC2_OTG=y
BR2_PACKAGE_THINGINO_MOTORS_DW9714_ONLY=y
BR2_PACKAGE_USBNET=y
BR2_PACKAGE_USBNET_USB_DIRECT_NCM=y
BR2_SENSOR_1_NAME="sc500ai"
BR2_SOC_INGENIC_T31X=y
BR2_THINGINO_AUDIO=y
BR2_THINGINO_MOTORS=y
BR2_THINGINO_RMEM_MB=64
FLASH_SIZE_MB=16
```

## configs/cameras-exp/besder_w9q_t23n_os02n10_aic8800u/besder_w9q_t23n_os02n10_aic8800u_defconfig
```kconfig
# NAME: Besder W9Q (T23N, 2xOS02N10, AIC8800 USB)
# FRAG: soc-xburst1 ccache brand rootfs kernel system target uboot ssl
BR2_THINGINO_TOOLCHAIN_TYPE_EXTERNAL=y
BR2_THINGINO_TOOLCHAIN_GCC_15=y
BR2_THINGINO_TOOLCHAIN_LIBC_UCLIBC=y
#BR2_TARGET_ROOTFS_SQUASHFS_BS_1024K=y
BR2_ISP_CONFIG_HZ=200000000
BR2_ISP_CONFIG_HZ=200000000
BR2_PACKAGE_THINGINO_KOPT_MMC0=y
BR2_PACKAGE_THINGINO_KOPT_MMC0_PB_4BIT=y
BR2_PACKAGE_WIFI=y
BR2_PACKAGE_WIFI_AIC8800=y
BR2_PACKAGE_WIFI_AIC8800_USB=y
BR2_PACKAGE_WIFI_AIC8800_USB_8800D80=y
BR2_SENSOR_1_NAME="os02n10s0"
BR2_SENSOR_2_NAME="os02n10s1"
BR2_INGENIC_SOC_MODEL="t23n"
BR2_THINGINO_AUDIO=y
BR2_THINGINO_AUDIO_GPIO=63
BR2_THINGINO_BUTTON=y
BR2_THINGINO_IMAGE_SENSOR_QTY=2
BR2_THINGINO_PWM_ENABLE=y
BR2_THINGINO_SDCARD=y
FLASH_SIZE_MB=8
```

## configs/cameras-exp/cinnado_d1_3k_atbm6132u/cinnado_d1_3k_atbm6132u_defconfig
```kconfig
# NAME: Cinnado D1 3K (T41NQ, SC5336, ATBM6132U)
# FRAG: soc-xburst2 toolchain-xburst2 ccache brand rootfs kernel system target uboot ssl
BR2_AVPU_APLL=y
BR2_AVPU_CLK_550MHZ=y
BR2_ISP_CLKA_550MHZ=y
BR2_ISP_CLKA_SCLKA=y
BR2_ISP_CLKS_550MHZ=y
BR2_ISP_CLKS_SCLKA=y
BR2_ISP_CLK_300MHZ=y
BR2_ISP_CLK_VPLL=y
BR2_PACKAGE_THINGINO_UBOOT_FLASH_CONTROLLER_JZ_SFC=n
BR2_PACKAGE_THINGINO_UBOOT_FLASH_CONTROLLER_SFC0_NOR=y
BR2_PACKAGE_WIFI=y
BR2_PACKAGE_WIFI_ATBM6132U=y
BR2_SENSOR_1_NAME="sc5336"
BR2_SOC_INGENIC_T41NQ=y
BR2_THINGINO_AUDIO=y
BR2_THINGINO_NMEM_MB=8
BR2_THINGINO_RMEM_MB=64
FLASH_NOR=y
FLASH_SIZE_MB=16
```

## configs/cameras-exp/cinnado_d1_t31l_kernel44/cinnado_d1_t31l_kernel44_defconfig
```kconfig
# NAME: Cinnado D1 T31L (T31L, SC2336, ATBM6031) with Kernel 4.4
# FRAG: soc-xburst1 toolchain-xburst1 ccache brand rootfs kernel system target uboot ssl
BR2_PACKAGE_WIFI=y
BR2_PACKAGE_WIFI_ATBM6031=y
BR2_SENSOR_SC2336=y
BR2_SOC_INGENIC_T31L=y
#BR2_KERNEL_VERSION_4=y
BR2_THINGINO_MOTORS=y
BR2_THINGINO_MOTORS_TCU=y
BR2_THINGINO_SDCARD=y
#CONFIG_KERNEL_VERSION_4=y
FLASH_SIZE_8=y
KERNEL_VERSION_4=y
```
