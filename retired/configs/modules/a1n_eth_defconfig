## retired/configs/modules/a1n_eth_defconfig
```kconfig
# NAME: A1N, SENSOR_DUMMY, ETH
# FRAG: soc-xburst2 toolchain-xburst2 ccache brand rootfs kernel system target uboot ssl
BR2_ETHERNET=y
BR2_SENSOR_DUMMY=y
BR2_SOC_INGENIC_A1N=y
```

## retired/configs/modules/c100_gc2053_bcmdhd_ap6214a_defconfig
```kconfig
# NAME: C100, GC2063, BCMDHD_AP6214A
# FRAG: soc-xburst1 toolchain-xb1-gcc14-glibc-br ccache brand rootfs kernel system target uboot ssl
BR2_PACKAGE_WIFI=y
BR2_PACKAGE_WIFI_BCMDHD_AP6214A=y
BR2_SENSOR_GC2053=y
BR2_SOC_INGENIC_C100=y
```

## retired/configs/modules/t10_ov9732_rtl8188eu_defconfig
```kconfig
# NAME: T10, OV9732, RTL8188EU
# FRAG: soc-xburst1 toolchain-xburst1 ccache brand rootfs kernel system target uboot ssl
BR2_PACKAGE_WIFI=y
BR2_PACKAGE_WIFI_RTL8188EU=y
BR2_SENSOR_OV9732=y
BR2_SOC_INGENIC_T10A=y
```

## retired/configs/modules/t20l_ps5250_rtl8189ftv_defconfig
```kconfig
# NAME: T20L, PS5250, RTL8189FTV
# FRAG: soc-xburst1 toolchain-xburst1 ccache brand rootfs kernel system target uboot ssl
BR2_PACKAGE_WIFI=y
BR2_PACKAGE_WIFI_RTL8189FS=y
BR2_SENSOR_PS5250=y
BR2_SOC_INGENIC_T20L=y
```

## retired/configs/modules/t20n_gc1084_atbm6012bx_defconfig
```kconfig
# NAME: T20N, GC1084, ATBM6012BX
# FRAG: soc-xburst1 toolchain-xburst1 ccache brand rootfs kernel system target uboot ssl
BR2_ETHERNET=y
BR2_PACKAGE_WIFI=y
BR2_PACKAGE_WIFI_ATBM6012BX=y
BR2_SENSOR_GC1084=y
BR2_SOC_INGENIC_T20N=y
```

## retired/configs/modules/t23n_gc2083_aic8800u_defconfig
```kconfig
# NAME: T23N, GC2083, AIC8800 (USB)
# FRAG: soc-xburst1 toolchain-xburst1 ccache brand rootfs kernel system target uboot ssl
BR2_PACKAGE_WIFI=y
BR2_PACKAGE_WIFI_AIC8800=y
BR2_PACKAGE_WIFI_AIC8800_USB=y
BR2_PACKAGE_WIFI_AIC8800_USB_8800D80=y
BR2_SENSOR_GC2083=y
BR2_SOC_INGENIC_T23N=y
```

## retired/configs/modules/t23n_sc1346_atbm6132u_defconfig
```kconfig
# NAME: T23N, SC1346, ATBM6132U
# FRAG: soc-xburst1 toolchain-xburst1 ccache brand rootfs kernel system target uboot ssl
BR2_PACKAGE_WIFI=y
BR2_PACKAGE_WIFI_ATBM6132U=y
BR2_SENSOR_SC1346=y
BR2_SOC_INGENIC_T23N=y
```

## retired/configs/modules/t23n_sc3336_wq9001_defconfig
```kconfig
# NAME: T23N, SC3336, WQ9001
# FRAG: soc-xburst1 toolchain-xburst1 ccache brand rootfs kernel system target uboot ssl
BR2_SOC_INGENIC_T23N=y
BR2_SENSOR_SC3336=y
BR2_PACKAGE_WIFI=y
BR2_PACKAGE_WIFI_WQ9001=y
```

## retired/configs/modules/t30l_sc1235_rtl8189ftv_defconfig
```kconfig
# NAME: T30L, SC1235, RTL8189FTV
# FRAG: soc-xburst1 toolchain-xburst1 ccache brand rootfs kernel system target uboot ssl
BR2_PACKAGE_WIFI=y
BR2_PACKAGE_WIFI_RTL8189FS=y
BR2_SENSOR_SC1235=y
BR2_SOC_INGENIC_T30L=y
```

## retired/configs/modules/t31l_sc2336_ssv6256p_defconfig
```kconfig
# NAME: T31L, SC2336, SV6256P
# FRAG: soc-xburst1 toolchain-xburst1 ccache brand rootfs kernel system target uboot ssl
BR2_PACKAGE_WIFI=y
BR2_SENSOR_SC2336=y
BR2_SOC_INGENIC_T31L=y
BR2_PACKAGE_WIFI_SSV6X5X=y
BR2_PACKAGE_WIFI_SSV6X5X_SV6256P=y
```

## retired/configs/modules/t31n_jxf23_rtl8189ftv_defconfig
```kconfig
# NAME: T31N, JXF23, RTL8189FTV
# FRAG: soc-xburst1 toolchain-xburst1 ccache brand rootfs kernel system target uboot ssl
BR2_PACKAGE_WIFI=y
BR2_PACKAGE_WIFI_RTL8189FS=y
BR2_SENSOR_JXF23=y
BR2_SOC_INGENIC_T31N=y
```

## retired/configs/modules/t31x_gc4023_eth_rtl8188ftv_defconfig
```kconfig
# NAME: T31X, GC4023, ETH, RTL8188FTV
# FRAG: soc-xburst1 toolchain-xburst1 ccache brand rootfs kernel system target uboot ssl
BR2_PACKAGE_WIFI=y
BR2_PACKAGE_WIFI_RTL8188FU=y
BR2_ETHERNET=y
BR2_PACKAGE_THINGINO_KOPT_JZ_MAC_V13=y
BR2_SENSOR_GC4023=y
BR2_SOC_INGENIC_T31X=y
```

## retired/configs/modules/t41nq_gc4023_eth_defconfig
```kconfig
# NAME: T41NQ, GC4023, ETH
# FRAG: soc-xburst2 toolchain-xburst2 ccache brand rootfs kernel system target uboot ssl
BR2_ETHERNET=y
BR2_SENSOR_GC4023=y
BR2_SOC_INGENIC_T41NQ=y
BR2_PACKAGE_THINGINO_UBOOT_FLASH_CONTROLLER_JZ_SFC=n
BR2_PACKAGE_THINGINO_UBOOT_FLASH_CONTROLLER_SFC0_NOR=y
```
